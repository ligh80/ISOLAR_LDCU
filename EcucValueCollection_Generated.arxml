AUTOSAR XML (schema 4-2-2)
package /ETAS_Project/EcucModuleConfigurationValuess
  ecuc value collection EcucValueCollection_0: ecuc-values=[Rte, Os, ComStack, Com, CanIf, Can, PduR, CanSM, ComM, EcuC]
