AUTOSAR XML (schema 4-2-2)
package /ETAS_Project/EcucModuleConfigurationValuess
  module config Com: implementation-config-variant=VARIANT-PRE-COMPILE
    ComConfig_0 (ComConfig)
      ComTimeBase: ComGwTimeBase=0.005, ComRxTimeBase=0.01, ComTxTimeBase=0.01
      ComIPduGroup_Rx (ComIPduGroup)
      C_LDCU_IPB_RaxleRegen_Can_Network_CANNODE_0 (ComIPdu):
        ComIPduSignalProcessing = IMMEDIATE
        ComIPduType = NORMAL
        ComIPduDirection = RECEIVE
        ComIPduGroupRef = ComIPduGroup_Rx
        ComPduIdRef = PduCollection/C_LDCU_IPB_RaxleRegen_Can_Network_CANNODE_0_PduR2Com
        ComIPduSignalRef = C_LDCU_RMotorSpd
        ComIPduSignalRef = C_LDCU_RMotorSpdVD
        ComIPduSignalRef = C_LDCU_RMotorSpdDirection
      3 x ComSignal, all with ComSignalInitValue=0, ComTimeout=0.1, ComSignalEndianness=BIG_ENDIAN, ComUpdateBitPosition=-1, ComTransferProperty=TRIGGERED:
        C_LDCU_RMotorSpd: ComSignalType=UINT16, ComBitSize=14, ComBitPosition=7, ComSystemTemplateSystemSignalRef=C_LDCU_RMotorSpd
        C_LDCU_RMotorSpdVD: ComSignalType=UINT8, ComBitSize=2, ComBitPosition=33, ComSystemTemplateSystemSignalRef=C_LDCU_RMotorSpdVD
        C_LDCU_RMotorSpdDirection: ComSignalType=BOOLEAN, ComBitSize=1, ComBitPosition=9, ComSystemTemplateSystemSignalRef=C_LDCU_RMotorSpdDirection
      C_IPB_SpdEdges_Can_Network_CANNODE_0 (ComIPdu):
        ComIPduSignalProcessing = IMMEDIATE
        ComIPduType = NORMAL
        ComIPduDirection = RECEIVE
        ComIPduGroupRef = ComIPduGroup_Rx
        ComPduIdRef = PduCollection/C_IPB_SpdEdges_Can_Network_CANNODE_0_PduR2Com
        ComIPduSignalRef = C_IPB_FLWheelSpdEdgesSum
        ComIPduSignalRef = C_IPB_FRWheelSpdEdgesSum
        ComIPduSignalRef = C_IPB_RLWheelSpdEdgesSum
        ComIPduSignalRef = C_IPB_RRWheelSpdEdgesSum
        ComIPduSignalRef = C_IPB_SpdEdgesMsgCounter
        ComIPduSignalRef = C_IPB_SpdEdgesCRC8Checksum
      6 x ComSignal, all with ComSignalInitValue=0, ComTimeout=0.05, ComSignalEndianness=BIG_ENDIAN, ComUpdateBitPosition=-1, ComTransferProperty=TRIGGERED:
        C_IPB_FLWheelSpdEdgesSum: ComSignalType=UINT16, ComBitSize=12, ComBitPosition=11, ComSystemTemplateSystemSignalRef=C_IPB_FLWheelSpdEdgesSum
        C_IPB_FRWheelSpdEdgesSum: ComSignalType=UINT16, ComBitSize=12, ComBitPosition=7, ComSystemTemplateSystemSignalRef=C_IPB_FRWheelSpdEdgesSum
        C_IPB_RLWheelSpdEdgesSum: ComSignalType=UINT16, ComBitSize=12, ComBitPosition=31, ComSystemTemplateSystemSignalRef=C_IPB_RLWheelSpdEdgesSum
        C_IPB_RRWheelSpdEdgesSum: ComSignalType=UINT16, ComBitSize=12, ComBitPosition=35, ComSystemTemplateSystemSignalRef=C_IPB_RRWheelSpdEdgesSum
        C_IPB_SpdEdgesMsgCounter: ComSignalType=UINT8, ComBitSize=4, ComBitPosition=51, ComSystemTemplateSystemSignalRef=C_IPB_SpdEdgesMsgCounter
        C_IPB_SpdEdgesCRC8Checksum: ComSignalType=UINT8, ComBitSize=8, ComBitPosition=63, ComSystemTemplateSystemSignalRef=C_IPB_SpdEdgesCRC8Checksum
      C_IPB_SpdInfoR_Can_Network_CANNODE_0 (ComIPdu):
        ComIPduSignalProcessing = IMMEDIATE
        ComIPduType = NORMAL
        ComIPduDirection = RECEIVE
        ComIPduGroupRef = ComIPduGroup_Rx
        ComPduIdRef = PduCollection/C_IPB_SpdInfoR_Can_Network_CANNODE_0_PduR2Com
        ComIPduSignalRef = C_IPB_RLWheelSpd
        ComIPduSignalRef = C_IPB_RLWheelSpdVD
        ComIPduSignalRef = C_IPB_RRWheelSpd
        ComIPduSignalRef = C_IPB_RRWheelSpdVD
        ComIPduSignalRef = C_IPB_SimulatorPressure
        ComIPduSignalRef = C_IPB_SimulatorPressure_Status
        ComIPduSignalRef = C_IPB_SpdInfo2MsgCounter
        ComIPduSignalRef = C_IPB_SpdInfo2CRC8Checksum
      8 x ComSignal, all with ComTimeout=0.05, ComSignalEndianness=BIG_ENDIAN, ComUpdateBitPosition=-1, ComTransferProperty=TRIGGERED:
        C_IPB_RLWheelSpd: ComSignalInitValue=0, ComSignalType=UINT16, ComBitSize=15, ComBitPosition=7, ComSystemTemplateSystemSignalRef=C_IPB_RLWheelSpd
        C_IPB_RLWheelSpdVD: ComSignalInitValue=0, ComSignalType=BOOLEAN, ComBitSize=1, ComBitPosition=8, ComSystemTemplateSystemSignalRef=C_IPB_RLWheelSpdVD
        C_IPB_RRWheelSpd: ComSignalInitValue=0, ComSignalType=UINT16, ComBitSize=15, ComBitPosition=23, ComSystemTemplateSystemSignalRef=C_IPB_RRWheelSpd
        C_IPB_RRWheelSpdVD: ComSignalInitValue=0, ComSignalType=BOOLEAN, ComBitSize=1, ComBitPosition=24, ComSystemTemplateSystemSignalRef=C_IPB_RRWheelSpdVD
        C_IPB_SimulatorPressure: ComSignalInitValue=17, ComSignalType=UINT16, ComBitSize=10, ComBitPosition=39, ComSystemTemplateSystemSignalRef=C_IPB_SimulatorPressure
        C_IPB_SimulatorPressure_Status: ComSignalInitValue=0, ComSignalType=UINT8, ComBitSize=2, ComBitPosition=45, ComSystemTemplateSystemSignalRef=C_IPB_SimulatorPressure_Status
        C_IPB_SpdInfo2MsgCounter: ComSignalInitValue=0, ComSignalType=UINT8, ComBitSize=4, ComBitPosition=51, ComSystemTemplateSystemSignalRef=C_IPB_SpdInfo2MsgCounter
        C_IPB_SpdInfo2CRC8Checksum: ComSignalInitValue=0, ComSignalType=UINT8, ComBitSize=8, ComBitPosition=63, ComSystemTemplateSystemSignalRef=C_IPB_SpdInfo2CRC8Checksum
      C_LDCU_EPB_APB_ROPP2_Can_Network_CANNODE_0 (ComIPdu):
        ComIPduSignalProcessing = IMMEDIATE
        ComIPduType = NORMAL
        ComIPduDirection = RECEIVE
        ComIPduGroupRef = ComIPduGroup_Rx
        ComPduIdRef = PduCollection/C_LDCU_EPB_APB_ROPP2_Can_Network_CANNODE_0_PduR2Com
        ComIPduSignalGroupRef = ISigGrp_C_LDCU_EPB_APB_ROPP2
      ISigGrp_C_LDCU_EPB_APB_ROPP2 (ComSignalGroup):
        ComTimeout = 0.1
        ComTransferProperty = TRIGGERED
        ComNotification = Rte_COMCbk_ISigGrp_C_LDCU_EPB_APB_ROPP2
        ComTimeoutNotification = Rte_COMCbkTOut_ISigGrp_C_LDCU_EPB_APB_ROPP2
        ComSystemTemplateSignalGroupRef = ISignalToIPduMapping_ISigGrp_C_LDCU_EPB_APB_ROPP2
        8 x ComGroupSignal, all with ComTransferProperty=TRIGGERED_ON_CHANGE, ComSignalEndianness=BIG_ENDIAN, ComBitSize=8, ComSignalType=UINT8:
          C_LDCU_EPB_APB_ROPP2_Byte0: ComBitPosition=7, ComSignalInitValue=0, ComSystemTemplateSystemSignalRef=C_LDCU_EPB_APB_ROPP2_Byte0
          C_LDCU_EPB_APB_ROPP2_Byte1: ComBitPosition=15, ComSignalInitValue=0, ComSystemTemplateSystemSignalRef=C_LDCU_EPB_APB_ROPP2_Byte1
          C_LDCU_EPB_APB_ROPP2_Byte2: ComBitPosition=23, ComSignalInitValue=128, ComSystemTemplateSystemSignalRef=C_LDCU_EPB_APB_ROPP2_Byte2
          C_LDCU_EPB_APB_ROPP2_Byte3: ComBitPosition=31, ComSignalInitValue=0, ComSystemTemplateSystemSignalRef=C_LDCU_EPB_APB_ROPP2_Byte3
          C_LDCU_EPB_APB_ROPP2_Byte4: ComBitPosition=39, ComSignalInitValue=4, ComSystemTemplateSystemSignalRef=C_LDCU_EPB_APB_ROPP2_Byte4
          C_LDCU_EPB_APB_ROPP2_Byte5: ComBitPosition=47, ComSignalInitValue=0, ComSystemTemplateSystemSignalRef=C_LDCU_EPB_APB_ROPP2_Byte5
          C_LDCU_EPB_APB_ROPP2_Byte6: ComBitPosition=55, ComSignalInitValue=0, ComSystemTemplateSystemSignalRef=C_LDCU_EPB_APB_ROPP2_Byte6
          C_LDCU_EPB_APB_ROPP2_Byte7: ComBitPosition=63, ComSignalInitValue=0, ComSystemTemplateSystemSignalRef=C_LDCU_EPB_APB_ROPP2_Byte7
      C_IPB_SysSt_E2E_Can_Network_CANNODE_0 (ComIPdu):
        ComIPduSignalProcessing = IMMEDIATE
        ComIPduType = NORMAL
        ComIPduDirection = RECEIVE
        ComIPduGroupRef = ComIPduGroup_Rx
        ComPduIdRef = PduCollection/C_IPB_SysSt_E2E_Can_Network_CANNODE_0_PduR2Com
        ComIPduSignalGroupRef = ISigGrp_C_IPB_SysSt_E2E
      ISigGrp_C_IPB_SysSt_E2E (ComSignalGroup):
        ComTimeout = 0.2
        ComTransferProperty = TRIGGERED
        ComNotification = Rte_COMCbk_ISigGrp_C_IPB_SysSt_E2E
        ComTimeoutNotification = Rte_COMCbkTOut_ISigGrp_C_IPB_SysSt_E2E
        ComSystemTemplateSignalGroupRef = ISignalToIPduMapping_ISigGrp_C_IPB_SysSt_E2E
        12 x ComGroupSignal, all with ComTransferProperty=TRIGGERED_ON_CHANGE, ComSignalEndianness=BIG_ENDIAN, ComBitSize=8, ComSignalType=UINT8:
          C_IPB_SysSt_E2E_Byte0: ComBitPosition=7, ComSignalInitValue=4, ComSystemTemplateSystemSignalRef=C_IPB_SysSt_E2E_Byte0
          C_IPB_SysSt_E2E_Byte1: ComBitPosition=15, ComSignalInitValue=34, ComSystemTemplateSystemSignalRef=C_IPB_SysSt_E2E_Byte1
          C_IPB_SysSt_E2E_Byte2: ComBitPosition=23, ComSignalInitValue=113, ComSystemTemplateSystemSignalRef=C_IPB_SysSt_E2E_Byte2
          C_IPB_SysSt_E2E_Byte3: ComBitPosition=31, ComSignalInitValue=39, ComSystemTemplateSystemSignalRef=C_IPB_SysSt_E2E_Byte3
          C_IPB_SysSt_E2E_Byte4: ComBitPosition=39, ComSignalInitValue=17, ComSystemTemplateSystemSignalRef=C_IPB_SysSt_E2E_Byte4
          C_IPB_SysSt_E2E_Byte5: ComBitPosition=47, ComSignalInitValue=116, ComSystemTemplateSystemSignalRef=C_IPB_SysSt_E2E_Byte5
          C_IPB_SysSt_E2E_Byte6: ComBitPosition=55, ComSignalInitValue=0, ComSystemTemplateSystemSignalRef=C_IPB_SysSt_E2E_Byte6
          C_IPB_SysSt_E2E_Byte7: ComBitPosition=63, ComSignalInitValue=0, ComSystemTemplateSystemSignalRef=C_IPB_SysSt_E2E_Byte7
          C_IPB_SysSt_E2E_Byte8: ComBitPosition=71, ComSignalInitValue=0, ComSystemTemplateSystemSignalRef=C_IPB_SysSt_E2E_Byte8
          C_IPB_SysSt_E2E_Byte9: ComBitPosition=79, ComSignalInitValue=0, ComSystemTemplateSystemSignalRef=C_IPB_SysSt_E2E_Byte9
          C_IPB_SysSt_E2E_Byte10: ComBitPosition=87, ComSignalInitValue=0, ComSystemTemplateSystemSignalRef=C_IPB_SysSt_E2E_Byte10
          C_IPB_SysSt_E2E_Byte11: ComBitPosition=95, ComSignalInitValue=0, ComSystemTemplateSystemSignalRef=C_IPB_SysSt_E2E_Byte11
      C_MFS_Status_Can_Network_CANNODE_0 (ComIPdu):
        ComIPduSignalProcessing = IMMEDIATE
        ComIPduType = NORMAL
        ComIPduDirection = RECEIVE
        ComIPduGroupRef = ComIPduGroup_Rx
        ComPduIdRef = PduCollection/C_MFS_Status_Can_Network_CANNODE_0_PduR2Com
        ComIPduSignalGroupRef = ISigGrp_C_MFS_Status
      ISigGrp_C_MFS_Status (ComSignalGroup):
        ComTimeout = 0.2
        ComTransferProperty = TRIGGERED
        ComNotification = Rte_COMCbk_ISigGrp_C_MFS_Status
        ComTimeoutNotification = Rte_COMCbkTOut_ISigGrp_C_MFS_Status
        ComSystemTemplateSignalGroupRef = ISignalToIPduMapping_ISigGrp_C_MFS_Status
        8 x ComGroupSignal, all with ComTransferProperty=TRIGGERED_ON_CHANGE, ComSignalEndianness=BIG_ENDIAN, ComSignalInitValue=0, ComBitSize=8, ComSignalType=UINT8:
          C_MFS_Status_Byte0: ComBitPosition=7, ComSystemTemplateSystemSignalRef=C_MFS_Status_Byte0
          C_MFS_Status_Byte1: ComBitPosition=15, ComSystemTemplateSystemSignalRef=C_MFS_Status_Byte1
          C_MFS_Status_Byte2: ComBitPosition=23, ComSystemTemplateSystemSignalRef=C_MFS_Status_Byte2
          C_MFS_Status_Byte3: ComBitPosition=31, ComSystemTemplateSystemSignalRef=C_MFS_Status_Byte3
          C_MFS_Status_Byte4: ComBitPosition=39, ComSystemTemplateSystemSignalRef=C_MFS_Status_Byte4
          C_MFS_Status_Byte5: ComBitPosition=47, ComSystemTemplateSystemSignalRef=C_MFS_Status_Byte5
          C_MFS_Status_Byte6: ComBitPosition=55, ComSystemTemplateSystemSignalRef=C_MFS_Status_Byte6
          C_MFS_Status_Byte7: ComBitPosition=63, ComSystemTemplateSystemSignalRef=C_MFS_Status_Byte7
      C_IPB_SysSt1_Can_Network_CANNODE_0 (ComIPdu):
        ComIPduSignalProcessing = IMMEDIATE
        ComIPduType = NORMAL
        ComIPduDirection = RECEIVE
        ComIPduGroupRef = ComIPduGroup_Rx
        ComPduIdRef = PduCollection/C_IPB_SysSt1_Can_Network_CANNODE_0_PduR2Com
        ComIPduSignalRef = C_IPB_InputRodStroke
        ComIPduSignalRef = C_IPB_InputRodStroke_Status
        ComIPduSignalRef = C_IPB_WheelPressureFrontLeftVD
        ComIPduSignalRef = C_IPB_WheelPressureFrontLeft
        ComIPduSignalRef = C_IPB_SysSt1MsgCounter
        ComIPduSignalRef = C_IPB_SysSt1CRC8Checksum
      6 x ComSignal, all with ComTimeout=0.1, ComSignalEndianness=BIG_ENDIAN, ComUpdateBitPosition=-1, ComTransferProperty=TRIGGERED:
        C_IPB_InputRodStroke: ComSignalInitValue=100, ComSignalType=UINT16, ComBitSize=12, ComBitPosition=7, ComSystemTemplateSystemSignalRef=C_IPB_InputRodStroke
        C_IPB_InputRodStroke_Status: ComSignalInitValue=0, ComSignalType=UINT8, ComBitSize=2, ComBitPosition=27, ComSystemTemplateSystemSignalRef=C_IPB_InputRodStroke_Status
        C_IPB_WheelPressureFrontLeftVD: ComSignalInitValue=0, ComSignalType=BOOLEAN, ComBitSize=1, ComBitPosition=34, ComSystemTemplateSystemSignalRef=C_IPB_WheelPressureFrontLeftVD
        C_IPB_WheelPressureFrontLeft: ComSignalInitValue=640, ComSignalType=UINT16, ComBitSize=14, ComBitPosition=33, ComSystemTemplateSystemSignalRef=C_IPB_WheelPressureFrontLeft
        C_IPB_SysSt1MsgCounter: ComSignalInitValue=0, ComSignalType=UINT8, ComBitSize=4, ComBitPosition=51, ComSystemTemplateSystemSignalRef=C_IPB_SysSt1MsgCounter
        C_IPB_SysSt1CRC8Checksum: ComSignalInitValue=0, ComSignalType=UINT8, ComBitSize=8, ComBitPosition=63, ComSystemTemplateSystemSignalRef=C_IPB_SysSt1CRC8Checksum
      C_AS_SysSt2_Can_Network_CANNODE_0 (ComIPdu):
        ComIPduSignalProcessing = IMMEDIATE
        ComIPduType = NORMAL
        ComIPduDirection = RECEIVE
        ComIPduGroupRef = ComIPduGroup_Rx
        ComPduIdRef = PduCollection/C_AS_SysSt2_Can_Network_CANNODE_0_PduR2Com
        ComIPduSignalRef = C_AS_wheelPosFLFilt_mm
        ComIPduSignalRef = C_AS_wheelPosFRFilt_mm
        ComIPduSignalRef = C_AS_wheelPosRLFilt_mm
        ComIPduSignalRef = C_AS_wheelPosRRFilt_mm
      4 x ComSignal, all with ComSignalInitValue=1000, ComTimeout=0.2, ComSignalType=UINT16, ComSignalEndianness=BIG_ENDIAN, ComBitSize=11, ComUpdateBitPosition=-1, ComTransferProperty=TRIGGERED:
        C_AS_wheelPosFLFilt_mm: ComBitPosition=7, ComSystemTemplateSystemSignalRef=C_AS_wheelPosFLFilt_mm
        C_AS_wheelPosFRFilt_mm: ComBitPosition=12, ComSystemTemplateSystemSignalRef=C_AS_wheelPosFRFilt_mm
        C_AS_wheelPosRLFilt_mm: ComBitPosition=17, ComSystemTemplateSystemSignalRef=C_AS_wheelPosRLFilt_mm
        C_AS_wheelPosRRFilt_mm: ComBitPosition=38, ComSystemTemplateSystemSignalRef=C_AS_wheelPosRRFilt_mm
      C_LDCU_EPBDebugData_Can_Network_CANNODE_0 (ComIPdu):
        ComIPduSignalProcessing = IMMEDIATE
        ComIPduType = NORMAL
        ComIPduDirection = RECEIVE
        ComIPduGroupRef = ComIPduGroup_Rx
        ComPduIdRef = PduCollection/C_LDCU_EPBDebugData_Can_Network_CANNODE_0_PduR2Com
        ComIPduSignalRef = C_LDCU_VehicleCurrentState
        ComIPduSignalRef = C_VehicleCurrentSpeed
        ComIPduSignalRef = C_VehicleCurrentSpeedVD
        ComIPduSignalRef = C_VehicleRwuVD
        ComIPduSignalRef = C_VehicleRwuSpeed
        ComIPduSignalRef = C_VehicleRwuSlipeRate
        ComIPduSignalRef = C_VehicleCurrentSlope
        ComIPduSignalRef = C_VehicleCurrentSlopeVD
      8 x ComSignal, all with ComTimeout=1.0, ComSignalEndianness=BIG_ENDIAN, ComUpdateBitPosition=-1, ComTransferProperty=TRIGGERED:
        C_LDCU_VehicleCurrentState: ComSignalInitValue=0, ComSignalType=UINT8, ComBitSize=2, ComBitPosition=14, ComSystemTemplateSystemSignalRef=C_LDCU_VehicleCurrentState
        C_VehicleCurrentSpeed: ComSignalInitValue=0, ComSignalType=UINT16, ComBitSize=15, ComBitPosition=12, ComSystemTemplateSystemSignalRef=C_VehicleCurrentSpeed
        C_VehicleCurrentSpeedVD: ComSignalInitValue=0, ComSignalType=BOOLEAN, ComBitSize=1, ComBitPosition=29, ComSystemTemplateSystemSignalRef=C_VehicleCurrentSpeedVD
        C_VehicleRwuVD: ComSignalInitValue=0, ComSignalType=BOOLEAN, ComBitSize=1, ComBitPosition=28, ComSystemTemplateSystemSignalRef=C_VehicleRwuVD
        C_VehicleRwuSpeed: ComSignalInitValue=0, ComSignalType=UINT16, ComBitSize=15, ComBitPosition=27, ComSystemTemplateSystemSignalRef=C_VehicleRwuSpeed
        C_VehicleRwuSlipeRate: ComSignalInitValue=0, ComSignalType=UINT16, ComBitSize=12, ComBitPosition=44, ComSystemTemplateSystemSignalRef=C_VehicleRwuSlipeRate
        C_VehicleCurrentSlope: ComSignalInitValue=40, ComSignalType=UINT8, ComBitSize=8, ComBitPosition=48, ComSystemTemplateSystemSignalRef=C_VehicleCurrentSlope
        C_VehicleCurrentSlopeVD: ComSignalInitValue=0, ComSignalType=BOOLEAN, ComBitSize=1, ComBitPosition=56, ComSystemTemplateSystemSignalRef=C_VehicleCurrentSlopeVD
      C_XPU_IPB_ADASToqCtrl_Can_Network_CANNODE_0 (ComIPdu):
        ComIPduSignalProcessing = IMMEDIATE
        ComIPduType = NORMAL
        ComIPduDirection = RECEIVE
        ComIPduGroupRef = ComIPduGroup_Rx
        ComPduIdRef = PduCollection/C_XPU_IPB_ADASToqCtrl_Can_Network_CANNODE_0_PduR2Com
        ComIPduSignalGroupRef = ISigGrp_C_XPU_IPB_ADASToqCtrl
      ISigGrp_C_XPU_IPB_ADASToqCtrl (ComSignalGroup):
        ComTimeout = 0.1
        ComTransferProperty = TRIGGERED
        ComNotification = Rte_COMCbk_ISigGrp_C_XPU_IPB_ADASToqCtrl
        ComTimeoutNotification = Rte_COMCbkTOut_ISigGrp_C_XPU_IPB_ADASToqCtrl
        ComSystemTemplateSignalGroupRef = ISignalToIPduMapping_ISigGrp_C_XPU_IPB_ADASToqCtrl
        8 x ComGroupSignal, all with ComTransferProperty=TRIGGERED_ON_CHANGE, ComSignalEndianness=BIG_ENDIAN, ComBitSize=8, ComSignalType=UINT8:
          C_XPU_IPB_ADASToqCtrl_Byte0: ComBitPosition=7, ComSignalInitValue=0, ComSystemTemplateSystemSignalRef=C_XPU_IPB_ADASToqCtrl_Byte0
          C_XPU_IPB_ADASToqCtrl_Byte1: ComBitPosition=15, ComSignalInitValue=4, ComSystemTemplateSystemSignalRef=C_XPU_IPB_ADASToqCtrl_Byte1
          C_XPU_IPB_ADASToqCtrl_Byte2: ComBitPosition=23, ComSignalInitValue=0, ComSystemTemplateSystemSignalRef=C_XPU_IPB_ADASToqCtrl_Byte2
          C_XPU_IPB_ADASToqCtrl_Byte3: ComBitPosition=31, ComSignalInitValue=0, ComSystemTemplateSystemSignalRef=C_XPU_IPB_ADASToqCtrl_Byte3
          C_XPU_IPB_ADASToqCtrl_Byte4: ComBitPosition=39, ComSignalInitValue=0, ComSystemTemplateSystemSignalRef=C_XPU_IPB_ADASToqCtrl_Byte4
          C_XPU_IPB_ADASToqCtrl_Byte5: ComBitPosition=47, ComSignalInitValue=0, ComSystemTemplateSystemSignalRef=C_XPU_IPB_ADASToqCtrl_Byte5
          C_XPU_IPB_ADASToqCtrl_Byte6: ComBitPosition=55, ComSignalInitValue=0, ComSystemTemplateSystemSignalRef=C_XPU_IPB_ADASToqCtrl_Byte6
          C_XPU_IPB_ADASToqCtrl_Byte7: ComBitPosition=63, ComSignalInitValue=0, ComSystemTemplateSystemSignalRef=C_XPU_IPB_ADASToqCtrl_Byte7
      C_IPB_SpdInfoF_Can_Network_CANNODE_0 (ComIPdu):
        ComIPduSignalProcessing = IMMEDIATE
        ComIPduType = NORMAL
        ComIPduDirection = RECEIVE
        ComIPduGroupRef = ComIPduGroup_Rx
        ComPduIdRef = PduCollection/C_IPB_SpdInfoF_Can_Network_CANNODE_0_PduR2Com
        ComIPduSignalRef = C_IPB_FLWheelSpd
        ComIPduSignalRef = C_IPB_FLWheelSpdVD
        ComIPduSignalRef = C_IPB_FRWheelSpd
        ComIPduSignalRef = C_IPB_FRWheelSpdVD
        ComIPduSignalRef = C_IPB_VehSpd
        ComIPduSignalRef = C_IPB_VehSpdVD
        ComIPduSignalRef = C_IPB_SpdInfo1MsgCounter
        ComIPduSignalRef = C_IPB_SpdInfo1CRC8Checksum
      8 x ComSignal, all with ComSignalInitValue=0, ComTimeout=0.05, ComSignalEndianness=BIG_ENDIAN, ComUpdateBitPosition=-1, ComTransferProperty=TRIGGERED:
        C_IPB_FLWheelSpd: ComSignalType=UINT16, ComBitSize=15, ComBitPosition=7, ComSystemTemplateSystemSignalRef=C_IPB_FLWheelSpd
        C_IPB_FLWheelSpdVD: ComSignalType=BOOLEAN, ComBitSize=1, ComBitPosition=8, ComSystemTemplateSystemSignalRef=C_IPB_FLWheelSpdVD
        C_IPB_FRWheelSpd: ComSignalType=UINT16, ComBitSize=15, ComBitPosition=23, ComSystemTemplateSystemSignalRef=C_IPB_FRWheelSpd
        C_IPB_FRWheelSpdVD: ComSignalType=BOOLEAN, ComBitSize=1, ComBitPosition=24, ComSystemTemplateSystemSignalRef=C_IPB_FRWheelSpdVD
        C_IPB_VehSpd: ComSignalType=UINT16, ComBitSize=15, ComBitPosition=39, ComSystemTemplateSystemSignalRef=C_IPB_VehSpd
        C_IPB_VehSpdVD: ComSignalType=UINT8, ComBitSize=2, ComBitPosition=53, ComSystemTemplateSystemSignalRef=C_IPB_VehSpdVD
        C_IPB_SpdInfo1MsgCounter: ComSignalType=UINT8, ComBitSize=4, ComBitPosition=51, ComSystemTemplateSystemSignalRef=C_IPB_SpdInfo1MsgCounter
        C_IPB_SpdInfo1CRC8Checksum: ComSignalType=UINT8, ComBitSize=8, ComBitPosition=63, ComSystemTemplateSystemSignalRef=C_IPB_SpdInfo1CRC8Checksum
      C_IPB_SpdInfo_E2E_Can_Network_CANNODE_0 (ComIPdu):
        ComIPduSignalProcessing = IMMEDIATE
        ComIPduType = NORMAL
        ComIPduDirection = RECEIVE
        ComIPduGroupRef = ComIPduGroup_Rx
        ComPduIdRef = PduCollection/C_IPB_SpdInfo_E2E_Can_Network_CANNODE_0_PduR2Com
        ComIPduSignalGroupRef = ISigGrp_C_IPB_SpdInfo_E2E
      ISigGrp_C_IPB_SpdInfo_E2E (ComSignalGroup):
        ComTimeout = 0.05
        ComTransferProperty = TRIGGERED
        ComNotification = Rte_COMCbk_ISigGrp_C_IPB_SpdInfo_E2E
        ComTimeoutNotification = Rte_COMCbkTOut_ISigGrp_C_IPB_SpdInfo_E2E
        ComSystemTemplateSignalGroupRef = ISignalToIPduMapping_ISigGrp_C_IPB_SpdInfo_E2E
        16 x ComGroupSignal, all with ComTransferProperty=TRIGGERED_ON_CHANGE, ComSignalEndianness=BIG_ENDIAN, ComSignalInitValue=0, ComBitSize=8, ComSignalType=UINT8:
          C_IPB_SpdInfo_E2E_Byte0: ComBitPosition=7, ComSystemTemplateSystemSignalRef=C_IPB_SpdInfo_E2E_Byte0
          C_IPB_SpdInfo_E2E_Byte1: ComBitPosition=15, ComSystemTemplateSystemSignalRef=C_IPB_SpdInfo_E2E_Byte1
          C_IPB_SpdInfo_E2E_Byte2: ComBitPosition=23, ComSystemTemplateSystemSignalRef=C_IPB_SpdInfo_E2E_Byte2
          C_IPB_SpdInfo_E2E_Byte3: ComBitPosition=31, ComSystemTemplateSystemSignalRef=C_IPB_SpdInfo_E2E_Byte3
          C_IPB_SpdInfo_E2E_Byte4: ComBitPosition=39, ComSystemTemplateSystemSignalRef=C_IPB_SpdInfo_E2E_Byte4
          C_IPB_SpdInfo_E2E_Byte5: ComBitPosition=47, ComSystemTemplateSystemSignalRef=C_IPB_SpdInfo_E2E_Byte5
          C_IPB_SpdInfo_E2E_Byte6: ComBitPosition=55, ComSystemTemplateSystemSignalRef=C_IPB_SpdInfo_E2E_Byte6
          C_IPB_SpdInfo_E2E_Byte7: ComBitPosition=63, ComSystemTemplateSystemSignalRef=C_IPB_SpdInfo_E2E_Byte7
          C_IPB_SpdInfo_E2E_Byte8: ComBitPosition=71, ComSystemTemplateSystemSignalRef=C_IPB_SpdInfo_E2E_Byte8
          C_IPB_SpdInfo_E2E_Byte9: ComBitPosition=79, ComSystemTemplateSystemSignalRef=C_IPB_SpdInfo_E2E_Byte9
          C_IPB_SpdInfo_E2E_Byte10: ComBitPosition=87, ComSystemTemplateSystemSignalRef=C_IPB_SpdInfo_E2E_Byte10
          C_IPB_SpdInfo_E2E_Byte11: ComBitPosition=95, ComSystemTemplateSystemSignalRef=C_IPB_SpdInfo_E2E_Byte11
          C_IPB_SpdInfo_E2E_Byte12: ComBitPosition=103, ComSystemTemplateSystemSignalRef=C_IPB_SpdInfo_E2E_Byte12
          C_IPB_SpdInfo_E2E_Byte13: ComBitPosition=111, ComSystemTemplateSystemSignalRef=C_IPB_SpdInfo_E2E_Byte13
          C_IPB_SpdInfo_E2E_Byte14: ComBitPosition=119, ComSystemTemplateSystemSignalRef=C_IPB_SpdInfo_E2E_Byte14
          C_IPB_SpdInfo_E2E_Byte15: ComBitPosition=127, ComSystemTemplateSystemSignalRef=C_IPB_SpdInfo_E2E_Byte15
      C_AS_SysSt1_Can_Network_CANNODE_0 (ComIPdu):
        ComIPduSignalProcessing = IMMEDIATE
        ComIPduType = NORMAL
        ComIPduDirection = RECEIVE
        ComIPduGroupRef = ComIPduGroup_Rx
        ComPduIdRef = PduCollection/C_AS_SysSt1_Can_Network_CANNODE_0_PduR2Com
        ComIPduSignalRef = C_AS_WelcomeSt
        ComIPduSignalRef = C_AS_EasyloadingSt
        ComIPduSignalRef = C_AS_MaintainMode
        ComIPduSignalRef = C_AS_HoistMode
      4 x ComSignal, all with ComTimeout=0.2, ComSignalEndianness=BIG_ENDIAN, ComUpdateBitPosition=-1, ComTransferProperty=TRIGGERED:
        C_AS_WelcomeSt: ComSignalInitValue=0, ComSignalType=UINT8, ComBitSize=2, ComBitPosition=18, ComSystemTemplateSystemSignalRef=C_AS_WelcomeSt
        C_AS_EasyloadingSt: ComSignalInitValue=0, ComSignalType=UINT8, ComBitSize=2, ComBitPosition=16, ComSystemTemplateSystemSignalRef=C_AS_EasyloadingSt
        C_AS_MaintainMode: ComSignalInitValue=4, ComSignalType=UINT8, ComBitSize=3, ComBitPosition=36, ComSystemTemplateSystemSignalRef=C_AS_MaintainMode
        C_AS_HoistMode: ComSignalInitValue=0, ComSignalType=BOOLEAN, ComBitSize=1, ComBitPosition=33, ComSystemTemplateSystemSignalRef=C_AS_HoistMode
      C_LDCU_BodySysSt1_Can_Network_CANNODE_0 (ComIPdu):
        ComIPduSignalProcessing = IMMEDIATE
        ComIPduType = NORMAL
        ComIPduDirection = RECEIVE
        ComIPduGroupRef = ComIPduGroup_Rx
        ComPduIdRef = PduCollection/C_LDCU_BodySysSt1_Can_Network_CANNODE_0_PduR2Com
        ComIPduSignalRef = C_LDCU_PowerMode
        ComIPduSignalRef = C_LDCU_DriverDoorLockSt
        ComIPduSignalRef = C_LDCU_DriverDoorAjarSt
        ComIPduSignalRef = C_LDCU_RLDoorAjarSt
        ComIPduSignalRef = C_LDCU_DrvSeatOccupancySt
        ComIPduSignalRef = C_LDCU_RLSeatOccupancySt
        ComIPduSignalRef = C_LDCU_HazardLampReq
        ComIPduSignalRef = C_LDCU_HazardLampSwSt
        ComIPduSignalRef = C_LDCU_AlarmSt
        ComIPduSignalRef = C_LDCU_DoorLockCtrlSt
        ComIPduSignalRef = C_LDCU_DoorLockSource
        ComIPduSignalRef = C_LDCU_DoorUnlockSource
        ComIPduSignalRef = C_LDCU_DoorLockEvent
        ComIPduSignalRef = C_LDCU_ChargeGunCmd
        ComIPduSignalRef = C_LDCU_TrunkReleaseSW
        ComIPduSignalRef = C_LDCU_LockLogicSt
      16 x ComSignal, all with ComSignalInitValue=0, ComTimeout=0.4, ComSignalEndianness=BIG_ENDIAN, ComUpdateBitPosition=-1, ComTransferProperty=TRIGGERED:
        C_LDCU_PowerMode: ComSignalType=UINT8, ComBitSize=2, ComBitPosition=1, ComSystemTemplateSystemSignalRef=C_LDCU_PowerMode
        C_LDCU_DriverDoorLockSt: ComSignalType=BOOLEAN, ComBitSize=1, ComBitPosition=35, ComSystemTemplateSystemSignalRef=C_LDCU_DriverDoorLockSt
        C_LDCU_DriverDoorAjarSt: ComSignalType=BOOLEAN, ComBitSize=1, ComBitPosition=2, ComSystemTemplateSystemSignalRef=C_LDCU_DriverDoorAjarSt
        C_LDCU_RLDoorAjarSt: ComSignalType=BOOLEAN, ComBitSize=1, ComBitPosition=3, ComSystemTemplateSystemSignalRef=C_LDCU_RLDoorAjarSt
        C_LDCU_DrvSeatOccupancySt: ComSignalType=BOOLEAN, ComBitSize=1, ComBitPosition=4, ComSystemTemplateSystemSignalRef=C_LDCU_DrvSeatOccupancySt
        C_LDCU_RLSeatOccupancySt: ComSignalType=BOOLEAN, ComBitSize=1, ComBitPosition=24, ComSystemTemplateSystemSignalRef=C_LDCU_RLSeatOccupancySt
        C_LDCU_HazardLampReq: ComSignalType=UINT8, ComBitSize=3, ComBitPosition=14, ComSystemTemplateSystemSignalRef=C_LDCU_HazardLampReq
        C_LDCU_HazardLampSwSt: ComSignalType=BOOLEAN, ComBitSize=1, ComBitPosition=15, ComSystemTemplateSystemSignalRef=C_LDCU_HazardLampSwSt
        C_LDCU_AlarmSt: ComSignalType=UINT8, ComBitSize=2, ComBitPosition=23, ComSystemTemplateSystemSignalRef=C_LDCU_AlarmSt
        C_LDCU_DoorLockCtrlSt: ComSignalType=UINT8, ComBitSize=3, ComBitPosition=21, ComSystemTemplateSystemSignalRef=C_LDCU_DoorLockCtrlSt
        C_LDCU_DoorLockSource: ComSignalType=UINT8, ComBitSize=5, ComBitPosition=18, ComSystemTemplateSystemSignalRef=C_LDCU_DoorLockSource
        C_LDCU_DoorUnlockSource: ComSignalType=UINT8, ComBitSize=5, ComBitPosition=29, ComSystemTemplateSystemSignalRef=C_LDCU_DoorUnlockSource
        C_LDCU_DoorLockEvent: ComSignalType=UINT8, ComBitSize=2, ComBitPosition=33, ComSystemTemplateSystemSignalRef=C_LDCU_DoorLockEvent
        C_LDCU_ChargeGunCmd: ComSignalType=UINT8, ComBitSize=2, ComBitPosition=55, ComSystemTemplateSystemSignalRef=C_LDCU_ChargeGunCmd
        C_LDCU_TrunkReleaseSW: ComSignalType=BOOLEAN, ComBitSize=1, ComBitPosition=41, ComSystemTemplateSystemSignalRef=C_LDCU_TrunkReleaseSW
        C_LDCU_LockLogicSt: ComSignalType=BOOLEAN, ComBitSize=1, ComBitPosition=40, ComSystemTemplateSystemSignalRef=C_LDCU_LockLogicSt
      C_CDCU_ChassisCtrl_Can_Network_CANNODE_0 (ComIPdu):
        ComIPduSignalProcessing = IMMEDIATE
        ComIPduType = NORMAL
        ComIPduDirection = RECEIVE
        ComIPduGroupRef = ComIPduGroup_Rx
        ComPduIdRef = PduCollection/C_CDCU_ChassisCtrl_Can_Network_CANNODE_0_PduR2Com
        ComIPduSignalRef = C_CDCU_ESP_EPBReq
        ComIPduSignalRef = C_CDCU_ESP_EPBReqVD
        ComIPduSignalRef = C_CDCU_EPB_Tra_modeReq
        ComIPduSignalRef = C_CDCU_EPB_Tra_modeReqVD
      4 x ComSignal, all with ComTimeout=1.0, ComSignalEndianness=BIG_ENDIAN, ComUpdateBitPosition=-1, ComTransferProperty=TRIGGERED:
        C_CDCU_ESP_EPBReq: ComSignalInitValue=0, ComSignalType=UINT8, ComBitSize=2, ComBitPosition=18, ComSystemTemplateSystemSignalRef=C_CDCU_ESP_EPBReq
        C_CDCU_ESP_EPBReqVD: ComSignalInitValue=1, ComSignalType=BOOLEAN, ComBitSize=1, ComBitPosition=16, ComSystemTemplateSystemSignalRef=C_CDCU_ESP_EPBReqVD
        C_CDCU_EPB_Tra_modeReq: ComSignalInitValue=0, ComSignalType=UINT8, ComBitSize=2, ComBitPosition=44, ComSystemTemplateSystemSignalRef=C_CDCU_EPB_Tra_modeReq
        C_CDCU_EPB_Tra_modeReqVD: ComSignalInitValue=0, ComSignalType=BOOLEAN, ComBitSize=1, ComBitPosition=42, ComSystemTemplateSystemSignalRef=C_CDCU_EPB_Tra_modeReqVD
      C_IPB_CylinderPressure2_Can_Network_CANNODE_0 (ComIPdu):
        ComIPduSignalProcessing = IMMEDIATE
        ComIPduType = NORMAL
        ComIPduDirection = RECEIVE
        ComIPduGroupRef = ComIPduGroup_Rx
        ComPduIdRef = PduCollection/C_IPB_CylinderPressure2_Can_Network_CANNODE_0_PduR2Com
        ComIPduSignalRef = C_IPB_WheelPressureFrontRightVD
        ComIPduSignalRef = C_IPB_WheelPressureRearLeftVD
        ComIPduSignalRef = C_IPB_WheelPressureRearRightVD
        ComIPduSignalRef = C_IPB_WheelPressureFrontRight
        ComIPduSignalRef = C_IPB_WheelPressureRearLeft
        ComIPduSignalRef = C_IPB_WheelPressureRearRight
        ComIPduSignalRef = C_IPB_CyPressure2MsgCounter
        ComIPduSignalRef = C_IPB_CyPressure2CRC8Checksum
      8 x ComSignal, all with ComTimeout=0.1, ComSignalEndianness=BIG_ENDIAN, ComUpdateBitPosition=-1, ComTransferProperty=TRIGGERED:
        C_IPB_WheelPressureFrontRightVD: ComSignalInitValue=0, ComSignalType=BOOLEAN, ComBitSize=1, ComBitPosition=0, ComSystemTemplateSystemSignalRef=C_IPB_WheelPressureFrontRightVD
        C_IPB_WheelPressureRearLeftVD: ComSignalInitValue=0, ComSignalType=BOOLEAN, ComBitSize=1, ComBitPosition=15, ComSystemTemplateSystemSignalRef=C_IPB_WheelPressureRearLeftVD
        C_IPB_WheelPressureRearRightVD: ComSignalInitValue=0, ComSignalType=BOOLEAN, ComBitSize=1, ComBitPosition=14, ComSystemTemplateSystemSignalRef=C_IPB_WheelPressureRearRightVD
        C_IPB_WheelPressureFrontRight: ComSignalInitValue=640, ComSignalType=UINT16, ComBitSize=14, ComBitPosition=13, ComSystemTemplateSystemSignalRef=C_IPB_WheelPressureFrontRight
        C_IPB_WheelPressureRearLeft: ComSignalInitValue=640, ComSignalType=UINT16, ComBitSize=14, ComBitPosition=31, ComSystemTemplateSystemSignalRef=C_IPB_WheelPressureRearLeft
        C_IPB_WheelPressureRearRight: ComSignalInitValue=640, ComSignalType=UINT16, ComBitSize=14, ComBitPosition=33, ComSystemTemplateSystemSignalRef=C_IPB_WheelPressureRearRight
        C_IPB_CyPressure2MsgCounter: ComSignalInitValue=0, ComSignalType=UINT8, ComBitSize=4, ComBitPosition=51, ComSystemTemplateSystemSignalRef=C_IPB_CyPressure2MsgCounter
        C_IPB_CyPressure2CRC8Checksum: ComSignalInitValue=0, ComSignalType=UINT8, ComBitSize=8, ComBitPosition=63, ComSystemTemplateSystemSignalRef=C_IPB_CyPressure2CRC8Checksum
      C_IPB_SysSt_Can_Network_CANNODE_0 (ComIPdu):
        ComIPduSignalProcessing = IMMEDIATE
        ComIPduType = NORMAL
        ComIPduDirection = RECEIVE
        ComIPduGroupRef = ComIPduGroup_Rx
        ComPduIdRef = PduCollection/C_IPB_SysSt_Can_Network_CANNODE_0_PduR2Com
        ComIPduSignalRef = C_IPB_ABSFault
        ComIPduSignalRef = C_IPB_ABSActSt
        ComIPduSignalRef = C_IPB_EBDFault
        ComIPduSignalRef = C_IPB_EBDActSt
        ComIPduSignalRef = C_IPB_VDCActSt
        ComIPduSignalRef = C_IPB_XPedalAVHActSt
        ComIPduSignalRef = C_IPB_BrkLightOnReq
        ComIPduSignalRef = C_IPB_TCSActSt
        ComIPduSignalRef = C_IPB_HHCFault
        ComIPduSignalRef = C_IPB_HHCActSt
        ComIPduSignalRef = C_IPB_AVHFault
        ComIPduSignalRef = C_IPB_EBAAct
        ComIPduSignalRef = C_IPB_AVHActSt
        ComIPduSignalRef = C_IPB_HpsAcknowledge
        ComIPduSignalRef = C_IPB_HpsAvailability
        ComIPduSignalRef = C_IPB_ESPPATA
        ComIPduSignalRef = C_IPB_ESPFault
        ComIPduSignalRef = C_IPB_CDPAvl
        ComIPduSignalRef = C_IPB_CDPIntervention
        ComIPduSignalRef = C_IPB_AEBAvl
        ComIPduSignalRef = C_IPB_AEBAct
        ComIPduSignalRef = C_IPB_CddSt
        ComIPduSignalRef = C_IPB_CddAvl
        ComIPduSignalRef = C_IPB_StandStillSt
        ComIPduSignalRef = C_IPB_ABAAvl
        ComIPduSignalRef = C_IPB_ABAAct
        ComIPduSignalRef = C_IPB_ABPAvl
        ComIPduSignalRef = C_IPB_ABPAct
        ComIPduSignalRef = C_IPB_AWBAvl
        ComIPduSignalRef = C_IPB_AWBAct
        ComIPduSignalRef = C_IPB_CDDBrkTempOff
        ComIPduSignalRef = C_IPB_CDDFaultSt
        ComIPduSignalRef = C_IPB_BrkPedalSt
        ComIPduSignalRef = C_IPB_BrkPedalStVD
        ComIPduSignalRef = C_IPB_EmerLightReq
        ComIPduSignalRef = C_IPB_DTCActSt
        ComIPduSignalRef = C_IPB_DTCFault
        ComIPduSignalRef = C_IPB_SCMSt
        ComIPduSignalRef = C_IPB_SCMFault
        ComIPduSignalRef = C_IPB_EBAAvl
        ComIPduSignalRef = C_IPB_SysStMsgCounter
        ComIPduSignalRef = C_IPB_SysStCRC8Checksum
      42 x ComSignal, all with ComTimeout=0.2, ComSignalEndianness=BIG_ENDIAN, ComUpdateBitPosition=-1, ComTransferProperty=TRIGGERED:
        C_IPB_ABSFault: ComSignalInitValue=1, ComSignalType=BOOLEAN, ComBitSize=1, ComBitPosition=7, ComSystemTemplateSystemSignalRef=C_IPB_ABSFault
        C_IPB_ABSActSt: ComSignalInitValue=0, ComSignalType=BOOLEAN, ComBitSize=1, ComBitPosition=6, ComSystemTemplateSystemSignalRef=C_IPB_ABSActSt
        C_IPB_EBDFault: ComSignalInitValue=1, ComSignalType=BOOLEAN, ComBitSize=1, ComBitPosition=5, ComSystemTemplateSystemSignalRef=C_IPB_EBDFault
        C_IPB_EBDActSt: ComSignalInitValue=1, ComSignalType=BOOLEAN, ComBitSize=1, ComBitPosition=4, ComSystemTemplateSystemSignalRef=C_IPB_EBDActSt
        C_IPB_VDCActSt: ComSignalInitValue=0, ComSignalType=BOOLEAN, ComBitSize=1, ComBitPosition=3, ComSystemTemplateSystemSignalRef=C_IPB_VDCActSt
        C_IPB_XPedalAVHActSt: ComSignalInitValue=0, ComSignalType=UINT8, ComBitSize=2, ComBitPosition=2, ComSystemTemplateSystemSignalRef=C_IPB_XPedalAVHActSt
        C_IPB_BrkLightOnReq: ComSignalInitValue=0, ComSignalType=BOOLEAN, ComBitSize=1, ComBitPosition=0, ComSystemTemplateSystemSignalRef=C_IPB_BrkLightOnReq
        C_IPB_TCSActSt: ComSignalInitValue=0, ComSignalType=BOOLEAN, ComBitSize=1, ComBitPosition=15, ComSystemTemplateSystemSignalRef=C_IPB_TCSActSt
        C_IPB_HHCFault: ComSignalInitValue=1, ComSignalType=BOOLEAN, ComBitSize=1, ComBitPosition=13, ComSystemTemplateSystemSignalRef=C_IPB_HHCFault
        C_IPB_HHCActSt: ComSignalInitValue=0, ComSignalType=BOOLEAN, ComBitSize=1, ComBitPosition=12, ComSystemTemplateSystemSignalRef=C_IPB_HHCActSt
        C_IPB_AVHFault: ComSignalInitValue=1, ComSignalType=BOOLEAN, ComBitSize=1, ComBitPosition=23, ComSystemTemplateSystemSignalRef=C_IPB_AVHFault
        C_IPB_EBAAct: ComSignalInitValue=0, ComSignalType=BOOLEAN, ComBitSize=1, ComBitPosition=20, ComSystemTemplateSystemSignalRef=C_IPB_EBAAct
        C_IPB_AVHActSt: ComSignalInitValue=0, ComSignalType=UINT8, ComBitSize=2, ComBitPosition=22, ComSystemTemplateSystemSignalRef=C_IPB_AVHActSt
        C_IPB_HpsAcknowledge: ComSignalInitValue=0, ComSignalType=BOOLEAN, ComBitSize=1, ComBitPosition=10, ComSystemTemplateSystemSignalRef=C_IPB_HpsAcknowledge
        C_IPB_HpsAvailability: ComSignalInitValue=0, ComSignalType=BOOLEAN, ComBitSize=1, ComBitPosition=11, ComSystemTemplateSystemSignalRef=C_IPB_HpsAvailability
        C_IPB_ESPPATA: ComSignalInitValue=2, ComSignalType=UINT8, ComBitSize=2, ComBitPosition=19, ComSystemTemplateSystemSignalRef=C_IPB_ESPPATA
        C_IPB_ESPFault: ComSignalInitValue=1, ComSignalType=BOOLEAN, ComBitSize=1, ComBitPosition=17, ComSystemTemplateSystemSignalRef=C_IPB_ESPFault
        C_IPB_CDPAvl: ComSignalInitValue=0, ComSignalType=BOOLEAN, ComBitSize=1, ComBitPosition=16, ComSystemTemplateSystemSignalRef=C_IPB_CDPAvl
        C_IPB_CDPIntervention: ComSignalInitValue=0, ComSignalType=BOOLEAN, ComBitSize=1, ComBitPosition=31, ComSystemTemplateSystemSignalRef=C_IPB_CDPIntervention
        C_IPB_AEBAvl: ComSignalInitValue=0, ComSignalType=BOOLEAN, ComBitSize=1, ComBitPosition=29, ComSystemTemplateSystemSignalRef=C_IPB_AEBAvl
        C_IPB_AEBAct: ComSignalInitValue=0, ComSignalType=BOOLEAN, ComBitSize=1, ComBitPosition=28, ComSystemTemplateSystemSignalRef=C_IPB_AEBAct
        C_IPB_CddSt: ComSignalInitValue=0, ComSignalType=BOOLEAN, ComBitSize=1, ComBitPosition=27, ComSystemTemplateSystemSignalRef=C_IPB_CddSt
        C_IPB_CddAvl: ComSignalInitValue=0, ComSignalType=BOOLEAN, ComBitSize=1, ComBitPosition=26, ComSystemTemplateSystemSignalRef=C_IPB_CddAvl
        C_IPB_StandStillSt: ComSignalInitValue=0, ComSignalType=UINT8, ComBitSize=2, ComBitPosition=25, ComSystemTemplateSystemSignalRef=C_IPB_StandStillSt
        C_IPB_ABAAvl: ComSignalInitValue=0, ComSignalType=BOOLEAN, ComBitSize=1, ComBitPosition=39, ComSystemTemplateSystemSignalRef=C_IPB_ABAAvl
        C_IPB_ABAAct: ComSignalInitValue=0, ComSignalType=BOOLEAN, ComBitSize=1, ComBitPosition=38, ComSystemTemplateSystemSignalRef=C_IPB_ABAAct
        C_IPB_ABPAvl: ComSignalInitValue=0, ComSignalType=BOOLEAN, ComBitSize=1, ComBitPosition=37, ComSystemTemplateSystemSignalRef=C_IPB_ABPAvl
        C_IPB_ABPAct: ComSignalInitValue=0, ComSignalType=BOOLEAN, ComBitSize=1, ComBitPosition=36, ComSystemTemplateSystemSignalRef=C_IPB_ABPAct
        C_IPB_AWBAvl: ComSignalInitValue=0, ComSignalType=BOOLEAN, ComBitSize=1, ComBitPosition=35, ComSystemTemplateSystemSignalRef=C_IPB_AWBAvl
        C_IPB_AWBAct: ComSignalInitValue=0, ComSignalType=BOOLEAN, ComBitSize=1, ComBitPosition=34, ComSystemTemplateSystemSignalRef=C_IPB_AWBAct
        C_IPB_CDDBrkTempOff: ComSignalInitValue=0, ComSignalType=BOOLEAN, ComBitSize=1, ComBitPosition=33, ComSystemTemplateSystemSignalRef=C_IPB_CDDBrkTempOff
        C_IPB_CDDFaultSt: ComSignalInitValue=1, ComSignalType=BOOLEAN, ComBitSize=1, ComBitPosition=32, ComSystemTemplateSystemSignalRef=C_IPB_CDDFaultSt
        C_IPB_BrkPedalSt: ComSignalInitValue=0, ComSignalType=BOOLEAN, ComBitSize=1, ComBitPosition=54, ComSystemTemplateSystemSignalRef=C_IPB_BrkPedalSt
        C_IPB_BrkPedalStVD: ComSignalInitValue=0, ComSignalType=BOOLEAN, ComBitSize=1, ComBitPosition=53, ComSystemTemplateSystemSignalRef=C_IPB_BrkPedalStVD
        C_IPB_EmerLightReq: ComSignalInitValue=0, ComSignalType=BOOLEAN, ComBitSize=1, ComBitPosition=52, ComSystemTemplateSystemSignalRef=C_IPB_EmerLightReq
        C_IPB_DTCActSt: ComSignalInitValue=0, ComSignalType=BOOLEAN, ComBitSize=1, ComBitPosition=47, ComSystemTemplateSystemSignalRef=C_IPB_DTCActSt
        C_IPB_DTCFault: ComSignalInitValue=1, ComSignalType=BOOLEAN, ComBitSize=1, ComBitPosition=46, ComSystemTemplateSystemSignalRef=C_IPB_DTCFault
        C_IPB_SCMSt: ComSignalInitValue=0, ComSignalType=BOOLEAN, ComBitSize=1, ComBitPosition=45, ComSystemTemplateSystemSignalRef=C_IPB_SCMSt
        C_IPB_SCMFault: ComSignalInitValue=0, ComSignalType=BOOLEAN, ComBitSize=1, ComBitPosition=44, ComSystemTemplateSystemSignalRef=C_IPB_SCMFault
        C_IPB_EBAAvl: ComSignalInitValue=0, ComSignalType=BOOLEAN, ComBitSize=1, ComBitPosition=43, ComSystemTemplateSystemSignalRef=C_IPB_EBAAvl
        C_IPB_SysStMsgCounter: ComSignalInitValue=0, ComSignalType=UINT8, ComBitSize=4, ComBitPosition=51, ComSystemTemplateSystemSignalRef=C_IPB_SysStMsgCounter
        C_IPB_SysStCRC8Checksum: ComSignalInitValue=0, ComSignalType=UINT8, ComBitSize=8, ComBitPosition=63, ComSystemTemplateSystemSignalRef=C_IPB_SysStCRC8Checksum
      C_LDCU_RTorqInfo_Can_Network_CANNODE_0 (ComIPdu):
        ComIPduSignalProcessing = IMMEDIATE
        ComIPduType = NORMAL
        ComIPduDirection = RECEIVE
        ComIPduGroupRef = ComIPduGroup_Rx
        ComPduIdRef = PduCollection/C_LDCU_RTorqInfo_Can_Network_CANNODE_0_PduR2Com
        ComIPduSignalRef = C_LDCU_RWheelPeakTorqMax
        ComIPduSignalRef = C_LDCU_RWheelPeakTorqMin
        ComIPduSignalRef = C_LDCU_RWheelCurTorq
        ComIPduSignalRef = C_LDCU_RWheelDriverTorqReq
        ComIPduSignalRef = C_LDCU_BrakePrRampReq
        ComIPduSignalRef = C_LDCU_RTorqInfoMsgCounter
        ComIPduSignalRef = C_LDCU_RTorqInfoCRC8Checksum
      7 x ComSignal, all with ComTimeout=0.1, ComSignalEndianness=BIG_ENDIAN, ComUpdateBitPosition=-1, ComTransferProperty=TRIGGERED:
        C_LDCU_RWheelPeakTorqMax: ComSignalInitValue=0, ComSignalType=UINT16, ComBitSize=10, ComBitPosition=7, ComSystemTemplateSystemSignalRef=C_LDCU_RWheelPeakTorqMax
        C_LDCU_RWheelPeakTorqMin: ComSignalInitValue=875, ComSignalType=UINT16, ComBitSize=10, ComBitPosition=13, ComSystemTemplateSystemSignalRef=C_LDCU_RWheelPeakTorqMin
        C_LDCU_RWheelCurTorq: ComSignalInitValue=1500, ComSignalType=UINT16, ComBitSize=12, ComBitPosition=19, ComSystemTemplateSystemSignalRef=C_LDCU_RWheelCurTorq
        C_LDCU_RWheelDriverTorqReq: ComSignalInitValue=1500, ComSignalType=UINT16, ComBitSize=12, ComBitPosition=39, ComSystemTemplateSystemSignalRef=C_LDCU_RWheelDriverTorqReq
        C_LDCU_BrakePrRampReq: ComSignalInitValue=0, ComSignalType=UINT8, ComBitSize=8, ComBitPosition=43, ComSystemTemplateSystemSignalRef=C_LDCU_BrakePrRampReq
        C_LDCU_RTorqInfoMsgCounter: ComSignalInitValue=0, ComSignalType=UINT8, ComBitSize=4, ComBitPosition=51, ComSystemTemplateSystemSignalRef=C_LDCU_RTorqInfoMsgCounter
        C_LDCU_RTorqInfoCRC8Checksum: ComSignalInitValue=0, ComSignalType=UINT8, ComBitSize=8, ComBitPosition=63, ComSystemTemplateSystemSignalRef=C_LDCU_RTorqInfoCRC8Checksum
      C_IPB_Accel_Can_Network_CANNODE_0 (ComIPdu):
        ComIPduSignalProcessing = IMMEDIATE
        ComIPduType = NORMAL
        ComIPduDirection = RECEIVE
        ComIPduGroupRef = ComIPduGroup_Rx
        ComPduIdRef = PduCollection/C_IPB_Accel_Can_Network_CANNODE_0_PduR2Com
        ComIPduSignalRef = C_IPB_VehLongAccel
        ComIPduSignalRef = C_IPB_VehLateralAccel
        ComIPduSignalRef = C_IPB_VehLongAccelVD
        ComIPduSignalRef = C_IPB_VehLateralAccelVD
        ComIPduSignalRef = C_IPB_YAWRate
        ComIPduSignalRef = C_IPB_YAWRateVD
      6 x ComSignal, all with ComTimeout=0.2, ComSignalEndianness=BIG_ENDIAN, ComUpdateBitPosition=-1, ComTransferProperty=TRIGGERED:
        C_IPB_VehLongAccel: ComSignalInitValue=625, ComSignalType=UINT16, ComBitSize=12, ComBitPosition=7, ComSystemTemplateSystemSignalRef=C_IPB_VehLongAccel
        C_IPB_VehLateralAccel: ComSignalInitValue=625, ComSignalType=UINT16, ComBitSize=12, ComBitPosition=11, ComSystemTemplateSystemSignalRef=C_IPB_VehLateralAccel
        C_IPB_VehLongAccelVD: ComSignalInitValue=0, ComSignalType=BOOLEAN, ComBitSize=1, ComBitPosition=31, ComSystemTemplateSystemSignalRef=C_IPB_VehLongAccelVD
        C_IPB_VehLateralAccelVD: ComSignalInitValue=0, ComSignalType=BOOLEAN, ComBitSize=1, ComBitPosition=30, ComSystemTemplateSystemSignalRef=C_IPB_VehLateralAccelVD
        C_IPB_YAWRate: ComSignalInitValue=1488, ComSignalType=UINT16, ComBitSize=12, ComBitPosition=29, ComSystemTemplateSystemSignalRef=C_IPB_YAWRate
        C_IPB_YAWRateVD: ComSignalInitValue=0, ComSignalType=BOOLEAN, ComBitSize=1, ComBitPosition=33, ComSystemTemplateSystemSignalRef=C_IPB_YAWRateVD
      C_LDCU_SysSt_Can_Network_CANNODE_0 (ComIPdu):
        ComIPduSignalProcessing = IMMEDIATE
        ComIPduType = NORMAL
        ComIPduDirection = RECEIVE
        ComIPduGroupRef = ComIPduGroup_Rx
        ComPduIdRef = PduCollection/C_LDCU_SysSt_Can_Network_CANNODE_0_PduR2Com
        ComIPduSignalRef = C_LDCU_EVSysReadySt
        ComIPduSignalRef = C_LDCU_GearLev
        ComIPduSignalRef = C_LDCU_CurrentGearLev
        ComIPduSignalRef = C_LDCU_ExterTemp
        ComIPduSignalRef = C_LDCU_ExterTempVD
        ComIPduSignalRef = C_LDCU_BrkPedalSt
        ComIPduSignalRef = C_LDCU_BrkPedalStVD
        ComIPduSignalRef = C_LDCU_AccPedalSigVD
        ComIPduSignalRef = C_LDCU_AccPedalSig
        ComIPduSignalRef = C_LDCU_ESP_EPBReq
        ComIPduSignalRef = C_LDCU_ESP_EPBReqVD
      11 x ComSignal, all with ComTimeout=0.1, ComSignalEndianness=BIG_ENDIAN, ComUpdateBitPosition=-1, ComTransferProperty=TRIGGERED:
        C_LDCU_EVSysReadySt: ComSignalInitValue=0, ComSignalType=UINT8, ComBitSize=2, ComBitPosition=7, ComSystemTemplateSystemSignalRef=C_LDCU_EVSysReadySt
        C_LDCU_GearLev: ComSignalInitValue=0, ComSignalType=UINT8, ComBitSize=3, ComBitPosition=5, ComSystemTemplateSystemSignalRef=C_LDCU_GearLev
        C_LDCU_CurrentGearLev: ComSignalInitValue=0, ComSignalType=UINT8, ComBitSize=3, ComBitPosition=2, ComSystemTemplateSystemSignalRef=C_LDCU_CurrentGearLev
        C_LDCU_ExterTemp: ComSignalInitValue=120, ComSignalType=UINT8, ComBitSize=8, ComBitPosition=15, ComSystemTemplateSystemSignalRef=C_LDCU_ExterTemp
        C_LDCU_ExterTempVD: ComSignalInitValue=0, ComSignalType=BOOLEAN, ComBitSize=1, ComBitPosition=23, ComSystemTemplateSystemSignalRef=C_LDCU_ExterTempVD
        C_LDCU_BrkPedalSt: ComSignalInitValue=0, ComSignalType=BOOLEAN, ComBitSize=1, ComBitPosition=28, ComSystemTemplateSystemSignalRef=C_LDCU_BrkPedalSt
        C_LDCU_BrkPedalStVD: ComSignalInitValue=0, ComSignalType=BOOLEAN, ComBitSize=1, ComBitPosition=27, ComSystemTemplateSystemSignalRef=C_LDCU_BrkPedalStVD
        C_LDCU_AccPedalSigVD: ComSignalInitValue=0, ComSignalType=BOOLEAN, ComBitSize=1, ComBitPosition=25, ComSystemTemplateSystemSignalRef=C_LDCU_AccPedalSigVD
        C_LDCU_AccPedalSig: ComSignalInitValue=0, ComSignalType=UINT8, ComBitSize=8, ComBitPosition=39, ComSystemTemplateSystemSignalRef=C_LDCU_AccPedalSig
        C_LDCU_ESP_EPBReq: ComSignalInitValue=0, ComSignalType=UINT8, ComBitSize=2, ComBitPosition=46, ComSystemTemplateSystemSignalRef=C_LDCU_ESP_EPBReq
        C_LDCU_ESP_EPBReqVD: ComSignalInitValue=0, ComSignalType=BOOLEAN, ComBitSize=1, ComBitPosition=47, ComSystemTemplateSystemSignalRef=C_LDCU_ESP_EPBReqVD
      C_LDCU_FTorqInfo_Can_Network_CANNODE_0 (ComIPdu):
        ComIPduSignalProcessing = IMMEDIATE
        ComIPduType = NORMAL
        ComIPduDirection = RECEIVE
        ComIPduGroupRef = ComIPduGroup_Rx
        ComPduIdRef = PduCollection/C_LDCU_FTorqInfo_Can_Network_CANNODE_0_PduR2Com
        ComIPduSignalGroupRef = ISigGrp_C_LDCU_FTorqInfo
      ISigGrp_C_LDCU_FTorqInfo (ComSignalGroup):
        ComTimeout = 0.1
        ComTransferProperty = TRIGGERED
        ComNotification = Rte_COMCbk_ISigGrp_C_LDCU_FTorqInfo
        ComTimeoutNotification = Rte_COMCbkTOut_ISigGrp_C_LDCU_FTorqInfo
        ComSystemTemplateSignalGroupRef = ISignalToIPduMapping_ISigGrp_C_LDCU_FTorqInfo
        8 x ComGroupSignal, all with ComTransferProperty=TRIGGERED_ON_CHANGE, ComSignalEndianness=BIG_ENDIAN, ComBitSize=8, ComSignalType=UINT8:
          C_LDCU_FTorqInfo_Byte0: ComBitPosition=7, ComSignalInitValue=0, ComSystemTemplateSystemSignalRef=C_LDCU_FTorqInfo_Byte0
          C_LDCU_FTorqInfo_Byte1: ComBitPosition=15, ComSignalInitValue=54, ComSystemTemplateSystemSignalRef=C_LDCU_FTorqInfo_Byte1
          C_LDCU_FTorqInfo_Byte2: ComBitPosition=23, ComSignalInitValue=181, ComSystemTemplateSystemSignalRef=C_LDCU_FTorqInfo_Byte2
          C_LDCU_FTorqInfo_Byte3: ComBitPosition=31, ComSignalInitValue=220, ComSystemTemplateSystemSignalRef=C_LDCU_FTorqInfo_Byte3
          C_LDCU_FTorqInfo_Byte4: ComBitPosition=39, ComSignalInitValue=93, ComSystemTemplateSystemSignalRef=C_LDCU_FTorqInfo_Byte4
          C_LDCU_FTorqInfo_Byte5: ComBitPosition=47, ComSignalInitValue=192, ComSystemTemplateSystemSignalRef=C_LDCU_FTorqInfo_Byte5
          C_LDCU_FTorqInfo_Byte6: ComBitPosition=55, ComSignalInitValue=0, ComSystemTemplateSystemSignalRef=C_LDCU_FTorqInfo_Byte6
          C_LDCU_FTorqInfo_Byte7: ComBitPosition=63, ComSignalInitValue=0, ComSystemTemplateSystemSignalRef=C_LDCU_FTorqInfo_Byte7
      C_LDCU_APBSysSt_Can_Network_CANNODE_0 (ComIPdu):
        ComIPduSignalProcessing = IMMEDIATE
        ComIPduType = NORMAL
        ComIPduDirection = RECEIVE
        ComIPduGroupRef = ComIPduGroup_Rx
        ComPduIdRef = PduCollection/C_LDCU_APBSysSt_Can_Network_CANNODE_0_PduR2Com
        ComIPduSignalGroupRef = ISigGrp_C_LDCU_APBSysSt
      ISigGrp_C_LDCU_APBSysSt (ComSignalGroup):
        ComTimeout = 0.2
        ComTransferProperty = TRIGGERED
        ComNotification = Rte_COMCbk_ISigGrp_C_LDCU_APBSysSt
        ComTimeoutNotification = Rte_COMCbkTOut_ISigGrp_C_LDCU_APBSysSt
        ComSystemTemplateSignalGroupRef = ISignalToIPduMapping_ISigGrp_C_LDCU_APBSysSt
        8 x ComGroupSignal, all with ComTransferProperty=TRIGGERED_ON_CHANGE, ComSignalEndianness=BIG_ENDIAN, ComSignalInitValue=0, ComBitSize=8, ComSignalType=UINT8:
          C_LDCU_APBSysSt_Byte0: ComBitPosition=7, ComSystemTemplateSystemSignalRef=C_LDCU_APBSysSt_Byte0
          C_LDCU_APBSysSt_Byte1: ComBitPosition=15, ComSystemTemplateSystemSignalRef=C_LDCU_APBSysSt_Byte1
          C_LDCU_APBSysSt_Byte2: ComBitPosition=23, ComSystemTemplateSystemSignalRef=C_LDCU_APBSysSt_Byte2
          C_LDCU_APBSysSt_Byte3: ComBitPosition=31, ComSystemTemplateSystemSignalRef=C_LDCU_APBSysSt_Byte3
          C_LDCU_APBSysSt_Byte4: ComBitPosition=39, ComSystemTemplateSystemSignalRef=C_LDCU_APBSysSt_Byte4
          C_LDCU_APBSysSt_Byte5: ComBitPosition=47, ComSystemTemplateSystemSignalRef=C_LDCU_APBSysSt_Byte5
          C_LDCU_APBSysSt_Byte6: ComBitPosition=55, ComSystemTemplateSystemSignalRef=C_LDCU_APBSysSt_Byte6
          C_LDCU_APBSysSt_Byte7: ComBitPosition=63, ComSystemTemplateSystemSignalRef=C_LDCU_APBSysSt_Byte7
      C_IPB_SysSt2_Can_Network_CANNODE_0 (ComIPdu):
        ComIPduSignalProcessing = IMMEDIATE
        ComIPduType = NORMAL
        ComIPduDirection = RECEIVE
        ComIPduGroupRef = ComIPduGroup_Rx
        ComPduIdRef = PduCollection/C_IPB_SysSt2_Can_Network_CANNODE_0_PduR2Com
        ComIPduSignalRef = C_IPB_PlungerPressure
        ComIPduSignalRef = C_IPB_PlungerPressure_Status
      C_IPB_PlungerPressure (ComSignal):
        ComSignalInitValue = 17
        ComTimeout = 0.2
        ComSignalType = UINT16
        ComSignalEndianness = BIG_ENDIAN
        ComBitSize = 12
        ComBitPosition = 28
        ComUpdateBitPosition = -1
        ComTransferProperty = TRIGGERED
        ComSystemTemplateSystemSignalRef = C_IPB_PlungerPressure
      C_IPB_PlungerPressure_Status (ComSignal):
        ComSignalInitValue = 0
        ComTimeout = 0.2
        ComSignalType = BOOLEAN
        ComSignalEndianness = BIG_ENDIAN
        ComBitSize = 1
        ComBitPosition = 32
        ComUpdateBitPosition = -1
        ComTransferProperty = TRIGGERED
        ComSystemTemplateSystemSignalRef = C_IPB_PlungerPressure_Status
      C_AS_SysSt3_Can_Network_CANNODE_0 (ComIPdu):
        ComIPduSignalProcessing = IMMEDIATE
        ComIPduType = NORMAL
        ComIPduDirection = RECEIVE
        ComIPduGroupRef = ComIPduGroup_Rx
        ComPduIdRef = PduCollection/C_AS_SysSt3_Can_Network_CANNODE_0_PduR2Com
        ComIPduSignalRef = C_AS_LvlSnsrCalSts
      C_AS_LvlSnsrCalSts (ComSignal):
        ComSignalInitValue = 1
        ComTimeout = 1.0
        ComSignalType = BOOLEAN
        ComSignalEndianness = BIG_ENDIAN
        ComBitSize = 1
        ComBitPosition = 18
        ComUpdateBitPosition = -1
        ComTransferProperty = TRIGGERED
        ComSystemTemplateSystemSignalRef = C_AS_LvlSnsrCalSts
      C_IPB_APBSysSt_Can_Network_CANNODE_0 (ComIPdu):
        ComIPduSignalProcessing = IMMEDIATE
        ComIPduType = NORMAL
        ComIPduDirection = RECEIVE
        ComIPduGroupRef = ComIPduGroup_Rx
        ComPduIdRef = PduCollection/C_IPB_APBSysSt_Can_Network_CANNODE_0_PduR2Com
        ComIPduSignalRef = C_IPB_EPB_ParkReq
        ComIPduSignalRef = C_IPB_EPB_ActiveVehicleHold
        ComIPduSignalRef = C_IPB_CruiseCtrlCancelReq
        ComIPduSignalRef = C_IPB_TSMFaultSt
        ComIPduSignalRef = C_IPB_TSMActSt
        ComIPduSignalRef = C_IPB_TSMFuncSt
        ComIPduSignalRef = C_IPB_APBSysStMsgCounter
        ComIPduSignalRef = C_IPB_APBSysStCRC8Checksum
      8 x ComSignal, all with ComTimeout=0.2, ComSignalEndianness=BIG_ENDIAN, ComUpdateBitPosition=-1, ComTransferProperty=TRIGGERED:
        C_IPB_EPB_ParkReq: ComSignalInitValue=0, ComSignalType=UINT8, ComBitSize=2, ComBitPosition=37, ComSystemTemplateSystemSignalRef=C_IPB_EPB_ParkReq
        C_IPB_EPB_ActiveVehicleHold: ComSignalInitValue=0, ComSignalType=BOOLEAN, ComBitSize=1, ComBitPosition=38, ComSystemTemplateSystemSignalRef=C_IPB_EPB_ActiveVehicleHold
        C_IPB_CruiseCtrlCancelReq: ComSignalInitValue=0, ComSignalType=BOOLEAN, ComBitSize=1, ComBitPosition=47, ComSystemTemplateSystemSignalRef=C_IPB_CruiseCtrlCancelReq
        C_IPB_TSMFaultSt: ComSignalInitValue=1, ComSignalType=BOOLEAN, ComBitSize=1, ComBitPosition=43, ComSystemTemplateSystemSignalRef=C_IPB_TSMFaultSt
        C_IPB_TSMActSt: ComSignalInitValue=1, ComSignalType=BOOLEAN, ComBitSize=1, ComBitPosition=44, ComSystemTemplateSystemSignalRef=C_IPB_TSMActSt
        C_IPB_TSMFuncSt: ComSignalInitValue=1, ComSignalType=BOOLEAN, ComBitSize=1, ComBitPosition=45, ComSystemTemplateSystemSignalRef=C_IPB_TSMFuncSt
        C_IPB_APBSysStMsgCounter: ComSignalInitValue=0, ComSignalType=UINT8, ComBitSize=4, ComBitPosition=51, ComSystemTemplateSystemSignalRef=C_IPB_APBSysStMsgCounter
        C_IPB_APBSysStCRC8Checksum: ComSignalInitValue=0, ComSignalType=UINT8, ComBitSize=8, ComBitPosition=63, ComSystemTemplateSystemSignalRef=C_IPB_APBSysStCRC8Checksum
      C_LDCU_IPB_FaxleRegen_Can_Network_CANNODE_0 (ComIPdu):
        ComIPduSignalProcessing = IMMEDIATE
        ComIPduType = NORMAL
        ComIPduDirection = RECEIVE
        ComIPduGroupRef = ComIPduGroup_Rx
        ComPduIdRef = PduCollection/C_LDCU_IPB_FaxleRegen_Can_Network_CANNODE_0_PduR2Com
        ComIPduSignalRef = C_LDCU_FMotorSpd
        ComIPduSignalRef = C_LDCU_FMotorSpdDirection
        ComIPduSignalRef = C_LDCU_FMotorSpdVD
      3 x ComSignal, all with ComSignalInitValue=0, ComTimeout=0.1, ComSignalEndianness=BIG_ENDIAN, ComUpdateBitPosition=-1, ComTransferProperty=TRIGGERED:
        C_LDCU_FMotorSpd: ComSignalType=UINT16, ComBitSize=14, ComBitPosition=7, ComSystemTemplateSystemSignalRef=C_LDCU_FMotorSpd
        C_LDCU_FMotorSpdDirection: ComSignalType=BOOLEAN, ComBitSize=1, ComBitPosition=9, ComSystemTemplateSystemSignalRef=C_LDCU_FMotorSpdDirection
        C_LDCU_FMotorSpdVD: ComSignalType=UINT8, ComBitSize=2, ComBitPosition=33, ComSystemTemplateSystemSignalRef=C_LDCU_FMotorSpdVD
      ComIPduGroup_Tx (ComIPduGroup)
      C_RDCU_IPB_APB_ROPP_Can_Network_CANNODE_0 (ComIPdu):
        ComIPduSignalProcessing = IMMEDIATE
        ComIPduType = NORMAL
        ComIPduDirection = SEND
        ComFirstTimeout = 0.0
        ComTimeout = 0.0
        ComIPduGroupRef = ComIPduGroup_Tx
        ComPduIdRef = PduCollection/C_RDCU_IPB_APB_ROPP_Can_Network_CANNODE_0_Com2PduR
        ComIPduSignalGroupRef = ISigGrp_C_RDCU_IPB_APB_ROPP
        ComTxIPdu: ComMinimumDelayTime=0.0, ComTxIPduUnusedAreasDefault=255
          ComTxModeTrue
            ComTxMode: ComTxModeTimePeriod=0, ComTxModeMode=DIRECT, ComTxModeNumberOfRepetitions=0, ComTxModeRepetitionPeriod=0, ComTxModeTimeOffset=0
          ComTxModeFalse
            ComTxMode: ComTxModeTimePeriod=0, ComTxModeMode=DIRECT, ComTxModeNumberOfRepetitions=0, ComTxModeRepetitionPeriod=0, ComTxModeTimeOffset=0
      ISigGrp_C_RDCU_IPB_APB_ROPP (ComSignalGroup): ComTimeout=0.0, ComTransferProperty=TRIGGERED, ComSystemTemplateSignalGroupRef=ISignalToIPduMapping_ISigGrp_C_RDCU_IPB_APB_ROPP
        8 x ComGroupSignal, all with ComTransferProperty=TRIGGERED_ON_CHANGE, ComSignalEndianness=BIG_ENDIAN, ComBitSize=8, ComSignalType=UINT8:
          C_RDCU_IPB_APB_ROPP_Byte0: ComBitPosition=7, ComSignalInitValue=0, ComSystemTemplateSystemSignalRef=C_RDCU_IPB_APB_ROPP_Byte0
          C_RDCU_IPB_APB_ROPP_Byte1: ComBitPosition=15, ComSignalInitValue=0, ComSystemTemplateSystemSignalRef=C_RDCU_IPB_APB_ROPP_Byte1
          C_RDCU_IPB_APB_ROPP_Byte2: ComBitPosition=23, ComSignalInitValue=0, ComSystemTemplateSystemSignalRef=C_RDCU_IPB_APB_ROPP_Byte2
          C_RDCU_IPB_APB_ROPP_Byte3: ComBitPosition=31, ComSignalInitValue=128, ComSystemTemplateSystemSignalRef=C_RDCU_IPB_APB_ROPP_Byte3
          C_RDCU_IPB_APB_ROPP_Byte4: ComBitPosition=39, ComSignalInitValue=0, ComSystemTemplateSystemSignalRef=C_RDCU_IPB_APB_ROPP_Byte4
          C_RDCU_IPB_APB_ROPP_Byte5: ComBitPosition=47, ComSignalInitValue=0, ComSystemTemplateSystemSignalRef=C_RDCU_IPB_APB_ROPP_Byte5
          C_RDCU_IPB_APB_ROPP_Byte6: ComBitPosition=55, ComSignalInitValue=0, ComSystemTemplateSystemSignalRef=C_RDCU_IPB_APB_ROPP_Byte6
          C_RDCU_IPB_APB_ROPP_Byte7: ComBitPosition=63, ComSignalInitValue=0, ComSystemTemplateSystemSignalRef=C_RDCU_IPB_APB_ROPP_Byte7
      C_RDCU_RLIN3Info_Can_Network_CANNODE_0 (ComIPdu):
        ComIPduSignalProcessing = IMMEDIATE
        ComIPduType = NORMAL
        ComIPduDirection = SEND
        ComFirstTimeout = 0.0
        ComTimeout = 0.0
        ComIPduGroupRef = ComIPduGroup_Tx
        ComPduIdRef = PduCollection/C_RDCU_RLIN3Info_Can_Network_CANNODE_0_Com2PduR
        ComIPduSignalRef = C_RDCU_FWiperAngle
        ComIPduSignalRef = C_RDCU_FWiperMotorAngle
        ComIPduSignalRef = C_RDCU_FWiperSpd
        ComIPduSignalRef = C_RDCU_FWiperActiveSt
        ComIPduSignalRef = C_RDCU_FWiperParkARSt
        ComIPduSignalRef = C_RDCU_FWiperTurnPosSt
        ComIPduSignalRef = C_RDCU_FWiperServicePosSt
        ComIPduSignalRef = C_RDCU_FWiperBlkPosSt
        ComIPduSignalRef = C_RDCU_FWiperMoveDir
        ComIPduSignalRef = C_RDCU_FWiperVoltErr
        ComIPduSignalRef = C_RDCU_FWiperMotorErr
        ComIPduSignalRef = C_RDCU_FWiperLinErr
        ComIPduSignalRef = C_RDCU_FWiperTempProtectSt
        ComIPduSignalRef = C_RDCU_FWiperOverLoadSt
        ComIPduSignalRef = C_RDCU_RLSRQWiperSPD
        ComIPduSignalRef = C_RDCU_RLSFaultRain
        ComIPduSignalRef = C_RDCU_RLSREPError
        ComIPduSignalRef = C_RDCU_RLSVOLTError
        ComIPduSignalRef = C_RDCU_RLSRainIntensity
        ComIPduSignalRef = C_RDCU_RLSBrightnessFW
        ComIPduSignalRef = C_RDCU_RLSDCbreA
        ComIPduSignalRef = C_RDCU_RLSADCA
        ComIPduSignalRef = C_RDCU_RLSDCbreB
        ComIPduSignalRef = C_RDCU_RLSADCB
        ComIPduSignalRef = C_FWiperSysFaultWarning
        ComTxIPdu: ComMinimumDelayTime=0.0, ComTxIPduUnusedAreasDefault=255
          ComTxModeTrue
            ComTxMode: ComTxModeTimePeriod=0, ComTxModeMode=DIRECT, ComTxModeNumberOfRepetitions=0, ComTxModeRepetitionPeriod=0, ComTxModeTimeOffset=0
          ComTxModeFalse
            ComTxMode: ComTxModeTimePeriod=0, ComTxModeMode=DIRECT, ComTxModeNumberOfRepetitions=0, ComTxModeRepetitionPeriod=0, ComTxModeTimeOffset=0
      25 x ComSignal, all with ComTimeout=0.0, ComSignalEndianness=BIG_ENDIAN, ComUpdateBitPosition=-1, ComTransferProperty=TRIGGERED:
        C_RDCU_FWiperAngle: ComSignalInitValue=0, ComSignalType=UINT8, ComBitSize=8, ComBitPosition=7, ComSystemTemplateSystemSignalRef=C_RDCU_FWiperAngle
        C_RDCU_FWiperMotorAngle: ComSignalInitValue=0, ComSignalType=UINT8, ComBitSize=8, ComBitPosition=15, ComSystemTemplateSystemSignalRef=C_RDCU_FWiperMotorAngle
        C_RDCU_FWiperSpd: ComSignalInitValue=0, ComSignalType=UINT8, ComBitSize=4, ComBitPosition=23, ComSystemTemplateSystemSignalRef=C_RDCU_FWiperSpd
        C_RDCU_FWiperActiveSt: ComSignalInitValue=0, ComSignalType=BOOLEAN, ComBitSize=1, ComBitPosition=19, ComSystemTemplateSystemSignalRef=C_RDCU_FWiperActiveSt
        C_RDCU_FWiperParkARSt: ComSignalInitValue=0, ComSignalType=BOOLEAN, ComBitSize=1, ComBitPosition=18, ComSystemTemplateSystemSignalRef=C_RDCU_FWiperParkARSt
        C_RDCU_FWiperTurnPosSt: ComSignalInitValue=0, ComSignalType=BOOLEAN, ComBitSize=1, ComBitPosition=17, ComSystemTemplateSystemSignalRef=C_RDCU_FWiperTurnPosSt
        C_RDCU_FWiperServicePosSt: ComSignalInitValue=0, ComSignalType=BOOLEAN, ComBitSize=1, ComBitPosition=16, ComSystemTemplateSystemSignalRef=C_RDCU_FWiperServicePosSt
        C_RDCU_FWiperBlkPosSt: ComSignalInitValue=0, ComSignalType=BOOLEAN, ComBitSize=1, ComBitPosition=31, ComSystemTemplateSystemSignalRef=C_RDCU_FWiperBlkPosSt
        C_RDCU_FWiperMoveDir: ComSignalInitValue=0, ComSignalType=UINT8, ComBitSize=2, ComBitPosition=30, ComSystemTemplateSystemSignalRef=C_RDCU_FWiperMoveDir
        C_RDCU_FWiperVoltErr: ComSignalInitValue=0, ComSignalType=UINT8, ComBitSize=2, ComBitPosition=28, ComSystemTemplateSystemSignalRef=C_RDCU_FWiperVoltErr
        C_RDCU_FWiperMotorErr: ComSignalInitValue=0, ComSignalType=BOOLEAN, ComBitSize=1, ComBitPosition=26, ComSystemTemplateSystemSignalRef=C_RDCU_FWiperMotorErr
        C_RDCU_FWiperLinErr: ComSignalInitValue=0, ComSignalType=BOOLEAN, ComBitSize=1, ComBitPosition=25, ComSystemTemplateSystemSignalRef=C_RDCU_FWiperLinErr
        C_RDCU_FWiperTempProtectSt: ComSignalInitValue=0, ComSignalType=BOOLEAN, ComBitSize=1, ComBitPosition=24, ComSystemTemplateSystemSignalRef=C_RDCU_FWiperTempProtectSt
        C_RDCU_FWiperOverLoadSt: ComSignalInitValue=0, ComSignalType=BOOLEAN, ComBitSize=1, ComBitPosition=39, ComSystemTemplateSystemSignalRef=C_RDCU_FWiperOverLoadSt
        C_RDCU_RLSRQWiperSPD: ComSignalInitValue=0, ComSignalType=UINT8, ComBitSize=4, ComBitPosition=38, ComSystemTemplateSystemSignalRef=C_RDCU_RLSRQWiperSPD
        C_RDCU_RLSFaultRain: ComSignalInitValue=0, ComSignalType=BOOLEAN, ComBitSize=1, ComBitPosition=34, ComSystemTemplateSystemSignalRef=C_RDCU_RLSFaultRain
        C_RDCU_RLSREPError: ComSignalInitValue=0, ComSignalType=BOOLEAN, ComBitSize=1, ComBitPosition=33, ComSystemTemplateSystemSignalRef=C_RDCU_RLSREPError
        C_RDCU_RLSVOLTError: ComSignalInitValue=0, ComSignalType=UINT8, ComBitSize=2, ComBitPosition=32, ComSystemTemplateSystemSignalRef=C_RDCU_RLSVOLTError
        C_RDCU_RLSRainIntensity: ComSignalInitValue=0, ComSignalType=UINT8, ComBitSize=6, ComBitPosition=46, ComSystemTemplateSystemSignalRef=C_RDCU_RLSRainIntensity
        C_RDCU_RLSBrightnessFW: ComSignalInitValue=1023, ComSignalType=UINT16, ComBitSize=10, ComBitPosition=48, ComSystemTemplateSystemSignalRef=C_RDCU_RLSBrightnessFW
        C_RDCU_RLSDCbreA: ComSignalInitValue=0, ComSignalType=UINT16, ComBitSize=16, ComBitPosition=70, ComSystemTemplateSystemSignalRef=C_RDCU_RLSDCbreA
        C_RDCU_RLSADCA: ComSignalInitValue=0, ComSignalType=UINT16, ComBitSize=16, ComBitPosition=86, ComSystemTemplateSystemSignalRef=C_RDCU_RLSADCA
        C_RDCU_RLSDCbreB: ComSignalInitValue=0, ComSignalType=UINT16, ComBitSize=16, ComBitPosition=102, ComSystemTemplateSystemSignalRef=C_RDCU_RLSDCbreB
        C_RDCU_RLSADCB: ComSignalInitValue=0, ComSignalType=UINT16, ComBitSize=16, ComBitPosition=118, ComSystemTemplateSystemSignalRef=C_RDCU_RLSADCB
        C_FWiperSysFaultWarning: ComSignalInitValue=0, ComSignalType=BOOLEAN, ComBitSize=1, ComBitPosition=40, ComSystemTemplateSystemSignalRef=C_FWiperSysFaultWarning
      C_RDCU_BodyCtrl2_Can_Network_CANNODE_0 (ComIPdu):
        ComIPduSignalProcessing = IMMEDIATE
        ComIPduType = NORMAL
        ComIPduDirection = SEND
        ComFirstTimeout = 0.0
        ComTimeout = 0.0
        ComIPduGroupRef = ComIPduGroup_Tx
        ComPduIdRef = PduCollection/C_RDCU_BodyCtrl2_Can_Network_CANNODE_0_Com2PduR
        ComIPduSignalRef = C_RDCU_BacklightBrightCtr
        ComIPduSignalRef = C_RDCU_PLGAlarmReq
        ComIPduSignalRef = C_RDCU_ChrgConnStReq
        ComIPduSignalRef = C_RDCU_SecurityAccessReq
        ComIPduSignalRef = C_ARSMotorCurrent
        ComIPduSignalRef = C_ARSCurtHallCnt
        ComIPduSignalRef = C_ARSWorkSt
        ComIPduSignalRef = C_ARSTermalProtec
        ComIPduSignalRef = C_ARSPstValu
        ComIPduSignalRef = C_ARSFailureCause
        ComIPduSignalRef = C_ARSAntiPinchSt
        ComTxIPdu: ComMinimumDelayTime=0.0, ComTxIPduUnusedAreasDefault=255
          ComTxModeTrue
            ComTxMode: ComTxModeTimePeriod=0, ComTxModeMode=DIRECT, ComTxModeNumberOfRepetitions=0, ComTxModeRepetitionPeriod=0, ComTxModeTimeOffset=0
          ComTxModeFalse
            ComTxMode: ComTxModeTimePeriod=0, ComTxModeMode=DIRECT, ComTxModeNumberOfRepetitions=0, ComTxModeRepetitionPeriod=0, ComTxModeTimeOffset=0
      11 x ComSignal, all with ComSignalInitValue=0, ComTimeout=0.0, ComSignalEndianness=BIG_ENDIAN, ComUpdateBitPosition=-1, ComTransferProperty=TRIGGERED:
        C_RDCU_BacklightBrightCtr: ComSignalType=BOOLEAN, ComBitSize=1, ComBitPosition=1, ComSystemTemplateSystemSignalRef=C_RDCU_BacklightBrightCtr
        C_RDCU_PLGAlarmReq: ComSignalType=BOOLEAN, ComBitSize=1, ComBitPosition=0, ComSystemTemplateSystemSignalRef=C_RDCU_PLGAlarmReq
        C_RDCU_ChrgConnStReq: ComSignalType=BOOLEAN, ComBitSize=1, ComBitPosition=2, ComSystemTemplateSystemSignalRef=C_RDCU_ChrgConnStReq
        C_RDCU_SecurityAccessReq: ComSignalType=BOOLEAN, ComBitSize=1, ComBitPosition=3, ComSystemTemplateSystemSignalRef=C_RDCU_SecurityAccessReq
        C_ARSMotorCurrent: ComSignalType=UINT8, ComBitSize=8, ComBitPosition=15, ComSystemTemplateSystemSignalRef=C_ARSMotorCurrent
        C_ARSCurtHallCnt: ComSignalType=UINT16, ComBitSize=16, ComBitPosition=47, ComSystemTemplateSystemSignalRef=C_ARSCurtHallCnt
        C_ARSWorkSt: ComSignalType=BOOLEAN, ComBitSize=1, ComBitPosition=4, ComSystemTemplateSystemSignalRef=C_ARSWorkSt
        C_ARSTermalProtec: ComSignalType=UINT8, ComBitSize=2, ComBitPosition=6, ComSystemTemplateSystemSignalRef=C_ARSTermalProtec
        C_ARSPstValu: ComSignalType=UINT8, ComBitSize=8, ComBitPosition=63, ComSystemTemplateSystemSignalRef=C_ARSPstValu
        C_ARSFailureCause: ComSignalType=UINT8, ComBitSize=4, ComBitPosition=23, ComSystemTemplateSystemSignalRef=C_ARSFailureCause
        C_ARSAntiPinchSt: ComSignalType=BOOLEAN, ComBitSize=1, ComBitPosition=7, ComSystemTemplateSystemSignalRef=C_ARSAntiPinchSt
      C_RDCU_APBSysSt_Can_Network_CANNODE_0 (ComIPdu):
        ComIPduSignalProcessing = IMMEDIATE
        ComIPduType = NORMAL
        ComIPduDirection = SEND
        ComFirstTimeout = 0.0
        ComTimeout = 0.0
        ComIPduGroupRef = ComIPduGroup_Tx
        ComPduIdRef = PduCollection/C_RDCU_APBSysSt_Can_Network_CANNODE_0_Com2PduR
        ComIPduSignalGroupRef = ISigGrp_C_RDCU_APBSysSt
        ComTxIPdu: ComMinimumDelayTime=0.0, ComTxIPduUnusedAreasDefault=255
          ComTxModeTrue
            ComTxMode: ComTxModeTimePeriod=0, ComTxModeMode=DIRECT, ComTxModeNumberOfRepetitions=0, ComTxModeRepetitionPeriod=0, ComTxModeTimeOffset=0
          ComTxModeFalse
            ComTxMode: ComTxModeTimePeriod=0, ComTxModeMode=DIRECT, ComTxModeNumberOfRepetitions=0, ComTxModeRepetitionPeriod=0, ComTxModeTimeOffset=0
      ISigGrp_C_RDCU_APBSysSt (ComSignalGroup): ComTimeout=0.0, ComTransferProperty=TRIGGERED, ComSystemTemplateSignalGroupRef=ISignalToIPduMapping_ISigGrp_C_RDCU_APBSysSt
        8 x ComGroupSignal, all with ComTransferProperty=TRIGGERED_ON_CHANGE, ComSignalEndianness=BIG_ENDIAN, ComSignalInitValue=0, ComBitSize=8, ComSignalType=UINT8:
          C_RDCU_APBSysSt_Byte0: ComBitPosition=7, ComSystemTemplateSystemSignalRef=C_RDCU_APBSysSt_Byte0
          C_RDCU_APBSysSt_Byte1: ComBitPosition=15, ComSystemTemplateSystemSignalRef=C_RDCU_APBSysSt_Byte1
          C_RDCU_APBSysSt_Byte2: ComBitPosition=23, ComSystemTemplateSystemSignalRef=C_RDCU_APBSysSt_Byte2
          C_RDCU_APBSysSt_Byte3: ComBitPosition=31, ComSystemTemplateSystemSignalRef=C_RDCU_APBSysSt_Byte3
          C_RDCU_APBSysSt_Byte4: ComBitPosition=39, ComSystemTemplateSystemSignalRef=C_RDCU_APBSysSt_Byte4
          C_RDCU_APBSysSt_Byte5: ComBitPosition=47, ComSystemTemplateSystemSignalRef=C_RDCU_APBSysSt_Byte5
          C_RDCU_APBSysSt_Byte6: ComBitPosition=55, ComSystemTemplateSystemSignalRef=C_RDCU_APBSysSt_Byte6
          C_RDCU_APBSysSt_Byte7: ComBitPosition=63, ComSystemTemplateSystemSignalRef=C_RDCU_APBSysSt_Byte7
      30 x ComIPdu, all with ComIPduSignalProcessing=IMMEDIATE, ComIPduType=NORMAL:
        C_LDCU_IPB_RaxleRegen_Can_Network_0_CANNODE_0: ComIPduDirection=RECEIVE, ComIPduGroupRef=ComIPduGroup_Rx, ComPduIdRef=PduCollection/C_LDCU_IPB_RaxleRegen_Can_Network_0_CANNODE_0_PduR2Com, ComIPduSignalRef=C_LDCU_RMotorSpd, ComIPduSignalRef=C_LDCU_RMotorSpdVD, ComIPduSignalRef=C_LDCU_RMotorSpdDirection
        C_IPB_SpdEdges_Can_Network_0_CANNODE_0: ComIPduDirection=RECEIVE, ComIPduGroupRef=ComIPduGroup_Rx, ComPduIdRef=PduCollection/C_IPB_SpdEdges_Can_Network_0_CANNODE_0_PduR2Com, ComIPduSignalRef=C_IPB_FLWheelSpdEdgesSum, ComIPduSignalRef=C_IPB_FRWheelSpdEdgesSum, ComIPduSignalRef=C_IPB_RLWheelSpdEdgesSum, ComIPduSignalRef=C_IPB_RRWheelSpdEdgesSum, ComIPduSignalRef=C_IPB_SpdEdgesMsgCounter, ComIPduSignalRef=C_IPB_SpdEdgesCRC8Checksum
        C_IPB_SpdInfoR_Can_Network_0_CANNODE_0: ComIPduDirection=RECEIVE, ComIPduGroupRef=ComIPduGroup_Rx, ComPduIdRef=PduCollection/C_IPB_SpdInfoR_Can_Network_0_CANNODE_0_PduR2Com, ComIPduSignalRef=C_IPB_RLWheelSpd, ComIPduSignalRef=C_IPB_RLWheelSpdVD, ComIPduSignalRef=C_IPB_RRWheelSpd, ComIPduSignalRef=C_IPB_RRWheelSpdVD, ComIPduSignalRef=C_IPB_SimulatorPressure, ComIPduSignalRef=C_IPB_SimulatorPressure_Status, ComIPduSignalRef=C_IPB_SpdInfo2MsgCounter, ComIPduSignalRef=C_IPB_SpdInfo2CRC8Checksum
        C_LDCU_EPB_APB_ROPP2_Can_Network_0_CANNODE_0: ComIPduDirection=RECEIVE, ComIPduGroupRef=ComIPduGroup_Rx, ComPduIdRef=PduCollection/C_LDCU_EPB_APB_ROPP2_Can_Network_0_CANNODE_0_PduR2Com
        C_IPB_SysSt_E2E_Can_Network_0_CANNODE_0: ComIPduDirection=RECEIVE, ComIPduGroupRef=ComIPduGroup_Rx, ComPduIdRef=PduCollection/C_IPB_SysSt_E2E_Can_Network_0_CANNODE_0_PduR2Com
        C_MFS_Status_Can_Network_0_CANNODE_0: ComIPduDirection=RECEIVE, ComIPduGroupRef=ComIPduGroup_Rx, ComPduIdRef=PduCollection/C_MFS_Status_Can_Network_0_CANNODE_0_PduR2Com
        C_IPB_SysSt1_Can_Network_0_CANNODE_0: ComIPduDirection=RECEIVE, ComIPduGroupRef=ComIPduGroup_Rx, ComPduIdRef=PduCollection/C_IPB_SysSt1_Can_Network_0_CANNODE_0_PduR2Com, ComIPduSignalRef=C_IPB_InputRodStroke, ComIPduSignalRef=C_IPB_InputRodStroke_Status, ComIPduSignalRef=C_IPB_WheelPressureFrontLeftVD, ComIPduSignalRef=C_IPB_WheelPressureFrontLeft, ComIPduSignalRef=C_IPB_SysSt1MsgCounter, ComIPduSignalRef=C_IPB_SysSt1CRC8Checksum
        C_AS_SysSt2_Can_Network_0_CANNODE_0: ComIPduDirection=RECEIVE, ComIPduGroupRef=ComIPduGroup_Rx, ComPduIdRef=PduCollection/C_AS_SysSt2_Can_Network_0_CANNODE_0_PduR2Com, ComIPduSignalRef=C_AS_wheelPosFLFilt_mm, ComIPduSignalRef=C_AS_wheelPosFRFilt_mm, ComIPduSignalRef=C_AS_wheelPosRLFilt_mm, ComIPduSignalRef=C_AS_wheelPosRRFilt_mm
        C_LDCU_EPBDebugData_Can_Network_0_CANNODE_0: ComIPduDirection=RECEIVE, ComIPduGroupRef=ComIPduGroup_Rx, ComPduIdRef=PduCollection/C_LDCU_EPBDebugData_Can_Network_0_CANNODE_0_PduR2Com, ComIPduSignalRef=C_LDCU_VehicleCurrentState, ComIPduSignalRef=C_VehicleCurrentSpeed, ComIPduSignalRef=C_VehicleCurrentSpeedVD, ComIPduSignalRef=C_VehicleRwuVD, ComIPduSignalRef=C_VehicleRwuSpeed, ComIPduSignalRef=C_VehicleRwuSlipeRate, ComIPduSignalRef=C_VehicleCurrentSlope, ComIPduSignalRef=C_VehicleCurrentSlopeVD
        C_XPU_IPB_ADASToqCtrl_Can_Network_0_CANNODE_0: ComIPduDirection=RECEIVE, ComIPduGroupRef=ComIPduGroup_Rx, ComPduIdRef=PduCollection/C_XPU_IPB_ADASToqCtrl_Can_Network_0_CANNODE_0_PduR2Com
        C_IPB_SpdInfoF_Can_Network_0_CANNODE_0: ComIPduDirection=RECEIVE, ComIPduGroupRef=ComIPduGroup_Rx, ComPduIdRef=PduCollection/C_IPB_SpdInfoF_Can_Network_0_CANNODE_0_PduR2Com, ComIPduSignalRef=C_IPB_FLWheelSpd, ComIPduSignalRef=C_IPB_FLWheelSpdVD, ComIPduSignalRef=C_IPB_FRWheelSpd, ComIPduSignalRef=C_IPB_FRWheelSpdVD, ComIPduSignalRef=C_IPB_VehSpd, ComIPduSignalRef=C_IPB_VehSpdVD, ComIPduSignalRef=C_IPB_SpdInfo1MsgCounter, ComIPduSignalRef=C_IPB_SpdInfo1CRC8Checksum
        C_IPB_SpdInfo_E2E_Can_Network_0_CANNODE_0: ComIPduDirection=RECEIVE, ComIPduGroupRef=ComIPduGroup_Rx, ComPduIdRef=PduCollection/C_IPB_SpdInfo_E2E_Can_Network_0_CANNODE_0_PduR2Com
        C_AS_SysSt1_Can_Network_0_CANNODE_0: ComIPduDirection=RECEIVE, ComIPduGroupRef=ComIPduGroup_Rx, ComPduIdRef=PduCollection/C_AS_SysSt1_Can_Network_0_CANNODE_0_PduR2Com, ComIPduSignalRef=C_AS_WelcomeSt, ComIPduSignalRef=C_AS_EasyloadingSt, ComIPduSignalRef=C_AS_MaintainMode, ComIPduSignalRef=C_AS_HoistMode
        C_LDCU_BodySysSt1_Can_Network_0_CANNODE_0: ComIPduDirection=RECEIVE, ComIPduGroupRef=ComIPduGroup_Rx, ComPduIdRef=PduCollection/C_LDCU_BodySysSt1_Can_Network_0_CANNODE_0_PduR2Com, ComIPduSignalRef=C_LDCU_PowerMode, ComIPduSignalRef=C_LDCU_DriverDoorLockSt, ComIPduSignalRef=C_LDCU_DriverDoorAjarSt, ComIPduSignalRef=C_LDCU_RLDoorAjarSt, ComIPduSignalRef=C_LDCU_DrvSeatOccupancySt, ComIPduSignalRef=C_LDCU_RLSeatOccupancySt, ComIPduSignalRef=C_LDCU_HazardLampReq, ComIPduSignalRef=C_LDCU_HazardLampSwSt, ComIPduSignalRef=C_LDCU_AlarmSt, ComIPduSignalRef=C_LDCU_DoorLockCtrlSt, ComIPduSignalRef=C_LDCU_DoorLockSource, ComIPduSignalRef=C_LDCU_DoorUnlockSource, ComIPduSignalRef=C_LDCU_DoorLockEvent, ComIPduSignalRef=C_LDCU_ChargeGunCmd, ComIPduSignalRef=C_LDCU_TrunkReleaseSW, ComIPduSignalRef=C_LDCU_LockLogicSt
        C_CDCU_ChassisCtrl_Can_Network_0_CANNODE_0: ComIPduDirection=RECEIVE, ComIPduGroupRef=ComIPduGroup_Rx, ComPduIdRef=PduCollection/C_CDCU_ChassisCtrl_Can_Network_0_CANNODE_0_PduR2Com, ComIPduSignalRef=C_CDCU_ESP_EPBReq, ComIPduSignalRef=C_CDCU_ESP_EPBReqVD, ComIPduSignalRef=C_CDCU_EPB_Tra_modeReq, ComIPduSignalRef=C_CDCU_EPB_Tra_modeReqVD
        C_IPB_CylinderPressure2_Can_Network_0_CANNODE_0: ComIPduDirection=RECEIVE, ComIPduGroupRef=ComIPduGroup_Rx, ComPduIdRef=PduCollection/C_IPB_CylinderPressure2_Can_Network_0_CANNODE_0_PduR2Com, ComIPduSignalRef=C_IPB_WheelPressureFrontRightVD, ComIPduSignalRef=C_IPB_WheelPressureRearLeftVD, ComIPduSignalRef=C_IPB_WheelPressureRearRightVD, ComIPduSignalRef=C_IPB_WheelPressureFrontRight, ComIPduSignalRef=C_IPB_WheelPressureRearLeft, ComIPduSignalRef=C_IPB_WheelPressureRearRight, ComIPduSignalRef=C_IPB_CyPressure2MsgCounter, ComIPduSignalRef=C_IPB_CyPressure2CRC8Checksum
        C_IPB_SysSt_Can_Network_0_CANNODE_0: ComIPduDirection=RECEIVE, ComIPduGroupRef=ComIPduGroup_Rx, ComPduIdRef=PduCollection/C_IPB_SysSt_Can_Network_0_CANNODE_0_PduR2Com, ComIPduSignalRef=C_IPB_ABSFault, ComIPduSignalRef=C_IPB_ABSActSt, ComIPduSignalRef=C_IPB_EBDFault, ComIPduSignalRef=C_IPB_EBDActSt, ComIPduSignalRef=C_IPB_VDCActSt, ComIPduSignalRef=C_IPB_XPedalAVHActSt, ComIPduSignalRef=C_IPB_BrkLightOnReq, ComIPduSignalRef=C_IPB_TCSActSt, ComIPduSignalRef=C_IPB_HHCFault, ComIPduSignalRef=C_IPB_HHCActSt, ComIPduSignalRef=C_IPB_AVHFault, ComIPduSignalRef=C_IPB_EBAAct, ComIPduSignalRef=C_IPB_AVHActSt, ComIPduSignalRef=C_IPB_HpsAcknowledge, ComIPduSignalRef=C_IPB_HpsAvailability, ComIPduSignalRef=C_IPB_ESPPATA, ComIPduSignalRef=C_IPB_ESPFault, ComIPduSignalRef=C_IPB_CDPAvl, ComIPduSignalRef=C_IPB_CDPIntervention, ComIPduSignalRef=C_IPB_AEBAvl, ComIPduSignalRef=C_IPB_AEBAct, ComIPduSignalRef=C_IPB_CddSt, ComIPduSignalRef=C_IPB_CddAvl, ComIPduSignalRef=C_IPB_StandStillSt, ComIPduSignalRef=C_IPB_ABAAvl, ComIPduSignalRef=C_IPB_ABAAct, ComIPduSignalRef=C_IPB_ABPAvl, ComIPduSignalRef=C_IPB_ABPAct, ComIPduSignalRef=C_IPB_AWBAvl, ComIPduSignalRef=C_IPB_AWBAct, ComIPduSignalRef=C_IPB_CDDBrkTempOff, ComIPduSignalRef=C_IPB_CDDFaultSt, ComIPduSignalRef=C_IPB_BrkPedalSt, ComIPduSignalRef=C_IPB_BrkPedalStVD, ComIPduSignalRef=C_IPB_EmerLightReq, ComIPduSignalRef=C_IPB_DTCActSt, ComIPduSignalRef=C_IPB_DTCFault, ComIPduSignalRef=C_IPB_SCMSt, ComIPduSignalRef=C_IPB_SCMFault, ComIPduSignalRef=C_IPB_EBAAvl, ComIPduSignalRef=C_IPB_SysStMsgCounter, ComIPduSignalRef=C_IPB_SysStCRC8Checksum
        C_LDCU_RTorqInfo_Can_Network_0_CANNODE_0: ComIPduDirection=RECEIVE, ComIPduGroupRef=ComIPduGroup_Rx, ComPduIdRef=PduCollection/C_LDCU_RTorqInfo_Can_Network_0_CANNODE_0_PduR2Com, ComIPduSignalRef=C_LDCU_RWheelPeakTorqMax, ComIPduSignalRef=C_LDCU_RWheelPeakTorqMin, ComIPduSignalRef=C_LDCU_RWheelCurTorq, ComIPduSignalRef=C_LDCU_RWheelDriverTorqReq, ComIPduSignalRef=C_LDCU_BrakePrRampReq, ComIPduSignalRef=C_LDCU_RTorqInfoMsgCounter, ComIPduSignalRef=C_LDCU_RTorqInfoCRC8Checksum
        C_IPB_Accel_Can_Network_0_CANNODE_0: ComIPduDirection=RECEIVE, ComIPduGroupRef=ComIPduGroup_Rx, ComPduIdRef=PduCollection/C_IPB_Accel_Can_Network_0_CANNODE_0_PduR2Com, ComIPduSignalRef=C_IPB_VehLongAccel, ComIPduSignalRef=C_IPB_VehLateralAccel, ComIPduSignalRef=C_IPB_VehLongAccelVD, ComIPduSignalRef=C_IPB_VehLateralAccelVD, ComIPduSignalRef=C_IPB_YAWRate, ComIPduSignalRef=C_IPB_YAWRateVD
        C_LDCU_SysSt_Can_Network_0_CANNODE_0: ComIPduDirection=RECEIVE, ComIPduGroupRef=ComIPduGroup_Rx, ComPduIdRef=PduCollection/C_LDCU_SysSt_Can_Network_0_CANNODE_0_PduR2Com, ComIPduSignalRef=C_LDCU_EVSysReadySt, ComIPduSignalRef=C_LDCU_GearLev, ComIPduSignalRef=C_LDCU_CurrentGearLev, ComIPduSignalRef=C_LDCU_ExterTemp, ComIPduSignalRef=C_LDCU_ExterTempVD, ComIPduSignalRef=C_LDCU_BrkPedalSt, ComIPduSignalRef=C_LDCU_BrkPedalStVD, ComIPduSignalRef=C_LDCU_AccPedalSigVD, ComIPduSignalRef=C_LDCU_AccPedalSig, ComIPduSignalRef=C_LDCU_ESP_EPBReq, ComIPduSignalRef=C_LDCU_ESP_EPBReqVD
        C_LDCU_FTorqInfo_Can_Network_0_CANNODE_0: ComIPduDirection=RECEIVE, ComIPduGroupRef=ComIPduGroup_Rx, ComPduIdRef=PduCollection/C_LDCU_FTorqInfo_Can_Network_0_CANNODE_0_PduR2Com
        C_LDCU_APBSysSt_Can_Network_0_CANNODE_0: ComIPduDirection=RECEIVE, ComIPduGroupRef=ComIPduGroup_Rx, ComPduIdRef=PduCollection/C_LDCU_APBSysSt_Can_Network_0_CANNODE_0_PduR2Com
        C_IPB_SysSt2_Can_Network_0_CANNODE_0: ComIPduDirection=RECEIVE, ComIPduGroupRef=ComIPduGroup_Rx, ComPduIdRef=PduCollection/C_IPB_SysSt2_Can_Network_0_CANNODE_0_PduR2Com, ComIPduSignalRef=C_IPB_PlungerPressure, ComIPduSignalRef=C_IPB_PlungerPressure_Status
        C_AS_SysSt3_Can_Network_0_CANNODE_0: ComIPduDirection=RECEIVE, ComIPduGroupRef=ComIPduGroup_Rx, ComPduIdRef=PduCollection/C_AS_SysSt3_Can_Network_0_CANNODE_0_PduR2Com, ComIPduSignalRef=C_AS_LvlSnsrCalSts
        C_IPB_APBSysSt_Can_Network_0_CANNODE_0: ComIPduDirection=RECEIVE, ComIPduGroupRef=ComIPduGroup_Rx, ComPduIdRef=PduCollection/C_IPB_APBSysSt_Can_Network_0_CANNODE_0_PduR2Com, ComIPduSignalRef=C_IPB_EPB_ParkReq, ComIPduSignalRef=C_IPB_EPB_ActiveVehicleHold, ComIPduSignalRef=C_IPB_CruiseCtrlCancelReq, ComIPduSignalRef=C_IPB_TSMFaultSt, ComIPduSignalRef=C_IPB_TSMActSt, ComIPduSignalRef=C_IPB_TSMFuncSt, ComIPduSignalRef=C_IPB_APBSysStMsgCounter, ComIPduSignalRef=C_IPB_APBSysStCRC8Checksum
        C_LDCU_IPB_FaxleRegen_Can_Network_0_CANNODE_0: ComIPduDirection=RECEIVE, ComIPduGroupRef=ComIPduGroup_Rx, ComPduIdRef=PduCollection/C_LDCU_IPB_FaxleRegen_Can_Network_0_CANNODE_0_PduR2Com, ComIPduSignalRef=C_LDCU_FMotorSpd, ComIPduSignalRef=C_LDCU_FMotorSpdDirection, ComIPduSignalRef=C_LDCU_FMotorSpdVD
        C_RDCU_IPB_APB_ROPP_Can_Network_0_CANNODE_0: ComIPduDirection=SEND, ComFirstTimeout=0.0, ComTimeout=0.0, ComIPduGroupRef=ComIPduGroup_Tx, ComPduIdRef=PduCollection/C_RDCU_IPB_APB_ROPP_Can_Network_0_CANNODE_0_Com2PduR
          ComTxIPdu: ComMinimumDelayTime=0.0, ComTxIPduUnusedAreasDefault=255
            ComTxModeTrue
              ComTxMode: ComTxModeTimePeriod=0, ComTxModeMode=DIRECT, ComTxModeNumberOfRepetitions=0, ComTxModeRepetitionPeriod=0, ComTxModeTimeOffset=0
            ComTxModeFalse
              ComTxMode: ComTxModeTimePeriod=0, ComTxModeMode=DIRECT, ComTxModeNumberOfRepetitions=0, ComTxModeRepetitionPeriod=0, ComTxModeTimeOffset=0
        C_RDCU_RLIN3Info_Can_Network_0_CANNODE_0: ComIPduDirection=SEND, ComFirstTimeout=0.0, ComTimeout=0.0, ComIPduGroupRef=ComIPduGroup_Tx, ComPduIdRef=PduCollection/C_RDCU_RLIN3Info_Can_Network_0_CANNODE_0_Com2PduR, ComIPduSignalRef=C_RDCU_FWiperAngle, ComIPduSignalRef=C_RDCU_FWiperMotorAngle, ComIPduSignalRef=C_RDCU_FWiperSpd, ComIPduSignalRef=C_RDCU_FWiperActiveSt, ComIPduSignalRef=C_RDCU_FWiperParkARSt, ComIPduSignalRef=C_RDCU_FWiperTurnPosSt, ComIPduSignalRef=C_RDCU_FWiperServicePosSt, ComIPduSignalRef=C_RDCU_FWiperBlkPosSt, ComIPduSignalRef=C_RDCU_FWiperMoveDir, ComIPduSignalRef=C_RDCU_FWiperVoltErr, ComIPduSignalRef=C_RDCU_FWiperMotorErr, ComIPduSignalRef=C_RDCU_FWiperLinErr, ComIPduSignalRef=C_RDCU_FWiperTempProtectSt, ComIPduSignalRef=C_RDCU_FWiperOverLoadSt, ComIPduSignalRef=C_RDCU_RLSRQWiperSPD, ComIPduSignalRef=C_RDCU_RLSFaultRain, ComIPduSignalRef=C_RDCU_RLSREPError, ComIPduSignalRef=C_RDCU_RLSVOLTError, ComIPduSignalRef=C_RDCU_RLSRainIntensity, ComIPduSignalRef=C_RDCU_RLSBrightnessFW, ComIPduSignalRef=C_RDCU_RLSDCbreA, ComIPduSignalRef=C_RDCU_RLSADCA, ComIPduSignalRef=C_RDCU_RLSDCbreB, ComIPduSignalRef=C_RDCU_RLSADCB, ComIPduSignalRef=C_FWiperSysFaultWarning
          ComTxIPdu: ComMinimumDelayTime=0.0, ComTxIPduUnusedAreasDefault=255
            ComTxModeTrue
              ComTxMode: ComTxModeTimePeriod=0, ComTxModeMode=DIRECT, ComTxModeNumberOfRepetitions=0, ComTxModeRepetitionPeriod=0, ComTxModeTimeOffset=0
            ComTxModeFalse
              ComTxMode: ComTxModeTimePeriod=0, ComTxModeMode=DIRECT, ComTxModeNumberOfRepetitions=0, ComTxModeRepetitionPeriod=0, ComTxModeTimeOffset=0
        C_RDCU_BodyCtrl2_Can_Network_0_CANNODE_0: ComIPduDirection=SEND, ComFirstTimeout=0.0, ComTimeout=0.0, ComIPduGroupRef=ComIPduGroup_Tx, ComPduIdRef=PduCollection/C_RDCU_BodyCtrl2_Can_Network_0_CANNODE_0_Com2PduR, ComIPduSignalRef=C_RDCU_BacklightBrightCtr, ComIPduSignalRef=C_RDCU_PLGAlarmReq, ComIPduSignalRef=C_RDCU_ChrgConnStReq, ComIPduSignalRef=C_RDCU_SecurityAccessReq, ComIPduSignalRef=C_ARSMotorCurrent, ComIPduSignalRef=C_ARSCurtHallCnt, ComIPduSignalRef=C_ARSWorkSt, ComIPduSignalRef=C_ARSTermalProtec, ComIPduSignalRef=C_ARSPstValu, ComIPduSignalRef=C_ARSFailureCause, ComIPduSignalRef=C_ARSAntiPinchSt
          ComTxIPdu: ComMinimumDelayTime=0.0, ComTxIPduUnusedAreasDefault=255
            ComTxModeTrue
              ComTxMode: ComTxModeTimePeriod=0, ComTxModeMode=DIRECT, ComTxModeNumberOfRepetitions=0, ComTxModeRepetitionPeriod=0, ComTxModeTimeOffset=0
            ComTxModeFalse
              ComTxMode: ComTxModeTimePeriod=0, ComTxModeMode=DIRECT, ComTxModeNumberOfRepetitions=0, ComTxModeRepetitionPeriod=0, ComTxModeTimeOffset=0
        C_RDCU_APBSysSt_Can_Network_0_CANNODE_0: ComIPduDirection=SEND, ComFirstTimeout=0.0, ComTimeout=0.0, ComIPduGroupRef=ComIPduGroup_Tx, ComPduIdRef=PduCollection/C_RDCU_APBSysSt_Can_Network_0_CANNODE_0_Com2PduR
          ComTxIPdu: ComMinimumDelayTime=0.0, ComTxIPduUnusedAreasDefault=255
            ComTxModeTrue
              ComTxMode: ComTxModeTimePeriod=0, ComTxModeMode=DIRECT, ComTxModeNumberOfRepetitions=0, ComTxModeRepetitionPeriod=0, ComTxModeTimeOffset=0
            ComTxModeFalse
              ComTxMode: ComTxModeTimePeriod=0, ComTxModeMode=DIRECT, ComTxModeNumberOfRepetitions=0, ComTxModeRepetitionPeriod=0, ComTxModeTimeOffset=0
    ComGeneral:
      ComVersionInfoApi = false
      ComCommonIPduTxPeriodFeature = false
      ComEnableJitterFilter = false
      ComEnableSignalGroupArrayApi = false
      ComCancellationSupport = false
      ComConfigurationUseDet = false
  module config CanSM: implementation-config-variant=VARIANT-PRE-COMPILE
    CanSMConfiguration: CanSMModeRequestRepetitionMax=5, CanSMModeRequestRepetitionTime=0.07
      CanSMManagerNetwork_Can_Network (CanSMManagerNetwork):
        CanSMBorTxConfirmationPolling = false
        CanSMBorCounterL1ToL2 = 0
        CanSMBorTimeL1 = 0.04
        CanSMBorTimeL2 = 0.1
        CanSMBorTimeTxEnsured = 0.02
        CanSMComMNetworkHandleRef = ComMChannel_Can_Network_Channel
        CanSMDemEventParameterRefs: CanSMRbDynCreate_CANSM_E_BUS_OFF=Standard
        CanSMController_Can_Network_CANNODE_0 (CanSMController): CanSMControllerId=CanIfCtrlDrvCfg/Can_Network_CANNODE_0
      CanSMManagerNetwork_Can_Network_0 (CanSMManagerNetwork):
        CanSMBorTxConfirmationPolling = false
        CanSMBorCounterL1ToL2 = 0
        CanSMBorTimeL1 = 0.04
        CanSMBorTimeL2 = 0.1
        CanSMBorTimeTxEnsured = 0.02
        CanSMComMNetworkHandleRef = ComMChannel_Can_Network_0_Channel
        CanSMDemEventParameterRefs: CanSMRbDynCreate_CANSM_E_BUS_OFF=Standard
        CanSMController_Can_Network_0_CANNODE_0 (CanSMController): CanSMControllerId=CanIfCtrlDrvCfg/Can_Network_0_CANNODE_0
    CanSMGeneral: CanSMMainFunctionTimePeriod=0.01, CanSMVersionInfoApi=false, CanSMDevErrorDetect=false
  module config ComM: implementation-config-variant=VARIANT-PRE-COMPILE
    ComMGeneral:
      ComMEcuGroupClassification = 0
      ComMModeLimitationEnabled = false
      ComMTMinFullComModeDuration = 0.01
      ComMVersionInfoApi = false
      ComMWakeupInhibitionEnabled = false
      ComMPncGatewayEnabled = false
      ComMPncSupport = false
      ComMResetAfterForcingNoComm = false
      ComMSynchronousWakeUp = false
      ComMRteEnabled = false
      ComMDevErrorDetect = false
    ComMConfigSet
      ComMUser_Can_Network_Channel (ComMUser)
      ComMChannel_Can_Network_Channel (ComMChannel):
        ComMMainFunctionPeriod = 0.01
        ComMFullCommRequestNotificationEnabled = false
        ComMNoCom = true
        ComMNoWakeUpInhibitionNvmStorage = false
        ComMNoWakeup = true
        ComMBusType = COMM_BUS_TYPE_CAN
        ComMNetworkManagement: ComMNmLightTimeout=10, ComMNmVariant=NONE, ComMPncNmRequest=false
        ComMUserPerChannel_Can_Network_Channel (ComMUserPerChannel): ComMUserChannel=ComMUser_Can_Network_Channel
      ComMUser_Can_Network_0_Channel (ComMUser)
      ComMChannel_Can_Network_0_Channel (ComMChannel):
        ComMMainFunctionPeriod = 0.01
        ComMFullCommRequestNotificationEnabled = false
        ComMNoCom = true
        ComMNoWakeUpInhibitionNvmStorage = false
        ComMNoWakeup = true
        ComMBusType = COMM_BUS_TYPE_CAN
        ComMNetworkManagement: ComMNmLightTimeout=10, ComMNmVariant=NONE, ComMPncNmRequest=false
        ComMUserPerChannel_Can_Network_0_Channel (ComMUserPerChannel): ComMUserChannel=ComMUser_Can_Network_0_Channel
  module config CanIf: implementation-config-variant=VARIANT-PRE-COMPILE
    CanIfInitCfg: CanIfInitCfgSet=0
      CanIfInitHohCfg
        26 x CanIfHrhCfg, all with CanIfHrhCanCtrlIdRef=CanIfCtrlDrvCfg/Can_Network_CANNODE_0:
          Can_Network_CANNODE_0_Rx_Std_MailBox_{1..26}: CanIfHrhIdSymRef=CanConfigSet/Can_Network_CANNODE_0_Rx_Std_MailBox_{1..26}
        4 x CanIfHthCfg, all with CanIfHthCanCtrlIdRef=CanIfCtrlDrvCfg/Can_Network_CANNODE_0:
          Can_Network_CANNODE_0_Tx_Std_MailBox_{1..4}: CanIfHthIdSymRef=CanConfigSet/Can_Network_CANNODE_0_Tx_Std_MailBox_{1..4}
        26 x CanIfHrhCfg, all with CanIfHrhCanCtrlIdRef=CanIfCtrlDrvCfg/Can_Network_0_CANNODE_0:
          Can_Network_0_CANNODE_0_Rx_Std_MailBox_{1..26}: CanIfHrhIdSymRef=CanConfigSet/Can_Network_0_CANNODE_0_Rx_Std_MailBox_{1..26}
        4 x CanIfHthCfg, all with CanIfHthCanCtrlIdRef=CanIfCtrlDrvCfg/Can_Network_0_CANNODE_0:
          Can_Network_0_CANNODE_0_Tx_Std_MailBox_{1..4}: CanIfHthIdSymRef=CanConfigSet/Can_Network_0_CANNODE_0_Tx_Std_MailBox_{1..4}
      26 x CanIfRxPduCfg, all with CanIfRxPduReadData=false, CanIfRxPduReadNotifyStatus=true, CanIfRxPduCanIdType=STANDARD_FD_CAN, CanIfRxPduUserRxIndicationName=PduR_CanIfRxIndication, CanIfRxPduUserRxIndicationUL=PDUR:
        C_LDCU_IPB_RaxleRegen_Can_Network_CANNODE_0: CanIfRxPduCanId=267, CanIfRxPduDlc=8, CanIfRxPduHrhIdRef=CanIfInitHohCfg/Can_Network_CANNODE_0_Rx_Std_MailBox_1, CanIfRxPduRef=PduCollection/C_LDCU_IPB_RaxleRegen_Can_Network_CANNODE_0_CanIf2PduR
        C_IPB_SpdEdges_Can_Network_CANNODE_0: CanIfRxPduCanId=298, CanIfRxPduDlc=8, CanIfRxPduHrhIdRef=CanIfInitHohCfg/Can_Network_CANNODE_0_Rx_Std_MailBox_2, CanIfRxPduRef=PduCollection/C_IPB_SpdEdges_Can_Network_CANNODE_0_CanIf2PduR
        C_IPB_SpdInfoR_Can_Network_CANNODE_0: CanIfRxPduCanId=296, CanIfRxPduDlc=8, CanIfRxPduHrhIdRef=CanIfInitHohCfg/Can_Network_CANNODE_0_Rx_Std_MailBox_3, CanIfRxPduRef=PduCollection/C_IPB_SpdInfoR_Can_Network_CANNODE_0_CanIf2PduR
        C_LDCU_EPB_APB_ROPP2_Can_Network_CANNODE_0: CanIfRxPduCanId=276, CanIfRxPduDlc=8, CanIfRxPduHrhIdRef=CanIfInitHohCfg/Can_Network_CANNODE_0_Rx_Std_MailBox_4, CanIfRxPduRef=PduCollection/C_LDCU_EPB_APB_ROPP2_Can_Network_CANNODE_0_CanIf2PduR
        C_IPB_SysSt_E2E_Can_Network_CANNODE_0: CanIfRxPduCanId=422, CanIfRxPduDlc=12, CanIfRxPduHrhIdRef=CanIfInitHohCfg/Can_Network_CANNODE_0_Rx_Std_MailBox_5, CanIfRxPduRef=PduCollection/C_IPB_SysSt_E2E_Can_Network_CANNODE_0_CanIf2PduR
        C_MFS_Status_Can_Network_CANNODE_0: CanIfRxPduCanId=497, CanIfRxPduDlc=8, CanIfRxPduHrhIdRef=CanIfInitHohCfg/Can_Network_CANNODE_0_Rx_Std_MailBox_6, CanIfRxPduRef=PduCollection/C_MFS_Status_Can_Network_CANNODE_0_CanIf2PduR
        C_IPB_SysSt1_Can_Network_CANNODE_0: CanIfRxPduCanId=278, CanIfRxPduDlc=8, CanIfRxPduHrhIdRef=CanIfInitHohCfg/Can_Network_CANNODE_0_Rx_Std_MailBox_7, CanIfRxPduRef=PduCollection/C_IPB_SysSt1_Can_Network_CANNODE_0_CanIf2PduR
        C_AS_SysSt2_Can_Network_CANNODE_0: CanIfRxPduCanId=658, CanIfRxPduDlc=48, CanIfRxPduHrhIdRef=CanIfInitHohCfg/Can_Network_CANNODE_0_Rx_Std_MailBox_8, CanIfRxPduRef=PduCollection/C_AS_SysSt2_Can_Network_CANNODE_0_CanIf2PduR
        C_LDCU_EPBDebugData_Can_Network_CANNODE_0: CanIfRxPduCanId=1552, CanIfRxPduDlc=8, CanIfRxPduHrhIdRef=CanIfInitHohCfg/Can_Network_CANNODE_0_Rx_Std_MailBox_9, CanIfRxPduRef=PduCollection/C_LDCU_EPBDebugData_Can_Network_CANNODE_0_CanIf2PduR
        C_XPU_IPB_ADASToqCtrl_Can_Network_CANNODE_0: CanIfRxPduCanId=256, CanIfRxPduDlc=8, CanIfRxPduHrhIdRef=CanIfInitHohCfg/Can_Network_CANNODE_0_Rx_Std_MailBox_10, CanIfRxPduRef=PduCollection/C_XPU_IPB_ADASToqCtrl_Can_Network_CANNODE_0_CanIf2PduR
        C_IPB_SpdInfoF_Can_Network_CANNODE_0: CanIfRxPduCanId=295, CanIfRxPduDlc=8, CanIfRxPduHrhIdRef=CanIfInitHohCfg/Can_Network_CANNODE_0_Rx_Std_MailBox_11, CanIfRxPduRef=PduCollection/C_IPB_SpdInfoF_Can_Network_CANNODE_0_CanIf2PduR
        C_IPB_SpdInfo_E2E_Can_Network_CANNODE_0: CanIfRxPduCanId=294, CanIfRxPduDlc=16, CanIfRxPduHrhIdRef=CanIfInitHohCfg/Can_Network_CANNODE_0_Rx_Std_MailBox_12, CanIfRxPduRef=PduCollection/C_IPB_SpdInfo_E2E_Can_Network_CANNODE_0_CanIf2PduR
        C_AS_SysSt1_Can_Network_CANNODE_0: CanIfRxPduCanId=399, CanIfRxPduDlc=8, CanIfRxPduHrhIdRef=CanIfInitHohCfg/Can_Network_CANNODE_0_Rx_Std_MailBox_13, CanIfRxPduRef=PduCollection/C_AS_SysSt1_Can_Network_CANNODE_0_CanIf2PduR
        C_LDCU_BodySysSt1_Can_Network_CANNODE_0: CanIfRxPduCanId=548, CanIfRxPduDlc=8, CanIfRxPduHrhIdRef=CanIfInitHohCfg/Can_Network_CANNODE_0_Rx_Std_MailBox_14, CanIfRxPduRef=PduCollection/C_LDCU_BodySysSt1_Can_Network_CANNODE_0_CanIf2PduR
        C_CDCU_ChassisCtrl_Can_Network_CANNODE_0: CanIfRxPduCanId=704, CanIfRxPduDlc=8, CanIfRxPduHrhIdRef=CanIfInitHohCfg/Can_Network_CANNODE_0_Rx_Std_MailBox_15, CanIfRxPduRef=PduCollection/C_CDCU_ChassisCtrl_Can_Network_CANNODE_0_CanIf2PduR
        C_IPB_CylinderPressure2_Can_Network_CANNODE_0: CanIfRxPduCanId=272, CanIfRxPduDlc=8, CanIfRxPduHrhIdRef=CanIfInitHohCfg/Can_Network_CANNODE_0_Rx_Std_MailBox_16, CanIfRxPduRef=PduCollection/C_IPB_CylinderPressure2_Can_Network_CANNODE_0_CanIf2PduR
        C_IPB_SysSt_Can_Network_CANNODE_0: CanIfRxPduCanId=423, CanIfRxPduDlc=8, CanIfRxPduHrhIdRef=CanIfInitHohCfg/Can_Network_CANNODE_0_Rx_Std_MailBox_17, CanIfRxPduRef=PduCollection/C_IPB_SysSt_Can_Network_CANNODE_0_CanIf2PduR
        C_LDCU_RTorqInfo_Can_Network_CANNODE_0: CanIfRxPduCanId=262, CanIfRxPduDlc=8, CanIfRxPduHrhIdRef=CanIfInitHohCfg/Can_Network_CANNODE_0_Rx_Std_MailBox_18, CanIfRxPduRef=PduCollection/C_LDCU_RTorqInfo_Can_Network_CANNODE_0_CanIf2PduR
        C_IPB_Accel_Can_Network_CANNODE_0: CanIfRxPduCanId=424, CanIfRxPduDlc=8, CanIfRxPduHrhIdRef=CanIfInitHohCfg/Can_Network_CANNODE_0_Rx_Std_MailBox_19, CanIfRxPduRef=PduCollection/C_IPB_Accel_Can_Network_CANNODE_0_CanIf2PduR
        C_LDCU_SysSt_Can_Network_CANNODE_0: CanIfRxPduCanId=279, CanIfRxPduDlc=8, CanIfRxPduHrhIdRef=CanIfInitHohCfg/Can_Network_CANNODE_0_Rx_Std_MailBox_20, CanIfRxPduRef=PduCollection/C_LDCU_SysSt_Can_Network_CANNODE_0_CanIf2PduR
        C_LDCU_FTorqInfo_Can_Network_CANNODE_0: CanIfRxPduCanId=263, CanIfRxPduDlc=8, CanIfRxPduHrhIdRef=CanIfInitHohCfg/Can_Network_CANNODE_0_Rx_Std_MailBox_21, CanIfRxPduRef=PduCollection/C_LDCU_FTorqInfo_Can_Network_CANNODE_0_CanIf2PduR
        C_LDCU_APBSysSt_Can_Network_CANNODE_0: CanIfRxPduCanId=436, CanIfRxPduDlc=8, CanIfRxPduHrhIdRef=CanIfInitHohCfg/Can_Network_CANNODE_0_Rx_Std_MailBox_22, CanIfRxPduRef=PduCollection/C_LDCU_APBSysSt_Can_Network_CANNODE_0_CanIf2PduR
        C_IPB_SysSt2_Can_Network_CANNODE_0: CanIfRxPduCanId=394, CanIfRxPduDlc=8, CanIfRxPduHrhIdRef=CanIfInitHohCfg/Can_Network_CANNODE_0_Rx_Std_MailBox_23, CanIfRxPduRef=PduCollection/C_IPB_SysSt2_Can_Network_CANNODE_0_CanIf2PduR
        C_AS_SysSt3_Can_Network_CANNODE_0: CanIfRxPduCanId=659, CanIfRxPduDlc=8, CanIfRxPduHrhIdRef=CanIfInitHohCfg/Can_Network_CANNODE_0_Rx_Std_MailBox_24, CanIfRxPduRef=PduCollection/C_AS_SysSt3_Can_Network_CANNODE_0_CanIf2PduR
        C_IPB_APBSysSt_Can_Network_CANNODE_0: CanIfRxPduCanId=434, CanIfRxPduDlc=8, CanIfRxPduHrhIdRef=CanIfInitHohCfg/Can_Network_CANNODE_0_Rx_Std_MailBox_25, CanIfRxPduRef=PduCollection/C_IPB_APBSysSt_Can_Network_CANNODE_0_CanIf2PduR
        C_LDCU_IPB_FaxleRegen_Can_Network_CANNODE_0: CanIfRxPduCanId=266, CanIfRxPduDlc=8, CanIfRxPduHrhIdRef=CanIfInitHohCfg/Can_Network_CANNODE_0_Rx_Std_MailBox_26, CanIfRxPduRef=PduCollection/C_LDCU_IPB_FaxleRegen_Can_Network_CANNODE_0_CanIf2PduR
      Buffer_Can_Network_CANNODE_0_Tx_Std_MailBox_1 (CanIfBufferCfg): CanIfBufferSize=0, CanIfBufferHthRef=CanIfInitHohCfg/Can_Network_CANNODE_0_Tx_Std_MailBox_1
      C_RDCU_IPB_APB_ROPP_Can_Network_CANNODE_0 (CanIfTxPduCfg):
        CanIfTxPduReadNotifyStatus = false
        CanIfTxPduType = STATIC
        CanIfTxPduTruncation = false
        CanIfTxPduCanIdType = STANDARD_FD_CAN
        CanIfTxPduCanId = 280
        CanIfTxPduUserTxConfirmationUL = PDUR
        CanIfTxPduBufferRef = Buffer_Can_Network_CANNODE_0_Tx_Std_MailBox_1
        CanIfTxPduRef = PduCollection/C_RDCU_IPB_APB_ROPP_Can_Network_CANNODE_0_PduR2CanIf
      Buffer_Can_Network_CANNODE_0_Tx_Std_MailBox_2 (CanIfBufferCfg): CanIfBufferSize=0, CanIfBufferHthRef=CanIfInitHohCfg/Can_Network_CANNODE_0_Tx_Std_MailBox_2
      C_RDCU_RLIN3Info_Can_Network_CANNODE_0 (CanIfTxPduCfg):
        CanIfTxPduReadNotifyStatus = false
        CanIfTxPduType = STATIC
        CanIfTxPduTruncation = false
        CanIfTxPduCanIdType = STANDARD_FD_CAN
        CanIfTxPduCanId = 575
        CanIfTxPduUserTxConfirmationUL = PDUR
        CanIfTxPduBufferRef = Buffer_Can_Network_CANNODE_0_Tx_Std_MailBox_2
        CanIfTxPduRef = PduCollection/C_RDCU_RLIN3Info_Can_Network_CANNODE_0_PduR2CanIf
      Buffer_Can_Network_CANNODE_0_Tx_Std_MailBox_3 (CanIfBufferCfg): CanIfBufferSize=0, CanIfBufferHthRef=CanIfInitHohCfg/Can_Network_CANNODE_0_Tx_Std_MailBox_3
      C_RDCU_BodyCtrl2_Can_Network_CANNODE_0 (CanIfTxPduCfg):
        CanIfTxPduReadNotifyStatus = false
        CanIfTxPduType = STATIC
        CanIfTxPduTruncation = false
        CanIfTxPduCanIdType = STANDARD_FD_CAN
        CanIfTxPduCanId = 541
        CanIfTxPduUserTxConfirmationUL = PDUR
        CanIfTxPduBufferRef = Buffer_Can_Network_CANNODE_0_Tx_Std_MailBox_3
        CanIfTxPduRef = PduCollection/C_RDCU_BodyCtrl2_Can_Network_CANNODE_0_PduR2CanIf
      Buffer_Can_Network_CANNODE_0_Tx_Std_MailBox_4 (CanIfBufferCfg): CanIfBufferSize=0, CanIfBufferHthRef=CanIfInitHohCfg/Can_Network_CANNODE_0_Tx_Std_MailBox_4
      C_RDCU_APBSysSt_Can_Network_CANNODE_0 (CanIfTxPduCfg):
        CanIfTxPduReadNotifyStatus = false
        CanIfTxPduType = STATIC
        CanIfTxPduTruncation = false
        CanIfTxPduCanIdType = STANDARD_FD_CAN
        CanIfTxPduCanId = 435
        CanIfTxPduUserTxConfirmationUL = PDUR
        CanIfTxPduBufferRef = Buffer_Can_Network_CANNODE_0_Tx_Std_MailBox_4
        CanIfTxPduRef = PduCollection/C_RDCU_APBSysSt_Can_Network_CANNODE_0_PduR2CanIf
      26 x CanIfRxPduCfg, all with CanIfRxPduReadData=false, CanIfRxPduReadNotifyStatus=true, CanIfRxPduCanIdType=STANDARD_FD_CAN, CanIfRxPduUserRxIndicationName=PduR_CanIfRxIndication, CanIfRxPduUserRxIndicationUL=PDUR:
        C_LDCU_IPB_RaxleRegen_Can_Network_0_CANNODE_0: CanIfRxPduCanId=267, CanIfRxPduDlc=8, CanIfRxPduHrhIdRef=CanIfInitHohCfg/Can_Network_0_CANNODE_0_Rx_Std_MailBox_1, CanIfRxPduRef=PduCollection/C_LDCU_IPB_RaxleRegen_Can_Network_0_CANNODE_0_CanIf2PduR
        C_IPB_SpdEdges_Can_Network_0_CANNODE_0: CanIfRxPduCanId=298, CanIfRxPduDlc=8, CanIfRxPduHrhIdRef=CanIfInitHohCfg/Can_Network_0_CANNODE_0_Rx_Std_MailBox_2, CanIfRxPduRef=PduCollection/C_IPB_SpdEdges_Can_Network_0_CANNODE_0_CanIf2PduR
        C_IPB_SpdInfoR_Can_Network_0_CANNODE_0: CanIfRxPduCanId=296, CanIfRxPduDlc=8, CanIfRxPduHrhIdRef=CanIfInitHohCfg/Can_Network_0_CANNODE_0_Rx_Std_MailBox_3, CanIfRxPduRef=PduCollection/C_IPB_SpdInfoR_Can_Network_0_CANNODE_0_CanIf2PduR
        C_LDCU_EPB_APB_ROPP2_Can_Network_0_CANNODE_0: CanIfRxPduCanId=276, CanIfRxPduDlc=8, CanIfRxPduHrhIdRef=CanIfInitHohCfg/Can_Network_0_CANNODE_0_Rx_Std_MailBox_4, CanIfRxPduRef=PduCollection/C_LDCU_EPB_APB_ROPP2_Can_Network_0_CANNODE_0_CanIf2PduR
        C_IPB_SysSt_E2E_Can_Network_0_CANNODE_0: CanIfRxPduCanId=422, CanIfRxPduDlc=12, CanIfRxPduHrhIdRef=CanIfInitHohCfg/Can_Network_0_CANNODE_0_Rx_Std_MailBox_5, CanIfRxPduRef=PduCollection/C_IPB_SysSt_E2E_Can_Network_0_CANNODE_0_CanIf2PduR
        C_MFS_Status_Can_Network_0_CANNODE_0: CanIfRxPduCanId=497, CanIfRxPduDlc=8, CanIfRxPduHrhIdRef=CanIfInitHohCfg/Can_Network_0_CANNODE_0_Rx_Std_MailBox_6, CanIfRxPduRef=PduCollection/C_MFS_Status_Can_Network_0_CANNODE_0_CanIf2PduR
        C_IPB_SysSt1_Can_Network_0_CANNODE_0: CanIfRxPduCanId=278, CanIfRxPduDlc=8, CanIfRxPduHrhIdRef=CanIfInitHohCfg/Can_Network_0_CANNODE_0_Rx_Std_MailBox_7, CanIfRxPduRef=PduCollection/C_IPB_SysSt1_Can_Network_0_CANNODE_0_CanIf2PduR
        C_AS_SysSt2_Can_Network_0_CANNODE_0: CanIfRxPduCanId=658, CanIfRxPduDlc=48, CanIfRxPduHrhIdRef=CanIfInitHohCfg/Can_Network_0_CANNODE_0_Rx_Std_MailBox_8, CanIfRxPduRef=PduCollection/C_AS_SysSt2_Can_Network_0_CANNODE_0_CanIf2PduR
        C_LDCU_EPBDebugData_Can_Network_0_CANNODE_0: CanIfRxPduCanId=1552, CanIfRxPduDlc=8, CanIfRxPduHrhIdRef=CanIfInitHohCfg/Can_Network_0_CANNODE_0_Rx_Std_MailBox_9, CanIfRxPduRef=PduCollection/C_LDCU_EPBDebugData_Can_Network_0_CANNODE_0_CanIf2PduR
        C_XPU_IPB_ADASToqCtrl_Can_Network_0_CANNODE_0: CanIfRxPduCanId=256, CanIfRxPduDlc=8, CanIfRxPduHrhIdRef=CanIfInitHohCfg/Can_Network_0_CANNODE_0_Rx_Std_MailBox_10, CanIfRxPduRef=PduCollection/C_XPU_IPB_ADASToqCtrl_Can_Network_0_CANNODE_0_CanIf2PduR
        C_IPB_SpdInfoF_Can_Network_0_CANNODE_0: CanIfRxPduCanId=295, CanIfRxPduDlc=8, CanIfRxPduHrhIdRef=CanIfInitHohCfg/Can_Network_0_CANNODE_0_Rx_Std_MailBox_11, CanIfRxPduRef=PduCollection/C_IPB_SpdInfoF_Can_Network_0_CANNODE_0_CanIf2PduR
        C_IPB_SpdInfo_E2E_Can_Network_0_CANNODE_0: CanIfRxPduCanId=294, CanIfRxPduDlc=16, CanIfRxPduHrhIdRef=CanIfInitHohCfg/Can_Network_0_CANNODE_0_Rx_Std_MailBox_12, CanIfRxPduRef=PduCollection/C_IPB_SpdInfo_E2E_Can_Network_0_CANNODE_0_CanIf2PduR
        C_AS_SysSt1_Can_Network_0_CANNODE_0: CanIfRxPduCanId=399, CanIfRxPduDlc=8, CanIfRxPduHrhIdRef=CanIfInitHohCfg/Can_Network_0_CANNODE_0_Rx_Std_MailBox_13, CanIfRxPduRef=PduCollection/C_AS_SysSt1_Can_Network_0_CANNODE_0_CanIf2PduR
        C_LDCU_BodySysSt1_Can_Network_0_CANNODE_0: CanIfRxPduCanId=548, CanIfRxPduDlc=8, CanIfRxPduHrhIdRef=CanIfInitHohCfg/Can_Network_0_CANNODE_0_Rx_Std_MailBox_14, CanIfRxPduRef=PduCollection/C_LDCU_BodySysSt1_Can_Network_0_CANNODE_0_CanIf2PduR
        C_CDCU_ChassisCtrl_Can_Network_0_CANNODE_0: CanIfRxPduCanId=704, CanIfRxPduDlc=8, CanIfRxPduHrhIdRef=CanIfInitHohCfg/Can_Network_0_CANNODE_0_Rx_Std_MailBox_15, CanIfRxPduRef=PduCollection/C_CDCU_ChassisCtrl_Can_Network_0_CANNODE_0_CanIf2PduR
        C_IPB_CylinderPressure2_Can_Network_0_CANNODE_0: CanIfRxPduCanId=272, CanIfRxPduDlc=8, CanIfRxPduHrhIdRef=CanIfInitHohCfg/Can_Network_0_CANNODE_0_Rx_Std_MailBox_16, CanIfRxPduRef=PduCollection/C_IPB_CylinderPressure2_Can_Network_0_CANNODE_0_CanIf2PduR
        C_IPB_SysSt_Can_Network_0_CANNODE_0: CanIfRxPduCanId=423, CanIfRxPduDlc=8, CanIfRxPduHrhIdRef=CanIfInitHohCfg/Can_Network_0_CANNODE_0_Rx_Std_MailBox_17, CanIfRxPduRef=PduCollection/C_IPB_SysSt_Can_Network_0_CANNODE_0_CanIf2PduR
        C_LDCU_RTorqInfo_Can_Network_0_CANNODE_0: CanIfRxPduCanId=262, CanIfRxPduDlc=8, CanIfRxPduHrhIdRef=CanIfInitHohCfg/Can_Network_0_CANNODE_0_Rx_Std_MailBox_18, CanIfRxPduRef=PduCollection/C_LDCU_RTorqInfo_Can_Network_0_CANNODE_0_CanIf2PduR
        C_IPB_Accel_Can_Network_0_CANNODE_0: CanIfRxPduCanId=424, CanIfRxPduDlc=8, CanIfRxPduHrhIdRef=CanIfInitHohCfg/Can_Network_0_CANNODE_0_Rx_Std_MailBox_19, CanIfRxPduRef=PduCollection/C_IPB_Accel_Can_Network_0_CANNODE_0_CanIf2PduR
        C_LDCU_SysSt_Can_Network_0_CANNODE_0: CanIfRxPduCanId=279, CanIfRxPduDlc=8, CanIfRxPduHrhIdRef=CanIfInitHohCfg/Can_Network_0_CANNODE_0_Rx_Std_MailBox_20, CanIfRxPduRef=PduCollection/C_LDCU_SysSt_Can_Network_0_CANNODE_0_CanIf2PduR
        C_LDCU_FTorqInfo_Can_Network_0_CANNODE_0: CanIfRxPduCanId=263, CanIfRxPduDlc=8, CanIfRxPduHrhIdRef=CanIfInitHohCfg/Can_Network_0_CANNODE_0_Rx_Std_MailBox_21, CanIfRxPduRef=PduCollection/C_LDCU_FTorqInfo_Can_Network_0_CANNODE_0_CanIf2PduR
        C_LDCU_APBSysSt_Can_Network_0_CANNODE_0: CanIfRxPduCanId=436, CanIfRxPduDlc=8, CanIfRxPduHrhIdRef=CanIfInitHohCfg/Can_Network_0_CANNODE_0_Rx_Std_MailBox_22, CanIfRxPduRef=PduCollection/C_LDCU_APBSysSt_Can_Network_0_CANNODE_0_CanIf2PduR
        C_IPB_SysSt2_Can_Network_0_CANNODE_0: CanIfRxPduCanId=394, CanIfRxPduDlc=8, CanIfRxPduHrhIdRef=CanIfInitHohCfg/Can_Network_0_CANNODE_0_Rx_Std_MailBox_23, CanIfRxPduRef=PduCollection/C_IPB_SysSt2_Can_Network_0_CANNODE_0_CanIf2PduR
        C_AS_SysSt3_Can_Network_0_CANNODE_0: CanIfRxPduCanId=659, CanIfRxPduDlc=8, CanIfRxPduHrhIdRef=CanIfInitHohCfg/Can_Network_0_CANNODE_0_Rx_Std_MailBox_24, CanIfRxPduRef=PduCollection/C_AS_SysSt3_Can_Network_0_CANNODE_0_CanIf2PduR
        C_IPB_APBSysSt_Can_Network_0_CANNODE_0: CanIfRxPduCanId=434, CanIfRxPduDlc=8, CanIfRxPduHrhIdRef=CanIfInitHohCfg/Can_Network_0_CANNODE_0_Rx_Std_MailBox_25, CanIfRxPduRef=PduCollection/C_IPB_APBSysSt_Can_Network_0_CANNODE_0_CanIf2PduR
        C_LDCU_IPB_FaxleRegen_Can_Network_0_CANNODE_0: CanIfRxPduCanId=266, CanIfRxPduDlc=8, CanIfRxPduHrhIdRef=CanIfInitHohCfg/Can_Network_0_CANNODE_0_Rx_Std_MailBox_26, CanIfRxPduRef=PduCollection/C_LDCU_IPB_FaxleRegen_Can_Network_0_CANNODE_0_CanIf2PduR
      Buffer_Can_Network_0_CANNODE_0_Tx_Std_MailBox_1 (CanIfBufferCfg): CanIfBufferSize=0, CanIfBufferHthRef=CanIfInitHohCfg/Can_Network_0_CANNODE_0_Tx_Std_MailBox_1
      C_RDCU_IPB_APB_ROPP_Can_Network_0_CANNODE_0 (CanIfTxPduCfg):
        CanIfTxPduReadNotifyStatus = false
        CanIfTxPduType = STATIC
        CanIfTxPduTruncation = false
        CanIfTxPduCanIdType = STANDARD_FD_CAN
        CanIfTxPduCanId = 280
        CanIfTxPduUserTxConfirmationUL = PDUR
        CanIfTxPduBufferRef = Buffer_Can_Network_0_CANNODE_0_Tx_Std_MailBox_1
        CanIfTxPduRef = PduCollection/C_RDCU_IPB_APB_ROPP_Can_Network_0_CANNODE_0_PduR2CanIf
      Buffer_Can_Network_0_CANNODE_0_Tx_Std_MailBox_2 (CanIfBufferCfg): CanIfBufferSize=0, CanIfBufferHthRef=CanIfInitHohCfg/Can_Network_0_CANNODE_0_Tx_Std_MailBox_2
      C_RDCU_RLIN3Info_Can_Network_0_CANNODE_0 (CanIfTxPduCfg):
        CanIfTxPduReadNotifyStatus = false
        CanIfTxPduType = STATIC
        CanIfTxPduTruncation = false
        CanIfTxPduCanIdType = STANDARD_FD_CAN
        CanIfTxPduCanId = 575
        CanIfTxPduUserTxConfirmationUL = PDUR
        CanIfTxPduBufferRef = Buffer_Can_Network_0_CANNODE_0_Tx_Std_MailBox_2
        CanIfTxPduRef = PduCollection/C_RDCU_RLIN3Info_Can_Network_0_CANNODE_0_PduR2CanIf
      Buffer_Can_Network_0_CANNODE_0_Tx_Std_MailBox_3 (CanIfBufferCfg): CanIfBufferSize=0, CanIfBufferHthRef=CanIfInitHohCfg/Can_Network_0_CANNODE_0_Tx_Std_MailBox_3
      C_RDCU_BodyCtrl2_Can_Network_0_CANNODE_0 (CanIfTxPduCfg):
        CanIfTxPduReadNotifyStatus = false
        CanIfTxPduType = STATIC
        CanIfTxPduTruncation = false
        CanIfTxPduCanIdType = STANDARD_FD_CAN
        CanIfTxPduCanId = 541
        CanIfTxPduUserTxConfirmationUL = PDUR
        CanIfTxPduBufferRef = Buffer_Can_Network_0_CANNODE_0_Tx_Std_MailBox_3
        CanIfTxPduRef = PduCollection/C_RDCU_BodyCtrl2_Can_Network_0_CANNODE_0_PduR2CanIf
      Buffer_Can_Network_0_CANNODE_0_Tx_Std_MailBox_4 (CanIfBufferCfg): CanIfBufferSize=0, CanIfBufferHthRef=CanIfInitHohCfg/Can_Network_0_CANNODE_0_Tx_Std_MailBox_4
      C_RDCU_APBSysSt_Can_Network_0_CANNODE_0 (CanIfTxPduCfg):
        CanIfTxPduReadNotifyStatus = false
        CanIfTxPduType = STATIC
        CanIfTxPduTruncation = false
        CanIfTxPduCanIdType = STANDARD_FD_CAN
        CanIfTxPduCanId = 435
        CanIfTxPduUserTxConfirmationUL = PDUR
        CanIfTxPduBufferRef = Buffer_Can_Network_0_CANNODE_0_Tx_Std_MailBox_4
        CanIfTxPduRef = PduCollection/C_RDCU_APBSysSt_Can_Network_0_CANNODE_0_PduR2CanIf
    CanIfCtrlDrvCfg: CanIfRbCtrlDrvPrefix=CanConf_CanHardwareObject, CanIfCtrlDrvNameRef=CanGeneral, CanIfCtrlDrvInitHohConfigRef=CanIfInitHohCfg
      Can_Network_CANNODE_0 (CanIfCtrlCfg): CanIfCtrlWakeupSupport=false, CanIfCtrlCanCtrlRef=CanConfigSet/Can_Network_CANNODE_0
      Can_Network_0_CANNODE_0 (CanIfCtrlCfg): CanIfCtrlWakeupSupport=false, CanIfCtrlCanCtrlRef=CanConfigSet/Can_Network_0_CANNODE_0
    CanIfDispatchCfg: CanIfDispatchUserCtrlBusOffUL=CAN_SM, CanIfDispatchUserCtrlModeIndicationUL=CAN_SM, CanIfDispatchUserTrcvModeIndicationName=CAN_SM
    CanIfPrivateCfg: CanIfPrivateDlcCheck=false
    CanIfPublicCfg:
      CanIfPublicReadRxPduDataApi = false
      CanIfPublicReadRxPduNotifyStatusApi = true
      CanIfPublicReadTxPduNotifyStatusApi = true
      CanIfPublicSetDynamicTxIdApi = false
      CanIfPublicTxBuffering = false
      CanIfPublicTxConfirmPollingSupport = false
      CanIfPublicVersionInfoApi = false
      CanIfPublicCancelTransmitSupport = false
      CanIfPublicErrorPassiveSupport = false
      CanIfPublicMultipleDrvSupport = false
      CanIfPublicCanIfLiteConfiguration = false
      CanIfPublicUserTpTxInOfflineMode = false
      CanIfPublicWakeupCheckValidSupport = false
      CanIfPublicPnSupport = false
      CanIfPublicBusoffRecoveryfromRxIndication = false
      CanIfTriggerTransmitSupport = false
      CanIfTxOfflineActiveSupport = false
      CanIfWakeupSupport = false
      CanIfPublicDevErrorDetect = false
      CanIfRbCalibrationSupport: CanIfRbCalibration=false
  module config EcuC: implementation-config-variant=VARIANT-PRE-COMPILE
    EcucConfigSet
      PduCollection (EcucPduCollection): PduIdTypeEnum=uint16, PduLengthTypeEnum=uint16
        120 x Pdu:
          C_LDCU_IPB_RaxleRegen_Can_Network_CANNODE_0_CanIf2PduR: PduLength=8
          C_LDCU_IPB_RaxleRegen_Can_Network_CANNODE_0_PduR2Com: PduLength=8
          C_IPB_SpdEdges_Can_Network_CANNODE_0_CanIf2PduR: PduLength=8
          C_IPB_SpdEdges_Can_Network_CANNODE_0_PduR2Com: PduLength=8
          C_IPB_SpdInfoR_Can_Network_CANNODE_0_CanIf2PduR: PduLength=8
          C_IPB_SpdInfoR_Can_Network_CANNODE_0_PduR2Com: PduLength=8
          C_LDCU_EPB_APB_ROPP2_Can_Network_CANNODE_0_CanIf2PduR: PduLength=8
          C_LDCU_EPB_APB_ROPP2_Can_Network_CANNODE_0_PduR2Com: PduLength=8
          C_IPB_SysSt_E2E_Can_Network_CANNODE_0_CanIf2PduR: PduLength=12
          C_IPB_SysSt_E2E_Can_Network_CANNODE_0_PduR2Com: PduLength=12
          C_MFS_Status_Can_Network_CANNODE_0_CanIf2PduR: PduLength=8
          C_MFS_Status_Can_Network_CANNODE_0_PduR2Com: PduLength=8
          C_IPB_SysSt1_Can_Network_CANNODE_0_CanIf2PduR: PduLength=8
          C_IPB_SysSt1_Can_Network_CANNODE_0_PduR2Com: PduLength=8
          C_AS_SysSt2_Can_Network_CANNODE_0_CanIf2PduR: PduLength=48
          C_AS_SysSt2_Can_Network_CANNODE_0_PduR2Com: PduLength=48
          C_LDCU_EPBDebugData_Can_Network_CANNODE_0_CanIf2PduR: PduLength=8
          C_LDCU_EPBDebugData_Can_Network_CANNODE_0_PduR2Com: PduLength=8
          C_XPU_IPB_ADASToqCtrl_Can_Network_CANNODE_0_CanIf2PduR: PduLength=8
          C_XPU_IPB_ADASToqCtrl_Can_Network_CANNODE_0_PduR2Com: PduLength=8
          C_IPB_SpdInfoF_Can_Network_CANNODE_0_CanIf2PduR: PduLength=8
          C_IPB_SpdInfoF_Can_Network_CANNODE_0_PduR2Com: PduLength=8
          C_IPB_SpdInfo_E2E_Can_Network_CANNODE_0_CanIf2PduR: PduLength=16
          C_IPB_SpdInfo_E2E_Can_Network_CANNODE_0_PduR2Com: PduLength=16
          C_AS_SysSt1_Can_Network_CANNODE_0_CanIf2PduR: PduLength=8
          C_AS_SysSt1_Can_Network_CANNODE_0_PduR2Com: PduLength=8
          C_LDCU_BodySysSt1_Can_Network_CANNODE_0_CanIf2PduR: PduLength=8
          C_LDCU_BodySysSt1_Can_Network_CANNODE_0_PduR2Com: PduLength=8
          C_CDCU_ChassisCtrl_Can_Network_CANNODE_0_CanIf2PduR: PduLength=8
          C_CDCU_ChassisCtrl_Can_Network_CANNODE_0_PduR2Com: PduLength=8
          C_IPB_CylinderPressure2_Can_Network_CANNODE_0_CanIf2PduR: PduLength=8
          C_IPB_CylinderPressure2_Can_Network_CANNODE_0_PduR2Com: PduLength=8
          C_IPB_SysSt_Can_Network_CANNODE_0_CanIf2PduR: PduLength=8
          C_IPB_SysSt_Can_Network_CANNODE_0_PduR2Com: PduLength=8
          C_LDCU_RTorqInfo_Can_Network_CANNODE_0_CanIf2PduR: PduLength=8
          C_LDCU_RTorqInfo_Can_Network_CANNODE_0_PduR2Com: PduLength=8
          C_IPB_Accel_Can_Network_CANNODE_0_CanIf2PduR: PduLength=8
          C_IPB_Accel_Can_Network_CANNODE_0_PduR2Com: PduLength=8
          C_LDCU_SysSt_Can_Network_CANNODE_0_CanIf2PduR: PduLength=8
          C_LDCU_SysSt_Can_Network_CANNODE_0_PduR2Com: PduLength=8
          C_LDCU_FTorqInfo_Can_Network_CANNODE_0_CanIf2PduR: PduLength=8
          C_LDCU_FTorqInfo_Can_Network_CANNODE_0_PduR2Com: PduLength=8
          C_LDCU_APBSysSt_Can_Network_CANNODE_0_CanIf2PduR: PduLength=8
          C_LDCU_APBSysSt_Can_Network_CANNODE_0_PduR2Com: PduLength=8
          C_IPB_SysSt2_Can_Network_CANNODE_0_CanIf2PduR: PduLength=8
          C_IPB_SysSt2_Can_Network_CANNODE_0_PduR2Com: PduLength=8
          C_AS_SysSt3_Can_Network_CANNODE_0_CanIf2PduR: PduLength=8
          C_AS_SysSt3_Can_Network_CANNODE_0_PduR2Com: PduLength=8
          C_IPB_APBSysSt_Can_Network_CANNODE_0_CanIf2PduR: PduLength=8
          C_IPB_APBSysSt_Can_Network_CANNODE_0_PduR2Com: PduLength=8
          C_LDCU_IPB_FaxleRegen_Can_Network_CANNODE_0_CanIf2PduR: PduLength=8
          C_LDCU_IPB_FaxleRegen_Can_Network_CANNODE_0_PduR2Com: PduLength=8
          C_RDCU_IPB_APB_ROPP_Can_Network_CANNODE_0_Com2PduR: PduLength=8
          C_RDCU_IPB_APB_ROPP_Can_Network_CANNODE_0_PduR2CanIf: PduLength=8
          C_RDCU_RLIN3Info_Can_Network_CANNODE_0_Com2PduR: PduLength=24
          C_RDCU_RLIN3Info_Can_Network_CANNODE_0_PduR2CanIf: PduLength=24
          C_RDCU_BodyCtrl2_Can_Network_CANNODE_0_Com2PduR: PduLength=8
          C_RDCU_BodyCtrl2_Can_Network_CANNODE_0_PduR2CanIf: PduLength=8
          C_RDCU_APBSysSt_Can_Network_CANNODE_0_Com2PduR: PduLength=8
          C_RDCU_APBSysSt_Can_Network_CANNODE_0_PduR2CanIf: PduLength=8
          C_LDCU_IPB_RaxleRegen_Can_Network_0_CANNODE_0_CanIf2PduR: PduLength=8
          C_LDCU_IPB_RaxleRegen_Can_Network_0_CANNODE_0_PduR2Com: PduLength=8
          C_IPB_SpdEdges_Can_Network_0_CANNODE_0_CanIf2PduR: PduLength=8
          C_IPB_SpdEdges_Can_Network_0_CANNODE_0_PduR2Com: PduLength=8
          C_IPB_SpdInfoR_Can_Network_0_CANNODE_0_CanIf2PduR: PduLength=8
          C_IPB_SpdInfoR_Can_Network_0_CANNODE_0_PduR2Com: PduLength=8
          C_LDCU_EPB_APB_ROPP2_Can_Network_0_CANNODE_0_CanIf2PduR: PduLength=8
          C_LDCU_EPB_APB_ROPP2_Can_Network_0_CANNODE_0_PduR2Com: PduLength=8
          C_IPB_SysSt_E2E_Can_Network_0_CANNODE_0_CanIf2PduR: PduLength=12
          C_IPB_SysSt_E2E_Can_Network_0_CANNODE_0_PduR2Com: PduLength=12
          C_MFS_Status_Can_Network_0_CANNODE_0_CanIf2PduR: PduLength=8
          C_MFS_Status_Can_Network_0_CANNODE_0_PduR2Com: PduLength=8
          C_IPB_SysSt1_Can_Network_0_CANNODE_0_CanIf2PduR: PduLength=8
          C_IPB_SysSt1_Can_Network_0_CANNODE_0_PduR2Com: PduLength=8
          C_AS_SysSt2_Can_Network_0_CANNODE_0_CanIf2PduR: PduLength=48
          C_AS_SysSt2_Can_Network_0_CANNODE_0_PduR2Com: PduLength=48
          C_LDCU_EPBDebugData_Can_Network_0_CANNODE_0_CanIf2PduR: PduLength=8
          C_LDCU_EPBDebugData_Can_Network_0_CANNODE_0_PduR2Com: PduLength=8
          C_XPU_IPB_ADASToqCtrl_Can_Network_0_CANNODE_0_CanIf2PduR: PduLength=8
          C_XPU_IPB_ADASToqCtrl_Can_Network_0_CANNODE_0_PduR2Com: PduLength=8
          C_IPB_SpdInfoF_Can_Network_0_CANNODE_0_CanIf2PduR: PduLength=8
          C_IPB_SpdInfoF_Can_Network_0_CANNODE_0_PduR2Com: PduLength=8
          C_IPB_SpdInfo_E2E_Can_Network_0_CANNODE_0_CanIf2PduR: PduLength=16
          C_IPB_SpdInfo_E2E_Can_Network_0_CANNODE_0_PduR2Com: PduLength=16
          C_AS_SysSt1_Can_Network_0_CANNODE_0_CanIf2PduR: PduLength=8
          C_AS_SysSt1_Can_Network_0_CANNODE_0_PduR2Com: PduLength=8
          C_LDCU_BodySysSt1_Can_Network_0_CANNODE_0_CanIf2PduR: PduLength=8
          C_LDCU_BodySysSt1_Can_Network_0_CANNODE_0_PduR2Com: PduLength=8
          C_CDCU_ChassisCtrl_Can_Network_0_CANNODE_0_CanIf2PduR: PduLength=8
          C_CDCU_ChassisCtrl_Can_Network_0_CANNODE_0_PduR2Com: PduLength=8
          C_IPB_CylinderPressure2_Can_Network_0_CANNODE_0_CanIf2PduR: PduLength=8
          C_IPB_CylinderPressure2_Can_Network_0_CANNODE_0_PduR2Com: PduLength=8
          C_IPB_SysSt_Can_Network_0_CANNODE_0_CanIf2PduR: PduLength=8
          C_IPB_SysSt_Can_Network_0_CANNODE_0_PduR2Com: PduLength=8
          C_LDCU_RTorqInfo_Can_Network_0_CANNODE_0_CanIf2PduR: PduLength=8
          C_LDCU_RTorqInfo_Can_Network_0_CANNODE_0_PduR2Com: PduLength=8
          C_IPB_Accel_Can_Network_0_CANNODE_0_CanIf2PduR: PduLength=8
          C_IPB_Accel_Can_Network_0_CANNODE_0_PduR2Com: PduLength=8
          C_LDCU_SysSt_Can_Network_0_CANNODE_0_CanIf2PduR: PduLength=8
          C_LDCU_SysSt_Can_Network_0_CANNODE_0_PduR2Com: PduLength=8
          C_LDCU_FTorqInfo_Can_Network_0_CANNODE_0_CanIf2PduR: PduLength=8
          C_LDCU_FTorqInfo_Can_Network_0_CANNODE_0_PduR2Com: PduLength=8
          C_LDCU_APBSysSt_Can_Network_0_CANNODE_0_CanIf2PduR: PduLength=8
          C_LDCU_APBSysSt_Can_Network_0_CANNODE_0_PduR2Com: PduLength=8
          C_IPB_SysSt2_Can_Network_0_CANNODE_0_CanIf2PduR: PduLength=8
          C_IPB_SysSt2_Can_Network_0_CANNODE_0_PduR2Com: PduLength=8
          C_AS_SysSt3_Can_Network_0_CANNODE_0_CanIf2PduR: PduLength=8
          C_AS_SysSt3_Can_Network_0_CANNODE_0_PduR2Com: PduLength=8
          C_IPB_APBSysSt_Can_Network_0_CANNODE_0_CanIf2PduR: PduLength=8
          C_IPB_APBSysSt_Can_Network_0_CANNODE_0_PduR2Com: PduLength=8
          C_LDCU_IPB_FaxleRegen_Can_Network_0_CANNODE_0_CanIf2PduR: PduLength=8
          C_LDCU_IPB_FaxleRegen_Can_Network_0_CANNODE_0_PduR2Com: PduLength=8
          C_RDCU_IPB_APB_ROPP_Can_Network_0_CANNODE_0_Com2PduR: PduLength=8
          C_RDCU_IPB_APB_ROPP_Can_Network_0_CANNODE_0_PduR2CanIf: PduLength=8
          C_RDCU_RLIN3Info_Can_Network_0_CANNODE_0_Com2PduR: PduLength=24
          C_RDCU_RLIN3Info_Can_Network_0_CANNODE_0_PduR2CanIf: PduLength=24
          C_RDCU_BodyCtrl2_Can_Network_0_CANNODE_0_Com2PduR: PduLength=8
          C_RDCU_BodyCtrl2_Can_Network_0_CANNODE_0_PduR2CanIf: PduLength=8
          C_RDCU_APBSysSt_Can_Network_0_CANNODE_0_Com2PduR: PduLength=8
          C_RDCU_APBSysSt_Can_Network_0_CANNODE_0_PduR2CanIf: PduLength=8
    EcuCRbSettings: EcuCRbArRelease=AR42_Rev2, EcuCRbRteInUse=true
  module config Can: implementation-config-variant=VARIANT-PRE-COMPILE
    CanGeneral:
      CanMainFunctionBusoffPeriod = 0.0010
      CanMainFunctionModePeriod = 0.0010
      CanMultiplexedTransmission = false
      CanVersionInfoApi = false
      CanIndex = 0
      CanPublicIcomSupport = false
      CanTimeoutDuration = 1
      CanDevErrorDetection = false
    CanConfigSet
      Can_Network_CANNODE_0 (CanController):
        CanBusoffProcessing = POLLING
        CanControllerActivation = true
        CanControllerBaseAddress = 0
        CanTxProcessing = POLLING
        CanWakeupFunctionalityAPI = false
        CanWakeupProcessing = POLLING
        CanWakeupSupport = false
        CanControllerId = 0
        CanRxProcessing = POLLING
        CanControllerDefaultBaudrate = Can_Network_CANNODE_0/Can_Network_CANNODE_0
        Can_Network_CANNODE_0 (CanControllerBaudrateConfig):
          CanControllerBaudRateConfigID = 1
          CanControllerBaudRate = 500
          CanControllerPropSeg = 0
          CanControllerSeg1 = 10
          CanControllerSeg2 = 0
          CanControllerSyncJumpWidth = 0
          CanControllerFdBaudrateConfig:
            CanControllerFdBaudRate = 800
            CanControllerPropSeg = 0
            CanControllerSeg1 = 10
            CanControllerSeg2 = 0
            CanControllerSyncJumpWidth = 0
            CanControllerTxBitRateSwitch = true
      30 x CanHardwareObject, all with CanHwObjectCount=1, CanHandleType=FULL, CanIdType=STANDARD, CanControllerRef=CanConfigSet/Can_Network_CANNODE_0:
        Can_Network_CANNODE_0_Rx_Std_MailBox_1: CanObjectType=RECEIVE, CanObjectId=30
          CanHwFilter: CanHwFilterCode=267, CanHwFilterMask=2047
        Can_Network_CANNODE_0_Rx_Std_MailBox_2: CanObjectType=RECEIVE, CanObjectId=31
          CanHwFilter: CanHwFilterCode=298, CanHwFilterMask=2047
        Can_Network_CANNODE_0_Rx_Std_MailBox_3: CanObjectType=RECEIVE, CanObjectId=32
          CanHwFilter: CanHwFilterCode=296, CanHwFilterMask=2047
        Can_Network_CANNODE_0_Rx_Std_MailBox_4: CanObjectType=RECEIVE, CanObjectId=33
          CanHwFilter: CanHwFilterCode=276, CanHwFilterMask=2047
        Can_Network_CANNODE_0_Rx_Std_MailBox_5: CanObjectType=RECEIVE, CanObjectId=34
          CanHwFilter: CanHwFilterCode=422, CanHwFilterMask=2047
        Can_Network_CANNODE_0_Rx_Std_MailBox_6: CanObjectType=RECEIVE, CanObjectId=35
          CanHwFilter: CanHwFilterCode=497, CanHwFilterMask=2047
        Can_Network_CANNODE_0_Rx_Std_MailBox_7: CanObjectType=RECEIVE, CanObjectId=36
          CanHwFilter: CanHwFilterCode=278, CanHwFilterMask=2047
        Can_Network_CANNODE_0_Rx_Std_MailBox_8: CanObjectType=RECEIVE, CanObjectId=37
          CanHwFilter: CanHwFilterCode=658, CanHwFilterMask=2047
        Can_Network_CANNODE_0_Rx_Std_MailBox_9: CanObjectType=RECEIVE, CanObjectId=38
          CanHwFilter: CanHwFilterCode=1552, CanHwFilterMask=2047
        Can_Network_CANNODE_0_Rx_Std_MailBox_10: CanObjectType=RECEIVE, CanObjectId=39
          CanHwFilter: CanHwFilterCode=256, CanHwFilterMask=2047
        Can_Network_CANNODE_0_Rx_Std_MailBox_11: CanObjectType=RECEIVE, CanObjectId=40
          CanHwFilter: CanHwFilterCode=295, CanHwFilterMask=2047
        Can_Network_CANNODE_0_Rx_Std_MailBox_12: CanObjectType=RECEIVE, CanObjectId=41
          CanHwFilter: CanHwFilterCode=294, CanHwFilterMask=2047
        Can_Network_CANNODE_0_Rx_Std_MailBox_13: CanObjectType=RECEIVE, CanObjectId=42
          CanHwFilter: CanHwFilterCode=399, CanHwFilterMask=2047
        Can_Network_CANNODE_0_Rx_Std_MailBox_14: CanObjectType=RECEIVE, CanObjectId=43
          CanHwFilter: CanHwFilterCode=548, CanHwFilterMask=2047
        Can_Network_CANNODE_0_Rx_Std_MailBox_15: CanObjectType=RECEIVE, CanObjectId=44
          CanHwFilter: CanHwFilterCode=704, CanHwFilterMask=2047
        Can_Network_CANNODE_0_Rx_Std_MailBox_16: CanObjectType=RECEIVE, CanObjectId=45
          CanHwFilter: CanHwFilterCode=272, CanHwFilterMask=2047
        Can_Network_CANNODE_0_Rx_Std_MailBox_17: CanObjectType=RECEIVE, CanObjectId=46
          CanHwFilter: CanHwFilterCode=423, CanHwFilterMask=2047
        Can_Network_CANNODE_0_Rx_Std_MailBox_18: CanObjectType=RECEIVE, CanObjectId=47
          CanHwFilter: CanHwFilterCode=262, CanHwFilterMask=2047
        Can_Network_CANNODE_0_Rx_Std_MailBox_19: CanObjectType=RECEIVE, CanObjectId=48
          CanHwFilter: CanHwFilterCode=424, CanHwFilterMask=2047
        Can_Network_CANNODE_0_Rx_Std_MailBox_20: CanObjectType=RECEIVE, CanObjectId=49
          CanHwFilter: CanHwFilterCode=279, CanHwFilterMask=2047
        Can_Network_CANNODE_0_Rx_Std_MailBox_21: CanObjectType=RECEIVE, CanObjectId=50
          CanHwFilter: CanHwFilterCode=263, CanHwFilterMask=2047
        Can_Network_CANNODE_0_Rx_Std_MailBox_22: CanObjectType=RECEIVE, CanObjectId=51
          CanHwFilter: CanHwFilterCode=436, CanHwFilterMask=2047
        Can_Network_CANNODE_0_Rx_Std_MailBox_23: CanObjectType=RECEIVE, CanObjectId=52
          CanHwFilter: CanHwFilterCode=394, CanHwFilterMask=2047
        Can_Network_CANNODE_0_Rx_Std_MailBox_24: CanObjectType=RECEIVE, CanObjectId=53
          CanHwFilter: CanHwFilterCode=659, CanHwFilterMask=2047
        Can_Network_CANNODE_0_Rx_Std_MailBox_25: CanObjectType=RECEIVE, CanObjectId=54
          CanHwFilter: CanHwFilterCode=434, CanHwFilterMask=2047
        Can_Network_CANNODE_0_Rx_Std_MailBox_26: CanObjectType=RECEIVE, CanObjectId=55
          CanHwFilter: CanHwFilterCode=266, CanHwFilterMask=2047
        Can_Network_CANNODE_0_Tx_Std_MailBox_1: CanObjectType=TRANSMIT, CanObjectId=56
        Can_Network_CANNODE_0_Tx_Std_MailBox_2: CanObjectType=TRANSMIT, CanObjectId=57
        Can_Network_CANNODE_0_Tx_Std_MailBox_3: CanObjectType=TRANSMIT, CanObjectId=58
        Can_Network_CANNODE_0_Tx_Std_MailBox_4: CanObjectType=TRANSMIT, CanObjectId=59
      Can_Network_0_CANNODE_0 (CanController):
        CanBusoffProcessing = POLLING
        CanControllerActivation = true
        CanControllerBaseAddress = 0
        CanTxProcessing = POLLING
        CanWakeupFunctionalityAPI = false
        CanWakeupProcessing = POLLING
        CanWakeupSupport = false
        CanControllerId = 1
        CanRxProcessing = POLLING
        CanControllerDefaultBaudrate = Can_Network_0_CANNODE_0/Can_Network_0_CANNODE_0
        Can_Network_0_CANNODE_0 (CanControllerBaudrateConfig):
          CanControllerBaudRate = 500
          CanControllerBaudRateConfigID = 1
          CanControllerPropSeg = 0
          CanControllerSeg1 = 10
          CanControllerSeg2 = 0
          CanControllerSyncJumpWidth = 0
          CanControllerFdBaudrateConfig:
            CanControllerFdBaudRate = 800
            CanControllerPropSeg = 0
            CanControllerSeg1 = 10
            CanControllerSeg2 = 0
            CanControllerSyncJumpWidth = 0
            CanControllerTxBitRateSwitch = true
      30 x CanHardwareObject, all with CanHwObjectCount=1, CanHandleType=FULL, CanIdType=STANDARD, CanControllerRef=CanConfigSet/Can_Network_0_CANNODE_0:
        Can_Network_0_CANNODE_0_Rx_Std_MailBox_1: CanObjectType=RECEIVE, CanObjectId=0
          CanHwFilter: CanHwFilterCode=267, CanHwFilterMask=2047
        Can_Network_0_CANNODE_0_Rx_Std_MailBox_2: CanObjectType=RECEIVE, CanObjectId=1
          CanHwFilter: CanHwFilterCode=298, CanHwFilterMask=2047
        Can_Network_0_CANNODE_0_Rx_Std_MailBox_3: CanObjectType=RECEIVE, CanObjectId=2
          CanHwFilter: CanHwFilterCode=296, CanHwFilterMask=2047
        Can_Network_0_CANNODE_0_Rx_Std_MailBox_4: CanObjectType=RECEIVE, CanObjectId=3
          CanHwFilter: CanHwFilterCode=276, CanHwFilterMask=2047
        Can_Network_0_CANNODE_0_Rx_Std_MailBox_5: CanObjectType=RECEIVE, CanObjectId=4
          CanHwFilter: CanHwFilterCode=422, CanHwFilterMask=2047
        Can_Network_0_CANNODE_0_Rx_Std_MailBox_6: CanObjectType=RECEIVE, CanObjectId=5
          CanHwFilter: CanHwFilterCode=497, CanHwFilterMask=2047
        Can_Network_0_CANNODE_0_Rx_Std_MailBox_7: CanObjectType=RECEIVE, CanObjectId=6
          CanHwFilter: CanHwFilterCode=278, CanHwFilterMask=2047
        Can_Network_0_CANNODE_0_Rx_Std_MailBox_8: CanObjectType=RECEIVE, CanObjectId=7
          CanHwFilter: CanHwFilterCode=658, CanHwFilterMask=2047
        Can_Network_0_CANNODE_0_Rx_Std_MailBox_9: CanObjectType=RECEIVE, CanObjectId=8
          CanHwFilter: CanHwFilterCode=1552, CanHwFilterMask=2047
        Can_Network_0_CANNODE_0_Rx_Std_MailBox_10: CanObjectType=RECEIVE, CanObjectId=9
          CanHwFilter: CanHwFilterCode=256, CanHwFilterMask=2047
        Can_Network_0_CANNODE_0_Rx_Std_MailBox_11: CanObjectType=RECEIVE, CanObjectId=10
          CanHwFilter: CanHwFilterCode=295, CanHwFilterMask=2047
        Can_Network_0_CANNODE_0_Rx_Std_MailBox_12: CanObjectType=RECEIVE, CanObjectId=11
          CanHwFilter: CanHwFilterCode=294, CanHwFilterMask=2047
        Can_Network_0_CANNODE_0_Rx_Std_MailBox_13: CanObjectType=RECEIVE, CanObjectId=12
          CanHwFilter: CanHwFilterCode=399, CanHwFilterMask=2047
        Can_Network_0_CANNODE_0_Rx_Std_MailBox_14: CanObjectType=RECEIVE, CanObjectId=13
          CanHwFilter: CanHwFilterCode=548, CanHwFilterMask=2047
        Can_Network_0_CANNODE_0_Rx_Std_MailBox_15: CanObjectType=RECEIVE, CanObjectId=14
          CanHwFilter: CanHwFilterCode=704, CanHwFilterMask=2047
        Can_Network_0_CANNODE_0_Rx_Std_MailBox_16: CanObjectType=RECEIVE, CanObjectId=15
          CanHwFilter: CanHwFilterCode=272, CanHwFilterMask=2047
        Can_Network_0_CANNODE_0_Rx_Std_MailBox_17: CanObjectType=RECEIVE, CanObjectId=16
          CanHwFilter: CanHwFilterCode=423, CanHwFilterMask=2047
        Can_Network_0_CANNODE_0_Rx_Std_MailBox_18: CanObjectType=RECEIVE, CanObjectId=17
          CanHwFilter: CanHwFilterCode=262, CanHwFilterMask=2047
        Can_Network_0_CANNODE_0_Rx_Std_MailBox_19: CanObjectType=RECEIVE, CanObjectId=18
          CanHwFilter: CanHwFilterCode=424, CanHwFilterMask=2047
        Can_Network_0_CANNODE_0_Rx_Std_MailBox_20: CanObjectType=RECEIVE, CanObjectId=19
          CanHwFilter: CanHwFilterCode=279, CanHwFilterMask=2047
        Can_Network_0_CANNODE_0_Rx_Std_MailBox_21: CanObjectType=RECEIVE, CanObjectId=20
          CanHwFilter: CanHwFilterCode=263, CanHwFilterMask=2047
        Can_Network_0_CANNODE_0_Rx_Std_MailBox_22: CanObjectType=RECEIVE, CanObjectId=21
          CanHwFilter: CanHwFilterCode=436, CanHwFilterMask=2047
        Can_Network_0_CANNODE_0_Rx_Std_MailBox_23: CanObjectType=RECEIVE, CanObjectId=22
          CanHwFilter: CanHwFilterCode=394, CanHwFilterMask=2047
        Can_Network_0_CANNODE_0_Rx_Std_MailBox_24: CanObjectType=RECEIVE, CanObjectId=23
          CanHwFilter: CanHwFilterCode=659, CanHwFilterMask=2047
        Can_Network_0_CANNODE_0_Rx_Std_MailBox_25: CanObjectType=RECEIVE, CanObjectId=24
          CanHwFilter: CanHwFilterCode=434, CanHwFilterMask=2047
        Can_Network_0_CANNODE_0_Rx_Std_MailBox_26: CanObjectType=RECEIVE, CanObjectId=25
          CanHwFilter: CanHwFilterCode=266, CanHwFilterMask=2047
        Can_Network_0_CANNODE_0_Tx_Std_MailBox_1: CanObjectType=TRANSMIT, CanObjectId=26
        Can_Network_0_CANNODE_0_Tx_Std_MailBox_2: CanObjectType=TRANSMIT, CanObjectId=27
        Can_Network_0_CANNODE_0_Tx_Std_MailBox_3: CanObjectType=TRANSMIT, CanObjectId=28
        Can_Network_0_CANNODE_0_Tx_Std_MailBox_4: CanObjectType=TRANSMIT, CanObjectId=29
  module config PduR: implementation-config-variant=VARIANT-PRE-COMPILE
    PduRGeneral:
      PduRVersionInfoApi = false
      PduRZeroCostOperation = false
      PduRIFGatewayOperation = false
      PduRTPGatewayOperation = false
      PduRMulticastFromTpSupport = false
      PduRMulticastToIfSupport = false
      PduRMulticastToTpSupport = false
      PduRQueueingSupport = false
      PduRGwTpWithLimitedBuffer = false
      PduRDevErrorDetect = false
    PduRRoutingTables: PduRConfigurationId=0
      PduRRoutingTable
        60 x PduRRoutingPath:
          C_LDCU_IPB_RaxleRegen_Can_Network_CANNODE_0_CanIf2Com
            C_LDCU_IPB_RaxleRegen_Can_Network_CANNODE_0_CanIf2PduR (PduRSrcPdu): PduRSrcPduRef=PduCollection/C_LDCU_IPB_RaxleRegen_Can_Network_CANNODE_0_CanIf2PduR
            C_LDCU_IPB_RaxleRegen_Can_Network_CANNODE_0_PduR2Com (PduRDestPdu): PduRTransmissionConfirmation=false, PduRDestPduRef=PduCollection/C_LDCU_IPB_RaxleRegen_Can_Network_CANNODE_0_PduR2Com
          C_IPB_SpdEdges_Can_Network_CANNODE_0_CanIf2Com
            C_IPB_SpdEdges_Can_Network_CANNODE_0_CanIf2PduR (PduRSrcPdu): PduRSrcPduRef=PduCollection/C_IPB_SpdEdges_Can_Network_CANNODE_0_CanIf2PduR
            C_IPB_SpdEdges_Can_Network_CANNODE_0_PduR2Com (PduRDestPdu): PduRTransmissionConfirmation=false, PduRDestPduRef=PduCollection/C_IPB_SpdEdges_Can_Network_CANNODE_0_PduR2Com
          C_IPB_SpdInfoR_Can_Network_CANNODE_0_CanIf2Com
            C_IPB_SpdInfoR_Can_Network_CANNODE_0_CanIf2PduR (PduRSrcPdu): PduRSrcPduRef=PduCollection/C_IPB_SpdInfoR_Can_Network_CANNODE_0_CanIf2PduR
            C_IPB_SpdInfoR_Can_Network_CANNODE_0_PduR2Com (PduRDestPdu): PduRTransmissionConfirmation=false, PduRDestPduRef=PduCollection/C_IPB_SpdInfoR_Can_Network_CANNODE_0_PduR2Com
          C_LDCU_EPB_APB_ROPP2_Can_Network_CANNODE_0_CanIf2Com
            C_LDCU_EPB_APB_ROPP2_Can_Network_CANNODE_0_CanIf2PduR (PduRSrcPdu): PduRSrcPduRef=PduCollection/C_LDCU_EPB_APB_ROPP2_Can_Network_CANNODE_0_CanIf2PduR
            C_LDCU_EPB_APB_ROPP2_Can_Network_CANNODE_0_PduR2Com (PduRDestPdu): PduRTransmissionConfirmation=false, PduRDestPduRef=PduCollection/C_LDCU_EPB_APB_ROPP2_Can_Network_CANNODE_0_PduR2Com
          C_IPB_SysSt_E2E_Can_Network_CANNODE_0_CanIf2Com
            C_IPB_SysSt_E2E_Can_Network_CANNODE_0_CanIf2PduR (PduRSrcPdu): PduRSrcPduRef=PduCollection/C_IPB_SysSt_E2E_Can_Network_CANNODE_0_CanIf2PduR
            C_IPB_SysSt_E2E_Can_Network_CANNODE_0_PduR2Com (PduRDestPdu): PduRTransmissionConfirmation=false, PduRDestPduRef=PduCollection/C_IPB_SysSt_E2E_Can_Network_CANNODE_0_PduR2Com
          C_MFS_Status_Can_Network_CANNODE_0_CanIf2Com
            C_MFS_Status_Can_Network_CANNODE_0_CanIf2PduR (PduRSrcPdu): PduRSrcPduRef=PduCollection/C_MFS_Status_Can_Network_CANNODE_0_CanIf2PduR
            C_MFS_Status_Can_Network_CANNODE_0_PduR2Com (PduRDestPdu): PduRTransmissionConfirmation=false, PduRDestPduRef=PduCollection/C_MFS_Status_Can_Network_CANNODE_0_PduR2Com
          C_IPB_SysSt1_Can_Network_CANNODE_0_CanIf2Com
            C_IPB_SysSt1_Can_Network_CANNODE_0_CanIf2PduR (PduRSrcPdu): PduRSrcPduRef=PduCollection/C_IPB_SysSt1_Can_Network_CANNODE_0_CanIf2PduR
            C_IPB_SysSt1_Can_Network_CANNODE_0_PduR2Com (PduRDestPdu): PduRTransmissionConfirmation=false, PduRDestPduRef=PduCollection/C_IPB_SysSt1_Can_Network_CANNODE_0_PduR2Com
          C_AS_SysSt2_Can_Network_CANNODE_0_CanIf2Com
            C_AS_SysSt2_Can_Network_CANNODE_0_CanIf2PduR (PduRSrcPdu): PduRSrcPduRef=PduCollection/C_AS_SysSt2_Can_Network_CANNODE_0_CanIf2PduR
            C_AS_SysSt2_Can_Network_CANNODE_0_PduR2Com (PduRDestPdu): PduRTransmissionConfirmation=false, PduRDestPduRef=PduCollection/C_AS_SysSt2_Can_Network_CANNODE_0_PduR2Com
          C_LDCU_EPBDebugData_Can_Network_CANNODE_0_CanIf2Com
            C_LDCU_EPBDebugData_Can_Network_CANNODE_0_CanIf2PduR (PduRSrcPdu): PduRSrcPduRef=PduCollection/C_LDCU_EPBDebugData_Can_Network_CANNODE_0_CanIf2PduR
            C_LDCU_EPBDebugData_Can_Network_CANNODE_0_PduR2Com (PduRDestPdu): PduRTransmissionConfirmation=false, PduRDestPduRef=PduCollection/C_LDCU_EPBDebugData_Can_Network_CANNODE_0_PduR2Com
          C_XPU_IPB_ADASToqCtrl_Can_Network_CANNODE_0_CanIf2Com
            C_XPU_IPB_ADASToqCtrl_Can_Network_CANNODE_0_CanIf2PduR (PduRSrcPdu): PduRSrcPduRef=PduCollection/C_XPU_IPB_ADASToqCtrl_Can_Network_CANNODE_0_CanIf2PduR
            C_XPU_IPB_ADASToqCtrl_Can_Network_CANNODE_0_PduR2Com (PduRDestPdu): PduRTransmissionConfirmation=false, PduRDestPduRef=PduCollection/C_XPU_IPB_ADASToqCtrl_Can_Network_CANNODE_0_PduR2Com
          C_IPB_SpdInfoF_Can_Network_CANNODE_0_CanIf2Com
            C_IPB_SpdInfoF_Can_Network_CANNODE_0_CanIf2PduR (PduRSrcPdu): PduRSrcPduRef=PduCollection/C_IPB_SpdInfoF_Can_Network_CANNODE_0_CanIf2PduR
            C_IPB_SpdInfoF_Can_Network_CANNODE_0_PduR2Com (PduRDestPdu): PduRTransmissionConfirmation=false, PduRDestPduRef=PduCollection/C_IPB_SpdInfoF_Can_Network_CANNODE_0_PduR2Com
          C_IPB_SpdInfo_E2E_Can_Network_CANNODE_0_CanIf2Com
            C_IPB_SpdInfo_E2E_Can_Network_CANNODE_0_CanIf2PduR (PduRSrcPdu): PduRSrcPduRef=PduCollection/C_IPB_SpdInfo_E2E_Can_Network_CANNODE_0_CanIf2PduR
            C_IPB_SpdInfo_E2E_Can_Network_CANNODE_0_PduR2Com (PduRDestPdu): PduRTransmissionConfirmation=false, PduRDestPduRef=PduCollection/C_IPB_SpdInfo_E2E_Can_Network_CANNODE_0_PduR2Com
          C_AS_SysSt1_Can_Network_CANNODE_0_CanIf2Com
            C_AS_SysSt1_Can_Network_CANNODE_0_CanIf2PduR (PduRSrcPdu): PduRSrcPduRef=PduCollection/C_AS_SysSt1_Can_Network_CANNODE_0_CanIf2PduR
            C_AS_SysSt1_Can_Network_CANNODE_0_PduR2Com (PduRDestPdu): PduRTransmissionConfirmation=false, PduRDestPduRef=PduCollection/C_AS_SysSt1_Can_Network_CANNODE_0_PduR2Com
          C_LDCU_BodySysSt1_Can_Network_CANNODE_0_CanIf2Com
            C_LDCU_BodySysSt1_Can_Network_CANNODE_0_CanIf2PduR (PduRSrcPdu): PduRSrcPduRef=PduCollection/C_LDCU_BodySysSt1_Can_Network_CANNODE_0_CanIf2PduR
            C_LDCU_BodySysSt1_Can_Network_CANNODE_0_PduR2Com (PduRDestPdu): PduRTransmissionConfirmation=false, PduRDestPduRef=PduCollection/C_LDCU_BodySysSt1_Can_Network_CANNODE_0_PduR2Com
          C_CDCU_ChassisCtrl_Can_Network_CANNODE_0_CanIf2Com
            C_CDCU_ChassisCtrl_Can_Network_CANNODE_0_CanIf2PduR (PduRSrcPdu): PduRSrcPduRef=PduCollection/C_CDCU_ChassisCtrl_Can_Network_CANNODE_0_CanIf2PduR
            C_CDCU_ChassisCtrl_Can_Network_CANNODE_0_PduR2Com (PduRDestPdu): PduRTransmissionConfirmation=false, PduRDestPduRef=PduCollection/C_CDCU_ChassisCtrl_Can_Network_CANNODE_0_PduR2Com
          C_IPB_CylinderPressure2_Can_Network_CANNODE_0_CanIf2Com
            C_IPB_CylinderPressure2_Can_Network_CANNODE_0_CanIf2PduR (PduRSrcPdu): PduRSrcPduRef=PduCollection/C_IPB_CylinderPressure2_Can_Network_CANNODE_0_CanIf2PduR
            C_IPB_CylinderPressure2_Can_Network_CANNODE_0_PduR2Com (PduRDestPdu): PduRTransmissionConfirmation=false, PduRDestPduRef=PduCollection/C_IPB_CylinderPressure2_Can_Network_CANNODE_0_PduR2Com
          C_IPB_SysSt_Can_Network_CANNODE_0_CanIf2Com
            C_IPB_SysSt_Can_Network_CANNODE_0_CanIf2PduR (PduRSrcPdu): PduRSrcPduRef=PduCollection/C_IPB_SysSt_Can_Network_CANNODE_0_CanIf2PduR
            C_IPB_SysSt_Can_Network_CANNODE_0_PduR2Com (PduRDestPdu): PduRTransmissionConfirmation=false, PduRDestPduRef=PduCollection/C_IPB_SysSt_Can_Network_CANNODE_0_PduR2Com
          C_LDCU_RTorqInfo_Can_Network_CANNODE_0_CanIf2Com
            C_LDCU_RTorqInfo_Can_Network_CANNODE_0_CanIf2PduR (PduRSrcPdu): PduRSrcPduRef=PduCollection/C_LDCU_RTorqInfo_Can_Network_CANNODE_0_CanIf2PduR
            C_LDCU_RTorqInfo_Can_Network_CANNODE_0_PduR2Com (PduRDestPdu): PduRTransmissionConfirmation=false, PduRDestPduRef=PduCollection/C_LDCU_RTorqInfo_Can_Network_CANNODE_0_PduR2Com
          C_IPB_Accel_Can_Network_CANNODE_0_CanIf2Com
            C_IPB_Accel_Can_Network_CANNODE_0_CanIf2PduR (PduRSrcPdu): PduRSrcPduRef=PduCollection/C_IPB_Accel_Can_Network_CANNODE_0_CanIf2PduR
            C_IPB_Accel_Can_Network_CANNODE_0_PduR2Com (PduRDestPdu): PduRTransmissionConfirmation=false, PduRDestPduRef=PduCollection/C_IPB_Accel_Can_Network_CANNODE_0_PduR2Com
          C_LDCU_SysSt_Can_Network_CANNODE_0_CanIf2Com
            C_LDCU_SysSt_Can_Network_CANNODE_0_CanIf2PduR (PduRSrcPdu): PduRSrcPduRef=PduCollection/C_LDCU_SysSt_Can_Network_CANNODE_0_CanIf2PduR
            C_LDCU_SysSt_Can_Network_CANNODE_0_PduR2Com (PduRDestPdu): PduRTransmissionConfirmation=false, PduRDestPduRef=PduCollection/C_LDCU_SysSt_Can_Network_CANNODE_0_PduR2Com
          C_LDCU_FTorqInfo_Can_Network_CANNODE_0_CanIf2Com
            C_LDCU_FTorqInfo_Can_Network_CANNODE_0_CanIf2PduR (PduRSrcPdu): PduRSrcPduRef=PduCollection/C_LDCU_FTorqInfo_Can_Network_CANNODE_0_CanIf2PduR
            C_LDCU_FTorqInfo_Can_Network_CANNODE_0_PduR2Com (PduRDestPdu): PduRTransmissionConfirmation=false, PduRDestPduRef=PduCollection/C_LDCU_FTorqInfo_Can_Network_CANNODE_0_PduR2Com
          C_LDCU_APBSysSt_Can_Network_CANNODE_0_CanIf2Com
            C_LDCU_APBSysSt_Can_Network_CANNODE_0_CanIf2PduR (PduRSrcPdu): PduRSrcPduRef=PduCollection/C_LDCU_APBSysSt_Can_Network_CANNODE_0_CanIf2PduR
            C_LDCU_APBSysSt_Can_Network_CANNODE_0_PduR2Com (PduRDestPdu): PduRTransmissionConfirmation=false, PduRDestPduRef=PduCollection/C_LDCU_APBSysSt_Can_Network_CANNODE_0_PduR2Com
          C_IPB_SysSt2_Can_Network_CANNODE_0_CanIf2Com
            C_IPB_SysSt2_Can_Network_CANNODE_0_CanIf2PduR (PduRSrcPdu): PduRSrcPduRef=PduCollection/C_IPB_SysSt2_Can_Network_CANNODE_0_CanIf2PduR
            C_IPB_SysSt2_Can_Network_CANNODE_0_PduR2Com (PduRDestPdu): PduRTransmissionConfirmation=false, PduRDestPduRef=PduCollection/C_IPB_SysSt2_Can_Network_CANNODE_0_PduR2Com
          C_AS_SysSt3_Can_Network_CANNODE_0_CanIf2Com
            C_AS_SysSt3_Can_Network_CANNODE_0_CanIf2PduR (PduRSrcPdu): PduRSrcPduRef=PduCollection/C_AS_SysSt3_Can_Network_CANNODE_0_CanIf2PduR
            C_AS_SysSt3_Can_Network_CANNODE_0_PduR2Com (PduRDestPdu): PduRTransmissionConfirmation=false, PduRDestPduRef=PduCollection/C_AS_SysSt3_Can_Network_CANNODE_0_PduR2Com
          C_IPB_APBSysSt_Can_Network_CANNODE_0_CanIf2Com
            C_IPB_APBSysSt_Can_Network_CANNODE_0_CanIf2PduR (PduRSrcPdu): PduRSrcPduRef=PduCollection/C_IPB_APBSysSt_Can_Network_CANNODE_0_CanIf2PduR
            C_IPB_APBSysSt_Can_Network_CANNODE_0_PduR2Com (PduRDestPdu): PduRTransmissionConfirmation=false, PduRDestPduRef=PduCollection/C_IPB_APBSysSt_Can_Network_CANNODE_0_PduR2Com
          C_LDCU_IPB_FaxleRegen_Can_Network_CANNODE_0_CanIf2Com
            C_LDCU_IPB_FaxleRegen_Can_Network_CANNODE_0_CanIf2PduR (PduRSrcPdu): PduRSrcPduRef=PduCollection/C_LDCU_IPB_FaxleRegen_Can_Network_CANNODE_0_CanIf2PduR
            C_LDCU_IPB_FaxleRegen_Can_Network_CANNODE_0_PduR2Com (PduRDestPdu): PduRTransmissionConfirmation=false, PduRDestPduRef=PduCollection/C_LDCU_IPB_FaxleRegen_Can_Network_CANNODE_0_PduR2Com
          C_RDCU_IPB_APB_ROPP_Can_Network_CANNODE_0_Com2CanIf
            C_RDCU_IPB_APB_ROPP_Can_Network_CANNODE_0_Com2PduR (PduRSrcPdu): PduRSrcPduRef=PduCollection/C_RDCU_IPB_APB_ROPP_Can_Network_CANNODE_0_Com2PduR
            C_RDCU_IPB_APB_ROPP_Can_Network_CANNODE_0_PduR2CanIf (PduRDestPdu): PduRTransmissionConfirmation=false, PduRDestPduRef=PduCollection/C_RDCU_IPB_APB_ROPP_Can_Network_CANNODE_0_PduR2CanIf
          C_RDCU_RLIN3Info_Can_Network_CANNODE_0_Com2CanIf
            C_RDCU_RLIN3Info_Can_Network_CANNODE_0_Com2PduR (PduRSrcPdu): PduRSrcPduRef=PduCollection/C_RDCU_RLIN3Info_Can_Network_CANNODE_0_Com2PduR
            C_RDCU_RLIN3Info_Can_Network_CANNODE_0_PduR2CanIf (PduRDestPdu): PduRTransmissionConfirmation=false, PduRDestPduRef=PduCollection/C_RDCU_RLIN3Info_Can_Network_CANNODE_0_PduR2CanIf
          C_RDCU_BodyCtrl2_Can_Network_CANNODE_0_Com2CanIf
            C_RDCU_BodyCtrl2_Can_Network_CANNODE_0_Com2PduR (PduRSrcPdu): PduRSrcPduRef=PduCollection/C_RDCU_BodyCtrl2_Can_Network_CANNODE_0_Com2PduR
            C_RDCU_BodyCtrl2_Can_Network_CANNODE_0_PduR2CanIf (PduRDestPdu): PduRTransmissionConfirmation=false, PduRDestPduRef=PduCollection/C_RDCU_BodyCtrl2_Can_Network_CANNODE_0_PduR2CanIf
          C_RDCU_APBSysSt_Can_Network_CANNODE_0_Com2CanIf
            C_RDCU_APBSysSt_Can_Network_CANNODE_0_Com2PduR (PduRSrcPdu): PduRSrcPduRef=PduCollection/C_RDCU_APBSysSt_Can_Network_CANNODE_0_Com2PduR
            C_RDCU_APBSysSt_Can_Network_CANNODE_0_PduR2CanIf (PduRDestPdu): PduRTransmissionConfirmation=false, PduRDestPduRef=PduCollection/C_RDCU_APBSysSt_Can_Network_CANNODE_0_PduR2CanIf
          C_LDCU_IPB_RaxleRegen_Can_Network_0_CANNODE_0_CanIf2Com
            C_LDCU_IPB_RaxleRegen_Can_Network_0_CANNODE_0_CanIf2PduR (PduRSrcPdu): PduRSrcPduRef=PduCollection/C_LDCU_IPB_RaxleRegen_Can_Network_0_CANNODE_0_CanIf2PduR
            C_LDCU_IPB_RaxleRegen_Can_Network_0_CANNODE_0_PduR2Com (PduRDestPdu): PduRTransmissionConfirmation=false, PduRDestPduRef=PduCollection/C_LDCU_IPB_RaxleRegen_Can_Network_0_CANNODE_0_PduR2Com
          C_IPB_SpdEdges_Can_Network_0_CANNODE_0_CanIf2Com
            C_IPB_SpdEdges_Can_Network_0_CANNODE_0_CanIf2PduR (PduRSrcPdu): PduRSrcPduRef=PduCollection/C_IPB_SpdEdges_Can_Network_0_CANNODE_0_CanIf2PduR
            C_IPB_SpdEdges_Can_Network_0_CANNODE_0_PduR2Com (PduRDestPdu): PduRTransmissionConfirmation=false, PduRDestPduRef=PduCollection/C_IPB_SpdEdges_Can_Network_0_CANNODE_0_PduR2Com
          C_IPB_SpdInfoR_Can_Network_0_CANNODE_0_CanIf2Com
            C_IPB_SpdInfoR_Can_Network_0_CANNODE_0_CanIf2PduR (PduRSrcPdu): PduRSrcPduRef=PduCollection/C_IPB_SpdInfoR_Can_Network_0_CANNODE_0_CanIf2PduR
            C_IPB_SpdInfoR_Can_Network_0_CANNODE_0_PduR2Com (PduRDestPdu): PduRTransmissionConfirmation=false, PduRDestPduRef=PduCollection/C_IPB_SpdInfoR_Can_Network_0_CANNODE_0_PduR2Com
          C_LDCU_EPB_APB_ROPP2_Can_Network_0_CANNODE_0_CanIf2Com
            C_LDCU_EPB_APB_ROPP2_Can_Network_0_CANNODE_0_CanIf2PduR (PduRSrcPdu): PduRSrcPduRef=PduCollection/C_LDCU_EPB_APB_ROPP2_Can_Network_0_CANNODE_0_CanIf2PduR
            C_LDCU_EPB_APB_ROPP2_Can_Network_0_CANNODE_0_PduR2Com (PduRDestPdu): PduRTransmissionConfirmation=false, PduRDestPduRef=PduCollection/C_LDCU_EPB_APB_ROPP2_Can_Network_0_CANNODE_0_PduR2Com
          C_IPB_SysSt_E2E_Can_Network_0_CANNODE_0_CanIf2Com
            C_IPB_SysSt_E2E_Can_Network_0_CANNODE_0_CanIf2PduR (PduRSrcPdu): PduRSrcPduRef=PduCollection/C_IPB_SysSt_E2E_Can_Network_0_CANNODE_0_CanIf2PduR
            C_IPB_SysSt_E2E_Can_Network_0_CANNODE_0_PduR2Com (PduRDestPdu): PduRTransmissionConfirmation=false, PduRDestPduRef=PduCollection/C_IPB_SysSt_E2E_Can_Network_0_CANNODE_0_PduR2Com
          C_MFS_Status_Can_Network_0_CANNODE_0_CanIf2Com
            C_MFS_Status_Can_Network_0_CANNODE_0_CanIf2PduR (PduRSrcPdu): PduRSrcPduRef=PduCollection/C_MFS_Status_Can_Network_0_CANNODE_0_CanIf2PduR
            C_MFS_Status_Can_Network_0_CANNODE_0_PduR2Com (PduRDestPdu): PduRTransmissionConfirmation=false, PduRDestPduRef=PduCollection/C_MFS_Status_Can_Network_0_CANNODE_0_PduR2Com
          C_IPB_SysSt1_Can_Network_0_CANNODE_0_CanIf2Com
            C_IPB_SysSt1_Can_Network_0_CANNODE_0_CanIf2PduR (PduRSrcPdu): PduRSrcPduRef=PduCollection/C_IPB_SysSt1_Can_Network_0_CANNODE_0_CanIf2PduR
            C_IPB_SysSt1_Can_Network_0_CANNODE_0_PduR2Com (PduRDestPdu): PduRTransmissionConfirmation=false, PduRDestPduRef=PduCollection/C_IPB_SysSt1_Can_Network_0_CANNODE_0_PduR2Com
          C_AS_SysSt2_Can_Network_0_CANNODE_0_CanIf2Com
            C_AS_SysSt2_Can_Network_0_CANNODE_0_CanIf2PduR (PduRSrcPdu): PduRSrcPduRef=PduCollection/C_AS_SysSt2_Can_Network_0_CANNODE_0_CanIf2PduR
            C_AS_SysSt2_Can_Network_0_CANNODE_0_PduR2Com (PduRDestPdu): PduRTransmissionConfirmation=false, PduRDestPduRef=PduCollection/C_AS_SysSt2_Can_Network_0_CANNODE_0_PduR2Com
          C_LDCU_EPBDebugData_Can_Network_0_CANNODE_0_CanIf2Com
            C_LDCU_EPBDebugData_Can_Network_0_CANNODE_0_CanIf2PduR (PduRSrcPdu): PduRSrcPduRef=PduCollection/C_LDCU_EPBDebugData_Can_Network_0_CANNODE_0_CanIf2PduR
            C_LDCU_EPBDebugData_Can_Network_0_CANNODE_0_PduR2Com (PduRDestPdu): PduRTransmissionConfirmation=false, PduRDestPduRef=PduCollection/C_LDCU_EPBDebugData_Can_Network_0_CANNODE_0_PduR2Com
          C_XPU_IPB_ADASToqCtrl_Can_Network_0_CANNODE_0_CanIf2Com
            C_XPU_IPB_ADASToqCtrl_Can_Network_0_CANNODE_0_CanIf2PduR (PduRSrcPdu): PduRSrcPduRef=PduCollection/C_XPU_IPB_ADASToqCtrl_Can_Network_0_CANNODE_0_CanIf2PduR
            C_XPU_IPB_ADASToqCtrl_Can_Network_0_CANNODE_0_PduR2Com (PduRDestPdu): PduRTransmissionConfirmation=false, PduRDestPduRef=PduCollection/C_XPU_IPB_ADASToqCtrl_Can_Network_0_CANNODE_0_PduR2Com
          C_IPB_SpdInfoF_Can_Network_0_CANNODE_0_CanIf2Com
            C_IPB_SpdInfoF_Can_Network_0_CANNODE_0_CanIf2PduR (PduRSrcPdu): PduRSrcPduRef=PduCollection/C_IPB_SpdInfoF_Can_Network_0_CANNODE_0_CanIf2PduR
            C_IPB_SpdInfoF_Can_Network_0_CANNODE_0_PduR2Com (PduRDestPdu): PduRTransmissionConfirmation=false, PduRDestPduRef=PduCollection/C_IPB_SpdInfoF_Can_Network_0_CANNODE_0_PduR2Com
          C_IPB_SpdInfo_E2E_Can_Network_0_CANNODE_0_CanIf2Com
            C_IPB_SpdInfo_E2E_Can_Network_0_CANNODE_0_CanIf2PduR (PduRSrcPdu): PduRSrcPduRef=PduCollection/C_IPB_SpdInfo_E2E_Can_Network_0_CANNODE_0_CanIf2PduR
            C_IPB_SpdInfo_E2E_Can_Network_0_CANNODE_0_PduR2Com (PduRDestPdu): PduRTransmissionConfirmation=false, PduRDestPduRef=PduCollection/C_IPB_SpdInfo_E2E_Can_Network_0_CANNODE_0_PduR2Com
          C_AS_SysSt1_Can_Network_0_CANNODE_0_CanIf2Com
            C_AS_SysSt1_Can_Network_0_CANNODE_0_CanIf2PduR (PduRSrcPdu): PduRSrcPduRef=PduCollection/C_AS_SysSt1_Can_Network_0_CANNODE_0_CanIf2PduR
            C_AS_SysSt1_Can_Network_0_CANNODE_0_PduR2Com (PduRDestPdu): PduRTransmissionConfirmation=false, PduRDestPduRef=PduCollection/C_AS_SysSt1_Can_Network_0_CANNODE_0_PduR2Com
          C_LDCU_BodySysSt1_Can_Network_0_CANNODE_0_CanIf2Com
            C_LDCU_BodySysSt1_Can_Network_0_CANNODE_0_CanIf2PduR (PduRSrcPdu): PduRSrcPduRef=PduCollection/C_LDCU_BodySysSt1_Can_Network_0_CANNODE_0_CanIf2PduR
            C_LDCU_BodySysSt1_Can_Network_0_CANNODE_0_PduR2Com (PduRDestPdu): PduRTransmissionConfirmation=false, PduRDestPduRef=PduCollection/C_LDCU_BodySysSt1_Can_Network_0_CANNODE_0_PduR2Com
          C_CDCU_ChassisCtrl_Can_Network_0_CANNODE_0_CanIf2Com
            C_CDCU_ChassisCtrl_Can_Network_0_CANNODE_0_CanIf2PduR (PduRSrcPdu): PduRSrcPduRef=PduCollection/C_CDCU_ChassisCtrl_Can_Network_0_CANNODE_0_CanIf2PduR
            C_CDCU_ChassisCtrl_Can_Network_0_CANNODE_0_PduR2Com (PduRDestPdu): PduRTransmissionConfirmation=false, PduRDestPduRef=PduCollection/C_CDCU_ChassisCtrl_Can_Network_0_CANNODE_0_PduR2Com
          C_IPB_CylinderPressure2_Can_Network_0_CANNODE_0_CanIf2Com
            C_IPB_CylinderPressure2_Can_Network_0_CANNODE_0_CanIf2PduR (PduRSrcPdu): PduRSrcPduRef=PduCollection/C_IPB_CylinderPressure2_Can_Network_0_CANNODE_0_CanIf2PduR
            C_IPB_CylinderPressure2_Can_Network_0_CANNODE_0_PduR2Com (PduRDestPdu): PduRTransmissionConfirmation=false, PduRDestPduRef=PduCollection/C_IPB_CylinderPressure2_Can_Network_0_CANNODE_0_PduR2Com
          C_IPB_SysSt_Can_Network_0_CANNODE_0_CanIf2Com
            C_IPB_SysSt_Can_Network_0_CANNODE_0_CanIf2PduR (PduRSrcPdu): PduRSrcPduRef=PduCollection/C_IPB_SysSt_Can_Network_0_CANNODE_0_CanIf2PduR
            C_IPB_SysSt_Can_Network_0_CANNODE_0_PduR2Com (PduRDestPdu): PduRTransmissionConfirmation=false, PduRDestPduRef=PduCollection/C_IPB_SysSt_Can_Network_0_CANNODE_0_PduR2Com
          C_LDCU_RTorqInfo_Can_Network_0_CANNODE_0_CanIf2Com
            C_LDCU_RTorqInfo_Can_Network_0_CANNODE_0_CanIf2PduR (PduRSrcPdu): PduRSrcPduRef=PduCollection/C_LDCU_RTorqInfo_Can_Network_0_CANNODE_0_CanIf2PduR
            C_LDCU_RTorqInfo_Can_Network_0_CANNODE_0_PduR2Com (PduRDestPdu): PduRTransmissionConfirmation=false, PduRDestPduRef=PduCollection/C_LDCU_RTorqInfo_Can_Network_0_CANNODE_0_PduR2Com
          C_IPB_Accel_Can_Network_0_CANNODE_0_CanIf2Com
            C_IPB_Accel_Can_Network_0_CANNODE_0_CanIf2PduR (PduRSrcPdu): PduRSrcPduRef=PduCollection/C_IPB_Accel_Can_Network_0_CANNODE_0_CanIf2PduR
            C_IPB_Accel_Can_Network_0_CANNODE_0_PduR2Com (PduRDestPdu): PduRTransmissionConfirmation=false, PduRDestPduRef=PduCollection/C_IPB_Accel_Can_Network_0_CANNODE_0_PduR2Com
          C_LDCU_SysSt_Can_Network_0_CANNODE_0_CanIf2Com
            C_LDCU_SysSt_Can_Network_0_CANNODE_0_CanIf2PduR (PduRSrcPdu): PduRSrcPduRef=PduCollection/C_LDCU_SysSt_Can_Network_0_CANNODE_0_CanIf2PduR
            C_LDCU_SysSt_Can_Network_0_CANNODE_0_PduR2Com (PduRDestPdu): PduRTransmissionConfirmation=false, PduRDestPduRef=PduCollection/C_LDCU_SysSt_Can_Network_0_CANNODE_0_PduR2Com
          C_LDCU_FTorqInfo_Can_Network_0_CANNODE_0_CanIf2Com
            C_LDCU_FTorqInfo_Can_Network_0_CANNODE_0_CanIf2PduR (PduRSrcPdu): PduRSrcPduRef=PduCollection/C_LDCU_FTorqInfo_Can_Network_0_CANNODE_0_CanIf2PduR
            C_LDCU_FTorqInfo_Can_Network_0_CANNODE_0_PduR2Com (PduRDestPdu): PduRTransmissionConfirmation=false, PduRDestPduRef=PduCollection/C_LDCU_FTorqInfo_Can_Network_0_CANNODE_0_PduR2Com
          C_LDCU_APBSysSt_Can_Network_0_CANNODE_0_CanIf2Com
            C_LDCU_APBSysSt_Can_Network_0_CANNODE_0_CanIf2PduR (PduRSrcPdu): PduRSrcPduRef=PduCollection/C_LDCU_APBSysSt_Can_Network_0_CANNODE_0_CanIf2PduR
            C_LDCU_APBSysSt_Can_Network_0_CANNODE_0_PduR2Com (PduRDestPdu): PduRTransmissionConfirmation=false, PduRDestPduRef=PduCollection/C_LDCU_APBSysSt_Can_Network_0_CANNODE_0_PduR2Com
          C_IPB_SysSt2_Can_Network_0_CANNODE_0_CanIf2Com
            C_IPB_SysSt2_Can_Network_0_CANNODE_0_CanIf2PduR (PduRSrcPdu): PduRSrcPduRef=PduCollection/C_IPB_SysSt2_Can_Network_0_CANNODE_0_CanIf2PduR
            C_IPB_SysSt2_Can_Network_0_CANNODE_0_PduR2Com (PduRDestPdu): PduRTransmissionConfirmation=false, PduRDestPduRef=PduCollection/C_IPB_SysSt2_Can_Network_0_CANNODE_0_PduR2Com
          C_AS_SysSt3_Can_Network_0_CANNODE_0_CanIf2Com
            C_AS_SysSt3_Can_Network_0_CANNODE_0_CanIf2PduR (PduRSrcPdu): PduRSrcPduRef=PduCollection/C_AS_SysSt3_Can_Network_0_CANNODE_0_CanIf2PduR
            C_AS_SysSt3_Can_Network_0_CANNODE_0_PduR2Com (PduRDestPdu): PduRTransmissionConfirmation=false, PduRDestPduRef=PduCollection/C_AS_SysSt3_Can_Network_0_CANNODE_0_PduR2Com
          C_IPB_APBSysSt_Can_Network_0_CANNODE_0_CanIf2Com
            C_IPB_APBSysSt_Can_Network_0_CANNODE_0_CanIf2PduR (PduRSrcPdu): PduRSrcPduRef=PduCollection/C_IPB_APBSysSt_Can_Network_0_CANNODE_0_CanIf2PduR
            C_IPB_APBSysSt_Can_Network_0_CANNODE_0_PduR2Com (PduRDestPdu): PduRTransmissionConfirmation=false, PduRDestPduRef=PduCollection/C_IPB_APBSysSt_Can_Network_0_CANNODE_0_PduR2Com
          C_LDCU_IPB_FaxleRegen_Can_Network_0_CANNODE_0_CanIf2Com
            C_LDCU_IPB_FaxleRegen_Can_Network_0_CANNODE_0_CanIf2PduR (PduRSrcPdu): PduRSrcPduRef=PduCollection/C_LDCU_IPB_FaxleRegen_Can_Network_0_CANNODE_0_CanIf2PduR
            C_LDCU_IPB_FaxleRegen_Can_Network_0_CANNODE_0_PduR2Com (PduRDestPdu): PduRTransmissionConfirmation=false, PduRDestPduRef=PduCollection/C_LDCU_IPB_FaxleRegen_Can_Network_0_CANNODE_0_PduR2Com
          C_RDCU_IPB_APB_ROPP_Can_Network_0_CANNODE_0_Com2CanIf
            C_RDCU_IPB_APB_ROPP_Can_Network_0_CANNODE_0_Com2PduR (PduRSrcPdu): PduRSrcPduRef=PduCollection/C_RDCU_IPB_APB_ROPP_Can_Network_0_CANNODE_0_Com2PduR
            C_RDCU_IPB_APB_ROPP_Can_Network_0_CANNODE_0_PduR2CanIf (PduRDestPdu): PduRTransmissionConfirmation=false, PduRDestPduRef=PduCollection/C_RDCU_IPB_APB_ROPP_Can_Network_0_CANNODE_0_PduR2CanIf
          C_RDCU_RLIN3Info_Can_Network_0_CANNODE_0_Com2CanIf
            C_RDCU_RLIN3Info_Can_Network_0_CANNODE_0_Com2PduR (PduRSrcPdu): PduRSrcPduRef=PduCollection/C_RDCU_RLIN3Info_Can_Network_0_CANNODE_0_Com2PduR
            C_RDCU_RLIN3Info_Can_Network_0_CANNODE_0_PduR2CanIf (PduRDestPdu): PduRTransmissionConfirmation=false, PduRDestPduRef=PduCollection/C_RDCU_RLIN3Info_Can_Network_0_CANNODE_0_PduR2CanIf
          C_RDCU_BodyCtrl2_Can_Network_0_CANNODE_0_Com2CanIf
            C_RDCU_BodyCtrl2_Can_Network_0_CANNODE_0_Com2PduR (PduRSrcPdu): PduRSrcPduRef=PduCollection/C_RDCU_BodyCtrl2_Can_Network_0_CANNODE_0_Com2PduR
            C_RDCU_BodyCtrl2_Can_Network_0_CANNODE_0_PduR2CanIf (PduRDestPdu): PduRTransmissionConfirmation=false, PduRDestPduRef=PduCollection/C_RDCU_BodyCtrl2_Can_Network_0_CANNODE_0_PduR2CanIf
          C_RDCU_APBSysSt_Can_Network_0_CANNODE_0_Com2CanIf
            C_RDCU_APBSysSt_Can_Network_0_CANNODE_0_Com2PduR (PduRSrcPdu): PduRSrcPduRef=PduCollection/C_RDCU_APBSysSt_Can_Network_0_CANNODE_0_Com2PduR
            C_RDCU_APBSysSt_Can_Network_0_CANNODE_0_PduR2CanIf (PduRDestPdu): PduRTransmissionConfirmation=false, PduRDestPduRef=PduCollection/C_RDCU_APBSysSt_Can_Network_0_CANNODE_0_PduR2CanIf
    CanIf (PduRBswModules):
      PduRCancelReceive = 0
      PduRCancelTransmit = 0
      PduRChangeParameterApi = 0
      PduRCommunicationInterface = 1
      PduRLowerModule = 1
      PduRRetransmission = 0
      PduRTransportProtocol = 0
      PduRTriggertransmit = 0
      PduRTxConfirmation = 1
      PduRUpperModule = 0
      PduRUseTag = 0
      PduRBswModuleRef = CanIf
    Com (PduRBswModules):
      PduRCancelReceive = 0
      PduRCancelTransmit = 0
      PduRChangeParameterApi = 0
      PduRCommunicationInterface = 1
      PduRLowerModule = 0
      PduRRetransmission = 0
      PduRTransportProtocol = 1
      PduRTriggertransmit = 1
      PduRTxConfirmation = 0
      PduRUpperModule = 1
      PduRUseTag = 0
      PduRBswModuleRef = Com
