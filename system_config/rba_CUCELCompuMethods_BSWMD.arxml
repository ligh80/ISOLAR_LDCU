AUTOSAR XML (schema 4-2-2)
package /RB/RBA/Common/CentralElements/CompuMethods
  compu method Identical: identical  # The internal value and the physical one are identical. No physical unit available
package /RB/RBA/Common/CentralElements/Units
  13 x unit:
    NoUnit: display-name=noUnit, factor-si-to-unit=1.0, offset-si-to-unit=0.0, physical-dimension=NoUnit  # No Unit
    rpm
    kmph
    bar
    mm
    percent
    Nm
    barps
    g
    degps
    degC
    deg
    LUX
package /RB/RBA/Common/CentralElements/PhysicalDimensions
  physical dimension NoUnit: length-exp=0
