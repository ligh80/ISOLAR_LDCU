AUTOSAR XML (schema 4-2-2)
standard types defined: Std_ReturnType
package /AUTOSAR_Std/ImplementationDataTypes  # AUTOSAR Standard types
  impl type Std_VersionInfoType: category=STRUCTURE, type-emitter=HEADER_FILE  # Standard Version Info Type | This type shall be used to request the version of a BSW module using the <Module name>_GetVersionInfo()function.
    5 x element, all with category=TYPE_REFERENCE:
      vendorID: implementation-data-type=uint16
      moduleID: implementation-data-type=uint16
      sw_major_version: implementation-data-type=uint8
      sw_minor_version: implementation-data-type=uint8
      sw_patch_version: implementation-data-type=uint8
package /AUTOSAR_Std/CompuMethods
  compu method Std_High_Low: 0=STD_LOW (no error occurred), 1=STD_HIGH (generic indication that an error occurred)
  compu method Std_Active_Idle: 0=STD_IDLE (no error occurred), 1=STD_ACTIVE (generic indication that an error occurred)
  compu method Std_On_Off: 0=STD_OFF (no error occurred), 1=STD_ON (generic indication that an error occurred)
  compu method CompuMethod_C_LDCU_RMotorSpd: raw=phys for phys 0..16000; unit rpm
  compu method CompuMethod_C_LDCU_RMotorSpdVD: phys=raw for raw 0..1, 0=VALID, 1=INVALID
  compu method CompuMethod_C_LDCU_RMotorSpdDirection: phys=raw for raw 0..1, 0=NEGATIVE, 1=POSITIVE
  compu method CompuMethod_C_IPB_FLWheelSpdEdgesSum: raw=phys for phys 0..4095
  compu method CompuMethod_C_IPB_FRWheelSpdEdgesSum: raw=phys for phys 0..4095
  compu method CompuMethod_C_IPB_RLWheelSpdEdgesSum: raw=phys for phys 0..4095
  compu method CompuMethod_C_IPB_RRWheelSpdEdgesSum: raw=phys for phys 0..4095
  compu method CompuMethod_C_IPB_SpdEdgesMsgCounter: raw=phys for phys 0..15
  compu method CompuMethod_C_IPB_SpdEdgesCRC8Checksum: raw=phys for phys 0..255
  compu method CompuMethod_C_IPB_RLWheelSpd: raw=phys*100 for phys 0..239.99; unit kmph
  compu method CompuMethod_C_IPB_RLWheelSpdVD: phys=raw for raw 0..1, 0=NOTVALID, 1=VALID
  compu method CompuMethod_C_IPB_RRWheelSpd: raw=phys*100 for phys 0..239.99; unit kmph
  compu method CompuMethod_C_IPB_RRWheelSpdVD: phys=raw for raw 0..1, 0=NOTVALID, 1=VALID
  compu method CompuMethod_C_IPB_SimulatorPressure: raw=phys*3.333333333+16.66666667 for phys -5..301.9; unit bar
  compu method CompuMethod_C_IPB_SimulatorPressure_Status: phys=raw for raw 0..3, 1=VALID, 2=INVALID
  compu method CompuMethod_C_IPB_SpdInfo2MsgCounter: raw=phys for phys 0..15
  compu method CompuMethod_C_IPB_SpdInfo2CRC8Checksum: raw=phys for phys 0..255
  compu method CompuMethod_C_LDCU_EPB_APB_ROPP2_Byte{0..7}: raw=phys for phys 0..255
  compu method CompuMethod_C_IPB_SysSt_E2E_Byte{0..11}: raw=phys for phys 0..255
  compu method CompuMethod_C_MFS_Status_Byte{0..7}: raw=phys for phys 0..255
  compu method CompuMethod_C_IPB_InputRodStroke: raw=phys*20+100 for phys -5..46.15; unit mm
  compu method CompuMethod_C_IPB_InputRodStroke_Status: phys=raw for raw 0..1, 0=VALID, 1=INVALID
  compu method CompuMethod_C_IPB_WheelPressureFrontLeftVD: phys=raw for raw 0..1, 0=NOTVALID, 1=VALID
  compu method CompuMethod_C_IPB_WheelPressureFrontLeft: raw=phys*32+640 for phys -20..400; unit bar
  compu method CompuMethod_C_IPB_SysSt1MsgCounter: raw=phys for phys 0..15
  compu method CompuMethod_C_IPB_SysSt1CRC8Checksum: raw=phys for phys 0..255
  compu method CompuMethod_C_AS_wheelPosFLFilt_mm: raw=phys+1000 for phys -1000..1000; unit mm
  compu method CompuMethod_C_AS_wheelPosFRFilt_mm: raw=phys+1000 for phys -1000..1000; unit mm
  compu method CompuMethod_C_AS_wheelPosRLFilt_mm: raw=phys+1000 for phys -1000..1000; unit mm
  compu method CompuMethod_C_AS_wheelPosRRFilt_mm: raw=phys+1000 for phys -1000..1000; unit mm
  compu method CompuMethod_C_LDCU_VehicleCurrentState: phys=raw for raw 0..3, 0=INVALID, 1=STANDSTILL, 2=MOTION, 3=RESERVED
  compu method CompuMethod_C_VehicleCurrentSpeed: raw=phys*100 for phys 0..239.99; unit kmph
  compu method CompuMethod_C_VehicleCurrentSpeedVD: phys=raw for raw 0..1, 0=NOTVALID, 1=VALID
  compu method CompuMethod_C_VehicleRwuVD: phys=raw for raw 0..1, 0=NOTVALID, 1=VALID
  compu method CompuMethod_C_VehicleRwuSpeed: raw=phys*100 for phys 0..239.99; unit kmph
  compu method CompuMethod_C_VehicleRwuSlipeRate: raw=phys*10 for phys 0..100; unit percent
  compu method CompuMethod_C_VehicleCurrentSlope: raw=phys+40 for phys -40..40; unit percent
  compu method CompuMethod_C_VehicleCurrentSlopeVD: phys=raw for raw 0..1, 0=NOTVALID, 1=VALID
  compu method CompuMethod_C_XPU_IPB_ADASToqCtrl_Byte{0..7}: raw=phys for phys 0..255
  compu method CompuMethod_C_IPB_FLWheelSpd: raw=phys*100 for phys 0..239.99; unit kmph
  compu method CompuMethod_C_IPB_FLWheelSpdVD: phys=raw for raw 0..1, 0=NOTVALID, 1=VALID
  compu method CompuMethod_C_IPB_FRWheelSpd: raw=phys*100 for phys 0..239.99; unit kmph
  compu method CompuMethod_C_IPB_FRWheelSpdVD: phys=raw for raw 0..1, 0=NOTVALID, 1=VALID
  compu method CompuMethod_C_IPB_VehSpd: raw=phys*100 for phys 0..239.99; unit kmph
  compu method CompuMethod_C_IPB_VehSpdVD: phys=raw for raw 0..3, 0=NOTINITIALIZED, 1=VALID, 2=INVALID, 3=RESERVED
  compu method CompuMethod_C_IPB_SpdInfo1MsgCounter: raw=phys for phys 0..15
  compu method CompuMethod_C_IPB_SpdInfo1CRC8Checksum: raw=phys for phys 0..255
  compu method CompuMethod_C_IPB_SpdInfo_E2E_Byte{0..15}: raw=phys for phys 0..255
  compu method CompuMethod_C_AS_WelcomeSt: phys=raw for raw 0..3, 0=INVALID, 1=NOTACTIVE, 2=ACTIVE, 3=RESERVED
  compu method CompuMethod_C_AS_EasyloadingSt: phys=raw for raw 0..3, 0=INVALID, 1=NOTACTIVE, 2=ACTIVE, 3=RESERVED
  compu method CompuMethod_C_AS_MaintainMode: phys=raw for raw 0..7, 0=NOREQUEST, 1=MAINTENANCEMODE, 2=TRANSPORTMODE, 3=TRAILERMODE, 4=RESERVED, 5=RESERVED, 6=CAMPINGMODE
  compu method CompuMethod_C_AS_HoistMode: phys=raw for raw 0..1, 0=NOTACTIVE, 1=ACTIVE
  compu method CompuMethod_C_LDCU_PowerMode: phys=raw for raw 0..3, 0=OFF, 1=LOCALON, 2=REMOTEON, 3=RESERVED
  compu method CompuMethod_C_LDCU_DriverDoorLockSt: phys=raw for raw 0..1, 0=UNLOCK, 1=LOCK
  compu method CompuMethod_C_LDCU_DriverDoorAjarSt: phys=raw for raw 0..1, 0=CLOSED, 1=OPEN
  compu method CompuMethod_C_LDCU_RLDoorAjarSt: phys=raw for raw 0..1, 0=CLOSED, 1=OPEN
  compu method CompuMethod_C_LDCU_DrvSeatOccupancySt: phys=raw for raw 0..1, 0=NOTOCCUPIED, 1=OCCUPIED
  compu method CompuMethod_C_LDCU_RLSeatOccupancySt: phys=raw for raw 0..1, 0=NOTOCCUPIED, 1=OCCUPIED
  compu method CompuMethod_C_LDCU_HazardLampReq: phys=raw for raw 0..7, 0=NOCOMMAND, 1=ONCE, 2=TWICE, 3..7=RESERVED
  compu method CompuMethod_C_LDCU_HazardLampSwSt: phys=raw for raw 0..1, 0=OFF, 1=ON
  compu method CompuMethod_C_LDCU_AlarmSt: phys=raw for raw 0..3, 0=ARMED, 1=PREARMED, 2=DISARMED, 3=ALARM
  compu method CompuMethod_C_LDCU_DoorLockCtrlSt: phys=raw for raw 0..7, 0=NOCOMMAND, 1=DRIVERDOORUNLOCK, 2=ALLUNLOCK, 3=ALLLOCK, 4..7=RESERVED
  compu method CompuMethod_C_LDCU_DoorLockSource: phys=raw for raw 0..31, 22..31=RESERVED, 10=SPEEDLOCK, 11=BLEPOLLINGLOCK, 12=OTALOCK, 13=XPULOCK, 14=FOURGTMPYLOCK, 15=BLETMPYLOCK, 16=SILENTLOCK, 17=UWBPELOCK, 18=UWBPOLLINGLOCK, 19=BLEWATCHLOCK, 0=NOCOMMAND, 1=RKELOCK, 2=POLLINGLOCK, 3=NFCLOCK, 4=BLELOCK, 5=FOURGLOCK, 6=CENTERSWLOCK, 7=CDCUSWLOCK, 8=PHYSICALLOCK, 9=SECONDLOCK, 20=SOALOCK, 21=RESERVED
  compu method CompuMethod_C_LDCU_DoorUnlockSource: phys=raw for raw 0..31, 22=FOURGREADYUNLOCK, 23=SOAUNLOCK, 24..31=RESERVED, 10=CRASHUNLOCK, 11=XPUUNLOCK, 12=BLEPOLLINGUNLOCK, 13=THERMALRUNAWAYUNLOCK, 14=ALM_UNLOCK, 15=MECHANICALANTI_MISLOCK, 16=DOOROPENUNLOCK, 17=SILENTUNLOCK, 18=BLEENABLEUNLOCK, 19=UWBPEUNLOCK, 0=NOCOMMAND, 1=RKEUNLOCK, 2=POLLINGUNLOCK, 3=NFCUNLOCK, 4=BLEUNLOCK, 5=FOURGUNLOCK, 6=CENTERSWUNLOCK, 7=CDCUSWUNLOCK, 8=PHYSICALUNLOCK, 9=PARKINGUNLOCK, 20=UWBPOLLINGUNLOCK, 21=BLEWATCHUNLOCK
  compu method CompuMethod_C_LDCU_DoorLockEvent: phys=raw for raw 0..3, 0=NOEVENT, 1=LOCK, 2=UNLOCK, 3=RESERVED
  compu method CompuMethod_C_LDCU_ChargeGunCmd: phys=raw for raw 0..3, 0=NOCOMMAND, 1=LOCKT, 2=UNLOCK, 3=NOTUSED
  compu method CompuMethod_C_LDCU_TrunkReleaseSW: phys=raw for raw 0..1, 0=NOTPRESSED, 1=PRESSED
  compu method CompuMethod_C_LDCU_LockLogicSt: phys=raw for raw 0..1, 0=UNLOCK, 1=LOCK
  compu method CompuMethod_C_CDCU_ESP_EPBReq: phys=raw for raw 0..3, 0=NOCOMMAND, 1=RELEASE, 2=APPLY, 3=RESERVED
  compu method CompuMethod_C_CDCU_ESP_EPBReqVD: phys=raw for raw 0..1, 0=NOTVALID, 1=VALID
  compu method CompuMethod_C_CDCU_EPB_Tra_modeReq: phys=raw for raw 0..3, 0=NOCOMMAND, 1=TRAMODE, 2=RESERVED, 3=RESERVED
  compu method CompuMethod_C_CDCU_EPB_Tra_modeReqVD: phys=raw for raw 0..1, 0=NOTVALID, 1=VALID
  compu method CompuMethod_C_IPB_WheelPressureFrontRightVD: phys=raw for raw 0..1, 0=NOTVALID, 1=VALID
  compu method CompuMethod_C_IPB_WheelPressureRearLeftVD: phys=raw for raw 0..1, 0=NOTVALID, 1=VALID
  compu method CompuMethod_C_IPB_WheelPressureRearRightVD: phys=raw for raw 0..1, 0=NOTVALID, 1=VALID
  compu method CompuMethod_C_IPB_WheelPressureFrontRight: raw=phys*32+640 for phys -20..400; unit bar
  compu method CompuMethod_C_IPB_WheelPressureRearLeft: raw=phys*32+640 for phys -20..400; unit bar
  compu method CompuMethod_C_IPB_WheelPressureRearRight: raw=phys*32+640 for phys -20..400; unit bar
  compu method CompuMethod_C_IPB_CyPressure2MsgCounter: raw=phys for phys 0..15
  compu method CompuMethod_C_IPB_CyPressure2CRC8Checksum: raw=phys for phys 0..255
  compu method CompuMethod_C_IPB_ABSFault: phys=raw for raw 0..1, 0=NOTFAULT, 1=FAULT
  compu method CompuMethod_C_IPB_ABSActSt: phys=raw for raw 0..1, 0=NOTACTIVE, 1=ACTIVE
  compu method CompuMethod_C_IPB_EBDFault: phys=raw for raw 0..1, 0=NOTFAULT, 1=FAULT
  compu method CompuMethod_C_IPB_EBDActSt: phys=raw for raw 0..1, 0=NOTACTIVE, 1=ACTIVE
  compu method CompuMethod_C_IPB_VDCActSt: phys=raw for raw 0..1, 0=NOTACTIVE, 1=ACTIVE
  compu method CompuMethod_C_IPB_XPedalAVHActSt: phys=raw for raw 0..3, 0=NOTACTIVE, 1=HOLDING, 2=ACTIVE, 3=NOTAVAILABLE
  compu method CompuMethod_C_IPB_BrkLightOnReq: phys=raw for raw 0..1, 0=OFF, 1=ON
  compu method CompuMethod_C_IPB_TCSActSt: phys=raw for raw 0..1, 0=NOTACTIVE, 1=ACTIVE
  compu method CompuMethod_C_IPB_HHCFault: phys=raw for raw 0..1, 0=NOTFAULT, 1=FAULT
  compu method CompuMethod_C_IPB_HHCActSt: phys=raw for raw 0..1, 0=NOTACTIVE, 1=ACTIVE
  compu method CompuMethod_C_IPB_AVHFault: phys=raw for raw 0..1, 0=NOTFAULT, 1=FAULT
  compu method CompuMethod_C_IPB_EBAAct: phys=raw for raw 0..1, 0=NOTACTIVE, 1=ACTIVE
  compu method CompuMethod_C_IPB_AVHActSt: phys=raw for raw 0..3, 0=NOTACTIVE, 1=STANDBY, 2=ACTIVE, 3=RESERVED
  compu method CompuMethod_C_IPB_HpsAcknowledge: phys=raw for raw 0..1, 0=NOTACKNOWLEDGED, 1=ACKNOWLEDGED
  compu method CompuMethod_C_IPB_HpsAvailability: phys=raw for raw 0..1, 0=NOTAVAILABLE, 1=AVAILABLE
  compu method CompuMethod_C_IPB_ESPPATA: phys=raw for raw 0..3, 0=NORMAL, 1=SPORT, 2=OFF, 3=RESERVED
  compu method CompuMethod_C_IPB_ESPFault: phys=raw for raw 0..1, 0=NOTFAULT, 1=FAULT
  compu method CompuMethod_C_IPB_CDPAvl: phys=raw for raw 0..1, 0=NOTAVAILABLE, 1=AVAILABLE
  compu method CompuMethod_C_IPB_CDPIntervention: phys=raw for raw 0..1, 0=NOTINTERVENTION, 1=INTERVENTION
  compu method CompuMethod_C_IPB_AEBAvl: phys=raw for raw 0..1, 0=NOTAVAILABLE, 1=AVAILABLE
  compu method CompuMethod_C_IPB_AEBAct: phys=raw for raw 0..1, 0=NOTACTIVE, 1=ACTIVE
  compu method CompuMethod_C_IPB_CddSt: phys=raw for raw 0..1, 0=NOTACTIVE, 1=ACTIVE
  compu method CompuMethod_C_IPB_CddAvl: phys=raw for raw 0..1, 0=NOTAVAILABLE, 1=AVAILABLE
  compu method CompuMethod_C_IPB_StandStillSt: phys=raw for raw 0..3, 0=NOTSTANDSTILL, 1=STANDSTILL, 2=INVALID, 3=RESERVED
  compu method CompuMethod_C_IPB_ABAAvl: phys=raw for raw 0..1, 0=NOTAVAILABLE, 1=AVAILABLE
  compu method CompuMethod_C_IPB_ABAAct: phys=raw for raw 0..1, 0=NOTACTIVE, 1=ACTIVE
  compu method CompuMethod_C_IPB_ABPAvl: phys=raw for raw 0..1, 0=NOTAVAILABLE, 1=AVAILABLE
  compu method CompuMethod_C_IPB_ABPAct: phys=raw for raw 0..1, 0=NOTACTIVE, 1=ACTIVE
  compu method CompuMethod_C_IPB_AWBAvl: phys=raw for raw 0..1, 0=NOTAVAILABLE, 1=AVAILABLE
  compu method CompuMethod_C_IPB_AWBAct: phys=raw for raw 0..1, 0=NOTACTIVE, 1=ACTIVE
  compu method CompuMethod_C_IPB_CDDBrkTempOff: phys=raw for raw 0..1, 0=NOTTOOHIGH, 1=TEMPERATURETOOHIGH
  compu method CompuMethod_C_IPB_CDDFaultSt: phys=raw for raw 0..1, 0=NOTFAULT, 1=FAULT
  compu method CompuMethod_C_IPB_BrkPedalSt: phys=raw for raw 0..1, 0=NOTPRESSED, 1=PRESSED
  compu method CompuMethod_C_IPB_BrkPedalStVD: phys=raw for raw 0..1, 0=NOTVALID, 1=VALID
  compu method CompuMethod_C_IPB_EmerLightReq: phys=raw for raw 0..1, 0=OFF, 1=ON
  compu method CompuMethod_C_IPB_DTCActSt: phys=raw for raw 0..1, 0=NOTACTIVE, 1=ACTIVE
  compu method CompuMethod_C_IPB_DTCFault: phys=raw for raw 0..1, 0=NOTFAULT, 1=FAULT
  compu method CompuMethod_C_IPB_SCMSt: phys=raw for raw 0..1, 0=NOTACTIVE, 1=ACTIVE
  compu method CompuMethod_C_IPB_SCMFault: phys=raw for raw 0..1, 0=NOTAVAILABLE, 1=AVAILABLE
  compu method CompuMethod_C_IPB_EBAAvl: phys=raw for raw 0..1, 0=NOTAVAILABLE, 1=AVAILABLE
  compu method CompuMethod_C_IPB_SysStMsgCounter: raw=phys for phys 0..15
  compu method CompuMethod_C_IPB_SysStCRC8Checksum: raw=phys for phys 0..255
  compu method CompuMethod_C_LDCU_RWheelPeakTorqMax: raw=phys*0.2 for phys 0..5000; unit Nm
  compu method CompuMethod_C_LDCU_RWheelPeakTorqMin: raw=phys*0.25+875 for phys -3500..0; unit Nm
  compu method CompuMethod_C_LDCU_RWheelCurTorq: raw=phys*0.25+1500 for phys -6000..6000; unit Nm
  compu method CompuMethod_C_LDCU_RWheelDriverTorqReq: raw=phys*0.25+1500 for phys -6000..6000; unit Nm
  compu method CompuMethod_C_LDCU_BrakePrRampReq: raw=phys*0.25 for phys 0..1000; unit barps
  compu method CompuMethod_C_LDCU_RTorqInfoMsgCounter: raw=phys for phys 0..15
  compu method CompuMethod_C_LDCU_RTorqInfoCRC8Checksum: raw=phys for phys 0..255
  compu method CompuMethod_C_IPB_VehLongAccel: raw=phys*361.2716763+625 for phys -1.73..1.73; unit g
  compu method CompuMethod_C_IPB_VehLateralAccel: raw=phys*361.2716763+625 for phys -1.73..1.73; unit g
  compu method CompuMethod_C_IPB_VehLongAccelVD: phys=raw for raw 0..1, 0=NOTVALID, 1=VALID
  compu method CompuMethod_C_IPB_VehLateralAccelVD: phys=raw for raw 0..1, 0=NOTVALID, 1=VALID
  compu method CompuMethod_C_IPB_YAWRate: raw=phys*16+1488 for phys -93..93; unit degps
  compu method CompuMethod_C_IPB_YAWRateVD: phys=raw for raw 0..1, 0=NOTVALID, 1=VALID
  compu method CompuMethod_C_LDCU_EVSysReadySt: phys=raw for raw 0..3, 0=NOTREADY, 1=HIGHVOLTAGEON, 2=READY
  compu method CompuMethod_C_LDCU_GearLev: phys=raw for raw 0..7, 0=INVALID, 1=DGEAR, 2=NGEAR, 3=RGEAR, 4=PGEAR, 5=RESERVED, 6=RESERVED, 7=RESERVED
  compu method CompuMethod_C_LDCU_CurrentGearLev: phys=raw for raw 0..7, 0=INVALID, 1=D, 2=N, 3=R, 4=P, 5=RESERVED, 6=RESERVED, 7=RESERVED
  compu method CompuMethod_C_LDCU_ExterTemp: raw=phys*2+80 for phys -40..87.5; unit degC
  compu method CompuMethod_C_LDCU_ExterTempVD: phys=raw for raw 0..1, 0=NOTVALID, 1=VALID
  compu method CompuMethod_C_LDCU_BrkPedalSt: phys=raw for raw 0..1, 0=NOTPRESSED, 1=PRESSED
  compu method CompuMethod_C_LDCU_BrkPedalStVD: phys=raw for raw 0..1, 0=NOTVALID, 1=VALID
  compu method CompuMethod_C_LDCU_AccPedalSigVD: phys=raw for raw 0..1, 0=NOTVALID, 1=VALID
  compu method CompuMethod_C_LDCU_AccPedalSig: raw=phys for phys 0..100
  compu method CompuMethod_C_LDCU_ESP_EPBReq: phys=raw for raw 0..3, 0=NOCOMMAND, 1=RELEASE, 2=APPLY, 3=RESERVED
  compu method CompuMethod_C_LDCU_ESP_EPBReqVD: phys=raw for raw 0..1, 0=NOTVALID, 1=VALID
  compu method CompuMethod_C_LDCU_FTorqInfo_Byte{0..7}: raw=phys for phys 0..255
  compu method CompuMethod_C_LDCU_APBSysSt_Byte{0..7}: raw=phys for phys 0..255
  compu method CompuMethod_C_IPB_PlungerPressure: raw=phys*3.333333333+16.66666667 for phys -5..301.6; unit bar
  compu method CompuMethod_C_IPB_PlungerPressure_Status: phys=raw for raw 0..1, 0=NOTVALID, 1=VALID
  compu method CompuMethod_C_AS_LvlSnsrCalSts: phys=raw for raw 0..1, 0=INVALID, 1=VALID
  compu method CompuMethod_C_IPB_EPB_ParkReq: phys=raw for raw 0..3, 0=NOREQUEST, 1=RELESEBAKEREQUEST, 2=LOCKBAKEREQUEST, 3=INVAILID
  compu method CompuMethod_C_IPB_EPB_ActiveVehicleHold: phys=raw for raw 0..1, 0=NOTACTIVEVEHICLEHOLD_, 1=ACTIVEVEHILCEHOLD_
  compu method CompuMethod_C_IPB_CruiseCtrlCancelReq: phys=raw for raw 0..1, 0=NOREQUEST, 1=REQUEST
  compu method CompuMethod_C_IPB_TSMFaultSt: phys=raw for raw 0..1, 0=NOTFAULT, 1=FAULT
  compu method CompuMethod_C_IPB_TSMActSt: phys=raw for raw 0..1, 0=NOTACTIVE, 1=ACTIVE
  compu method CompuMethod_C_IPB_TSMFuncSt: phys=raw for raw 0..1, 0=OFF, 1=ON
  compu method CompuMethod_C_IPB_APBSysStMsgCounter: raw=phys for phys 0..15
  compu method CompuMethod_C_IPB_APBSysStCRC8Checksum: raw=phys for phys 0..255
  compu method CompuMethod_C_LDCU_FMotorSpd: raw=phys for phys 0..16000; unit rpm
  compu method CompuMethod_C_LDCU_FMotorSpdDirection: phys=raw for raw 0..1, 0=NEGATIVE, 1=POSITIVE
  compu method CompuMethod_C_LDCU_FMotorSpdVD: phys=raw for raw 0..1, 0=VALID, 1=INVALID
  compu method CompuMethod_C_RDCU_IPB_APB_ROPP_Byte{0..7}: raw=phys for phys 0..255
  compu method CompuMethod_C_RDCU_FWiperAngle: raw=phys for phys 0..255; unit deg
  compu method CompuMethod_C_RDCU_FWiperMotorAngle: raw=phys for phys 0..255; unit deg
  compu method CompuMethod_C_RDCU_FWiperSpd: phys=raw for raw 0..15, 0=SPEED0_MIN, 11=SPEED60_MIN_HIGHSPD_, 1=SPEED40_MIN_LOWSPD_, 2=SPEED42_MIN, 3=SPEED44_MIN, 4=SPEED46_MIN, 5=SPEED48_MIN, 6=SPEED50_MIN, 7=SPEED52_MIN, 8=SPEED54_MIN, 9=SPEED56_MIN, 10=SPEED58MIN
  compu method CompuMethod_C_RDCU_FWiperActiveSt: phys=raw for raw 0..1, 0=NOTACTIVE, 1=ACTIVE
  compu method CompuMethod_C_RDCU_FWiperParkARSt: phys=raw for raw 0..1, 0=NOTINPARKINGAREA, 1=INPARKINGAREA
  compu method CompuMethod_C_RDCU_FWiperTurnPosSt: phys=raw for raw 0..1, 0=NOTINTURNINGAREA, 1=INTURNINGAREA
  compu method CompuMethod_C_RDCU_FWiperServicePosSt: phys=raw for raw 0..1, 0=NOTINSERVICEPOSITION, 1=INSERVICEPOSITION
  compu method CompuMethod_C_RDCU_FWiperBlkPosSt: phys=raw for raw 0..1, 0=NOBLOCKDETECTED, 1=BLOCKDETECTED
  compu method CompuMethod_C_RDCU_FWiperMoveDir: phys=raw for raw 0..3, 0=NOMOVE, 1=UPPER, 2=DOWN, 3=RESERVED
  compu method CompuMethod_C_RDCU_FWiperVoltErr: phys=raw for raw 0..3, 0=NOERR, 1=OVERVOLTAGE, 2=UNDERVOLTAGE
  compu method CompuMethod_C_RDCU_FWiperMotorErr: phys=raw for raw 0..1, 0=NOERR, 1=ERR
  compu method CompuMethod_C_RDCU_FWiperLinErr: phys=raw for raw 0..1, 0=NOERR, 1=ERR
  compu method CompuMethod_C_RDCU_FWiperTempProtectSt: phys=raw for raw 0..1, 0=NOTACTIVE, 1=ACTIVE
  compu method CompuMethod_C_RDCU_FWiperOverLoadSt: phys=raw for raw 0..1, 0=NOTACTIVE, 1=ACTIVE
  compu method CompuMethod_C_RDCU_RLSRQWiperSPD: phys=raw for raw 0..15, 0=SPEED0_MIN, 11=SPEED60_MIN_HIGHSPD_, 1=SPEED40_MIN_LOWSPD_, 2=SPEED42_MIN, 3=SPEED44_MIN, 4=SPEED46_MIN, 5=SPEED48_MIN, 6=SPEED50_MIN, 7=SPEED52_MIN, 8=SPEED54_MIN, 9=SPEED56_MIN, 10=SPEED58MIN
  compu method CompuMethod_C_RDCU_RLSFaultRain: phys=raw for raw 0..1, 0=NORMALSTATUS, 1=STATUSFAULT
  compu method CompuMethod_C_RDCU_RLSREPError: phys=raw for raw 0..1, 0=NOERROR, 1=ERROR
  compu method CompuMethod_C_RDCU_RLSVOLTError: phys=raw for raw 0..3, 0=NOERROR, 1=VOLT_LOW, 2=VOLT_HIGH, 3=NOTUSED
  compu method CompuMethod_C_RDCU_RLSRainIntensity: raw=phys*0.5 for phys 0..100; unit percent
  compu method CompuMethod_C_RDCU_RLSBrightnessFW: raw=phys/6 for phys 0..6138; unit LUX
  compu method CompuMethod_C_RDCU_RLSDCbreA: raw=phys for phys 0..65535
  compu method CompuMethod_C_RDCU_RLSADCA: raw=phys for phys 0..65535
  compu method CompuMethod_C_RDCU_RLSDCbreB: raw=phys for phys 0..65535
  compu method CompuMethod_C_RDCU_RLSADCB: raw=phys for phys 0..65535
  compu method CompuMethod_C_FWiperSysFaultWarning: phys=raw for raw 0..1, 0=NORMAL, 1=WARNING
  compu method CompuMethod_C_RDCU_BacklightBrightCtr: phys=raw for raw 0..1, 0=NOTACTIVE, 1=ACTIVE
  compu method CompuMethod_C_RDCU_PLGAlarmReq: phys=raw for raw 0..1, 0=INACTIVE, 1=ACTIVE
  compu method CompuMethod_C_RDCU_ChrgConnStReq: phys=raw for raw 0..1, 0=NOREQUEST, 1=REQUEST
  compu method CompuMethod_C_RDCU_SecurityAccessReq: phys=raw for raw 0..1, 0=NOREQUEST, 1=REQUEST
  compu method CompuMethod_C_ARSMotorCurrent: raw=phys*10 for phys 0..25.5
  compu method CompuMethod_C_ARSCurtHallCnt: raw=phys for phys 0..65535
  compu method CompuMethod_C_ARSWorkSt: phys=raw for raw 0..1, 0=NORMAL, 1=ERROR
  compu method CompuMethod_C_ARSTermalProtec: phys=raw for raw 0..3, 0=INVALID, 1=ACTIVE, 2=PROTCNOTOPEN, 3=RESERVED
  compu method CompuMethod_C_ARSPstValu: phys=raw for raw 0..255, 230=UNKNOWN, 110=UNKNOWN, 231=UNKNOWN, 111=UNKNOWN, 232=UNKNOWN, 112=UNKNOWN, 233=UNKNOWN, 113=UNKNOWN, 234=UNKNOWN, 114=UNKNOWN, 235=UNKNOWN, 115=UNKNOWN, 236=UNKNOWN, 116=UNKNOWN, 237=UNKNOWN, 117=UNKNOWN, 238=UNKNOWN, 118=UNKNOWN, 239=UNKNOWN, 119=UNKNOWN, 10..19=HALF_FOLD, 240=UNKNOWN, 120=UNKNOWN, 241=UNKNOWN, 0=FULLFOLDED, 121=UNKNOWN, 242=UNKNOWN, 1=HALF_FOLD, 122=UNKNOWN, 243=UNKNOWN, 2=HALF_FOLD, 123=UNKNOWN, 244=UNKNOWN, 3=HALF_FOLD, 124=UNKNOWN, 245=UNKNOWN, 4=HALF_FOLD, 125=UNKNOWN, 246=UNKNOWN, 5=HALF_FOLD, 126=UNKNOWN, 247=UNKNOWN, 6=HALF_FOLD, 127=UNKNOWN, 248=UNKNOWN, 7=HALF_FOLD, 128=UNKNOWN, 249=UNKNOWN, 8=HALF_FOLD, 129=UNKNOWN, 9=HALF_FOLD, 20..29=HALF_FOLD, 250=UNKNOWN, 130=UNKNOWN, 251=UNKNOWN, 131=UNKNOWN, 252=UNKNOWN, 132=UNKNOWN, 253=UNKNOWN, 133=UNKNOWN, 254=UNKNOWN, 134=UNKNOWN, 255=UNKNOWN, 135..139=UNKNOWN, 30..39=HALF_FOLD, 140..149=UNKNOWN, 40..49=HALF_FOLD, 150..159=UNKNOWN, 50..59=HALF_FOLD, 160..169=UNKNOWN, 60..69=HALF_FOLD, 170..179=UNKNOWN, 70..79=HALF_FOLD, 180..189=UNKNOWN, 80..89=HALF_FOLD, 190..199=UNKNOWN, 90..99=HALF_FOLD, 200..220=UNKNOWN, 100=FULLUNFOLDED, 221=UNKNOWN, 101=UNKNOWN, 222=UNKNOWN, 102=UNKNOWN, 223=UNKNOWN, 103=UNKNOWN, 224=UNKNOWN, 104=UNKNOWN, 225=UNKNOWN, 105=UNKNOWN, 226=UNKNOWN, 106=UNKNOWN, 227=UNKNOWN, 107=UNKNOWN, 228=UNKNOWN, 108=UNKNOWN, 229=UNKNOWN, 109=UNKNOWN
  compu method CompuMethod_C_ARSFailureCause: phys=raw for raw 0..15, 0=RESERVED, 1=PSTOVERVALUE, 2=PSTFAIL, 3=MAXARSHALLCNTFAIL, 4=CALIBRATIONHALLCOUNTFAIL, 5=ARSHALLERR, 6=NVMFAILZEROPOSLEARNINGFAIL, 7=STALLDECTECTIONTIMEOUT, 8=ZEROPOSLEARNINGFAIL, 9=ARSMOTORSTALL, 10=RESERVED
  compu method CompuMethod_C_ARSAntiPinchSt: phys=raw for raw 0..1, 0=NOT_ACTIVE, 1=ACTIVE
  compu method CompuMethod_C_RDCU_APBSysSt_Byte{0..7}: raw=phys for phys 0..255
